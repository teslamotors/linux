## Documentation/devicetree/bindings/platform/tegra/tegra-ape-ivc.txt
```
NVIDIA Tegra APE aux CPU, with communication via the "IVC" IPC protocol.

APE is an aux CPU which talks to CCPLEX over IVC.

Its assumed that the APE FW implements IVC, and uses HSP IRQs as part of IVC.
Its also assumed that the APE FW expects AST regions 0/1/2 are already set up
for the APE to access FW in DRAM, SYSRAM if applicable, and the IVC memory.

== APE top-level node ==

The APE core is represented by the top-level node including direct HW resources
such as clocks, resets etc.

Required properties:
- compatible: should be "nvidia,tegra186-ape-ivc" for T18x.
- reg: Address entries (APE BASE, APE IVC CPU AST, APE IVC DMA AST)
  Formatted as per standard rules for this property.
- reg-names: "ape-evp", "ast-cpu", "ast-dma" as per the reg property.
- clocks: Should contain an entry for each entry in clock-names.
  See ../clock/clock-bindings.txt for details.
- clock-names: Names of the clocks required by APE.
  Must include following entries:
  - ahub
  - apb2ape
  - ape
  - adsp
  - adspneon
- resets: Should contain an entry for each entry in reset-names.
  See ../reset/reset.txt for details.
- reset-names: Names of the resets required for APE.
  Must include following entries:
  - adspdbg
  - adspintf
  - adspneon
  - adspperiph
  - adspscu
  - adspwdt
  - ape
  - adsp
- nvidia,ivc-channels: IVC channel layout. See ./tegra-sce-ivc.txt.

Optional properties:
- nvidia,stream-id: should contain the SMMU Stream ID used.

== APE sub nodes ==

* hsp

Describes the hardware synchronization primitive(s) used.
See ./tegra-sce-ivc.txt for details (syntax is the same).

== Possible example ==

tegra_ape: rtcpu@2993000 {
	compatible = "nvidia,tegra186-ape-ivc";
	reg =	<0 0x02993000 0 0x1000>,
		<0 0x02994000 0 0x2000>,
		<0 0x02996000 0 0x2000>;
	reg-names = "ape-evp", "ast-cpu", "ast-dma";
	clocks =
		<&tegra_car TEGRA186_CLK_AHUB>,
		<&tegra_car TEGRA186_CLK_APB2APE>,
		<&tegra_car TEGRA186_CLK_APE>,
		<&tegra_car TEGRA186_CLK_ADSP>,
		<&tegra_car TEGRA186_CLK_ADSPNEON>;
	clock-names =
		"ahub",
		"apb2ape",
		"ape",
		"adsp",
		"adspneon";
	resets = <&tegra_car TEGRA186_RESET_ADSP_ALL>;
	reset-names = "adsp-all";

	/* See ./tegra-sce-ivc.txt for generic IVC example */
};
```

## Documentation/devicetree/bindings/platform/tegra/tegra-eqos.txt
```
Device tree binding for NVIDIA Tegra186 Ethernet QOS Controller
=================================================================

The Tegra186 EQOS (Ethernet QOS) device is an Ethernet controller which
supports Quality of Service features.


Required properties:
- compatible: should be "synopsys,dwc_eth_qos"
- reg: Physical base address and length of registers.
- interrupts: An array of tuples specifying IRQ number for each tx/rx queue.
- nvidia,csr_clock_speed: Specifies number of clocks in a microsecond.
	Controls reference time for LPI timers when EEE is enabled.
- nvidia,local-mac-address: Assigned MAC addressed.  This is
	populated by BL.
- clocks: Specifies the needed clocks.
- clock-names: Specifies the names of the needed clocks.
- resets: Specifies the reset line.
- reset-names: Specifies the name of the reset line.
- nvidia,use_multi_queues: If specified, enables multi queue support.
	Default is use_multi_queues is specified.  Otherwise, only
	one queue is enabled.
- nvidia,ptp_ref_clock_speed: Specified in microseconds.
- nvidia,rxq_enable_ctrl: An array where each entry specifies operating
	mode for rx queue.
- nvidia,queue_prio: An array where each entry specifies priority of
	tx and rx queue.
- nvidia,phy-reset-gpio: Specifies gpio pin for resetting PHY.
- nvidia,phy-intr-gpio: Specifies gpio pin for PHY interrupts.
- nvidia,phy-max-frame-size: Specifies maximum frame size supported by
	PHY in kilobytes.  Default is 10kb.   Will determine maximum
	jumbo frame size allowed.

Optional properties:
- nvidia,use_tagged_ptp: If specified, enables tagged PTP.
- nvidia,ptp_dma_ch: Specifies channel to route PTP packets.
	Channel 0 is default.
- nvidia,intr_mode: Specifies if only one IRQ is enabled or one for each
	channel.  Default is one IRQ.
- nvidia,chan_mode: Specifies operating mode for each channel's irq handler.
	Only applicable if intr_mode is "1". Default is NAPI.
- nvidia,chan_napi_quota: Specifies number of tx/rx completions to process
	when napi handler is called.  Default is "64".
- nvidia,pause_frames: Used to disable/enable PAUSE frames support.
	Default is enabled.
```
