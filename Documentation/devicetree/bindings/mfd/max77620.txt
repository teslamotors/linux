## Documentation/devicetree/bindings/padctrl/padctrl-tegra186-pmc.txt
```
This describe DT binding of the pad controller driver for Tegra 186 pmc.

Required properties:
- Compatible: Must be nvidia,tegra186-pmc.
- #padcontroller-cells: Number of padctrl arguments. It must be 1.

Pad intitialisation through subnode:
==================================
Driver offers the pad initialisation through subnode. The subnode
under "pmc" node contains the subnode name "io-pad-defaults" which contains
child node of pads and their settings.
Following are child node name for the "io-pad-defaults" node.
	audio-hv, dmic-hv, ao-hv, sdmmc1-hv, sdmmc2-hv, sdmmc3-hv,
	spi, dbg, ufs.

Optional properties:
- nvidia,pad-name: Pad name if child node name is not used for pad name.
- nvidia,io-pad-init-voltage: Voltage value. Options are
		IO_RAIL_VOLTAGE_1_2V,
		IO_RAIL_VOLTAGE_1_8V,
		IO_RAIL_VOLTAGE_3_3V.
- nvidia,deep-power-down-enable: Boolean, Deep power down enable.
- nvidia,deep-power-down-disable: Boolean, deep power down disable.
- nvidia,io-pad-power-enable: boolean, enable io pad power i.e. deep power
		down disable.
- nvidia,io-pad-power-disable: boolean, disable io pad power i.e. deep
		power down enable.
- nvidia,enable-dynamic-pad-voltage: boolean, allow dynamic pad voltage
		configuration. If this property is mising then it only
		only allo the configuration during init and thereafter,
		no dynamic switching.

	Property should be used for better readbility and not conflict with
	other properties.

	pmc {
		::::
		io-pad-defaults {
			audio-hv {
				nvidia,deep-power-down-enable;
			};

			dmic-hv {
				nvidia,io-pad-init-voltage = <IO_RAIL_VOLTAGE_1_8V>;
			};
			:::
		};
	};


Example: SDMMC1 pad is 6 and SDMMC3 is 7.

	tegra_pmc: pmc@c360000 {
		compatible = "nvidia,tegra186-pmc";
		reg = <0x0 0xc360000 0x0 0x400>;
		#padcontroller-cells = <1>;
		status = "disabled";
		io-pad-defaults {
			gpio {
				nvidia,io-pad-init-voltage = <IO_RAIL_VOLTAGE_1_8V>;
			};
			audio-hv {
				nvidia,io-pad-init-voltage = <IO_RAIL_VOLTAGE_3_3V>;
			};
		};
	};


	sdhci@700b0400 {
		compatible = "nvidia,tegra186-sdhci";
		::::
		pad-controllers = <&tegra_pmc TEGRA186_PAD_SDMMC3>;
		pad-names = "sdmmc";
		::::
	};
```

## Documentation/devicetree/bindings/padctrl/padctrl-tegra210-pmc.txt
```
This describe DT binding of the pad controller driver for Tegra 210 pmc.

Required properties:
- Compatible: Must be nvidia,tegra210-pmc.
- #padcontroller-cells: Number of padctrl arguments. It must be 1.

Pad intitialisation through subnode:
==================================
Driver offers the pad initialisation through subnode. The subnode
under "pmc" node contains the subnode name "io-pad-defaults" which contains
child node of pads and their settings.
Following are child node name for the "io-pad-defaults" node.
	audio, audio-hv, cam, csi, csib, csic, csid, csie, csif,
	dbg, debug-nonao, dmic, dp, dsi, dsib, dsic, dsid, emmc,
	emmc2, gpio, hdmi, hsic, lvds, mipi-bias, pex-bias,
	pex-clk1, pex-clk2, pex-ctrl, sdmmc1, sdmmc3, spi, spi-hv,
	uart, usb-bias, usb0, usb1, usb2, usb3, sys, bb

Optional properties:
- nvidia,pad-name: Pad name if child node name is not used for pad name.
- nvidia,io-pad-init-voltage: Voltage value. Option will be
		IO_RAIL_VOLTAGE_1_8V, IO_RAIL_VOLTAGE_3_3V.
- nvidia,deep-power-down-enable: Boolean, Deep power down enable.
- nvidia,deep-power-down-disable: Boolean, deep power down disable.
- nvidia,io-pad-power-enable: boolean, enable io pad power i.e. deep power
		down disable.
- nvidia,io-pad-power-disable: boolean, disable io pad power i.e. deep
		power down enable.

	Property should be used for better readbility and not clnflict with
	other properties.

	pmc {
		::::
		io-pad-defaults {
			pex-clk1 {
				nvidia,deep-power-down-enable;
			};

			gpio {
				nvidia,io-pad-init-voltage = <IO_RAIL_VOLTAGE_1_8V>;
			};
			:::
		};
	};


Example: SDMMC1 pad is 6 and SDMMC3 is 7.

	tegra_pmc: pmc@7000e400 {
		compatible = "nvidia,tegra210-pmc";
		reg = <0x0 0x7000e400 0x0 0x400>;
		#padcontroller-cells = <1>;
		status = "disabled";
		io-pad-defaults {
			gpio {
				nvidia,io-pad-init-voltage = <IO_RAIL_VOLTAGE_1_8V>;
			};
			audio-hv {
				nvidia,io-pad-init-voltage = <IO_RAIL_VOLTAGE_3_3V>;
			};
		};
	};


	sdhci@700b0400 {
		compatible = "nvidia,tegra210-sdhci";
		::::
		pad-controllers = <&tegra_pmc TEGRA210_PAD_SDMMC3>;
		pad-names = "sdmmc";
		::::
	};
```

## Documentation/devicetree/bindings/padctrl/padctrl.txt
```
== Introduction ==

Hardware module which controls the pins voltages, routing etc are
designated as pad controllers. Each pad controller must be represented
as a node in device tree just like any other hardware module.

Hardware modules whose signals are affected by pad configuration are
designated client devices. Again, each client device must be represented
as a node in device tree, just like any other hardware module.

Specifying padcontrol information for devices
======================================

1) PadCtrl user nodes
---------------------

Padctrl users should specify a list of pad controllers that they want to use
with a property containing a "pad-controllers":

	pad-controllers ::= <single-padctrl> [padctrl-list]
	single-padctrl ::= <padctrl-phandle> <padctrl-specifier>
	padctrl-phandle : phandle to Pad controller node
	padctrl-specifier : array of #padctrl-cells specifying the given Pad
			(controller specific)

Pad properties should be named "pad-controllers". The exact meaning of
each padctrl property must be documented in the device tree binding
for each device.
An optional property "pad-names" may contain a list of strings to label
each of the padctrl devices listed in the "pad-controllers" property. If no
"pad-names" property is given, the name of the user node will be used as
fallback.

Drivers for devices that use more than a single padctrl device can use the
"pad-names" property to map the name of the padctrl device requested by the
padctrl_get() call to an index into the list given by the " pad-controllers"
property.

The following example could be used to describe a padctrl based client device:

	padctrl: padctrl {
		#padctrl-cells = <2>;
	};

	[...]

	sdmmc1 {
		padctrls = <&padctrl 12>;
		pad-names = "sdmmc";
	};

	sdmmc3 {
		padctrls = <&padctrl 13>;
		pad-names = "sdmmc";
	};

Note that in the example above, specifying the "pad-names" is for "sdmmc" pads.

padctrl-specifier typically encodes the chip-relative pad number.


2) Pad controller nodes
-----------------------

Pad controller nodes must specify the number of cells used for the
specifier using the '#padctrl-cells' property.

An example PWM controller might look like this:

	tegra_pmc: pmc@7000e400 {
		compatible = "nvidia,tegra210-pmc";
		#padcontroller-cells = <1>;
	};

Pad controller binding will tell the details of the option if
#padcontroller-cells are more than zero.
```

## Documentation/devicetree/bindings/pinctrl/nvidia,tegra186-dpaux-pinctrl.txt
```
Device tree binding for NVIDIA Tegra186 DPAUX PINCTL
====================================================

The Tegra186 DPAUX PINCTL driver manages the DPAUX muxing

This document defines the device-specific binding for the Tegra186 DPAUX PINCTL
driver. This driver models dpaux pins to be muxed as either in I2C or DISPLAY.

Refer to pinctrl-bindings.txt in this directory for generic information about
pin controller device tree bindings.

Required properties:
--------------------
- compatible: Must be "nvidia,tegra186-dpaux-pinctrl" or
		"nvidia,tegra186-dpaux1-pinctrl"
the dpaux node should be updated with the compatible string:
		"nvidia,tegra186-dpaux-padctl" or
		"nvidia,tegra186-dpaux1-padctl" respectively.

Optional Pinmux properties:
--------------------------
Following properties are required if default setting of pins are required
at boot.
- pinctrl-names: A pinctrl state named per <pinctrl-binding.txt>.
- pinctrl[0...n]: Properties to contain the phandle for pinctrl states per
		<pinctrl-binding.txt>.

The pin configurations are defined as child of the pinctrl states node. Each
sub-node have following properties:

Required properties:
------------------
- pins: List of pins. Valid values of pins properties are:
		dpaux1-1, dpaux-0

Valid values for function properties are: i2c, display

Child nodes contain the pinmux configurations following the conventions from
the pinctrl-bindings.txt document. Typically a single, static configuration is
given and applied at boot time.

Example:
========

Board file extract:
-------------------

	# DPAUX1 muxed to I2C mode
	host1x {
		...
		dpaux@15040000 {
		...
		compatible = "nvidia,tegra186-dpaux1-padctl";
		pinctrl-names = "default";
		pinctrl-0 = <&dpaux_default>;
		dpaux_default: pinmux@0 {
			dpaux1_pins {
				pins = "dpaux1-1";
				function = "i2c";
			};
		};
		...
	}
	...
	dpaux1 {
		compatible = "nvidia,tegra186-dpaux1-pinctrl";
		status = "okay";
	};
```

## Documentation/devicetree/bindings/pinctrl/nvidia,tegra186-padctl.txt
```
Device tree binding for NVIDIA Tegra186 XUSB PADCTL
========================================================

The Tegra186 XUSB PADCTL manages UTMI/HSIC/SuperSpeed USB 2.0/3.0 pads, each of
which can be configured with one out of HOST_ONLY/DEVICE_ONLY/OTG capabilities.

This document defines the device-specific binding for the Tegra186 PADCTL driver.
This driver models pads and lanes as phy instances with the generic phy
abstraction. Function drivers (XHCI/XUDC drivers) could retrieve its own
phy instance via devm_phy_get() call.

Refer to pinctrl-bindings.txt in this directory for generic information about
pin controller device tree bindings and ../phy/phy-bindings.txt for details on
how to describe and reference PHYs in device trees.

Required properties:
--------------------
- compatible: should be "nvidia,tegra186-padctl"
- reg: Physical base address and length of PADCTL.
- interrupts: IRQ number of PADCTL.
- #phy-cells: Should be 1. The specifier is the index of the PHY to reference.
  See <dt-bindings/pinctrl/pinctrl-tegra-padctl.h> for the list of valid values.
- mboxes: Must contain an entry for the XUSB mailbox channel.
  See ../mailbox/mailbox.txt for details.
- mbox-names: Must include the following entries:
  - xusb

Optional properties:
-------------------
- vbus-{0,1,2}-supply: VBUS regulator for the corresponding UTMI pad.
- vddio-hsic-supply: VDDIO regulator for the HSIC pads.

Lane muxing:
------------

Child nodes contain the pinmux configurations following the conventions from
the pinctrl-bindings.txt document. Typically a single, static configuration is
given and applied at boot time.

Each subnode describes groups of lanes along with parameters and pads that
they should be assigned to. The name of these subnodes is not important. All
subnodes should be parsed solely based on their content.

Each subnode only applies the parameters that are explicitly listed. In other
words, if a subnode that lists a function but no pin configuration parameters
implies no information about any pin configuration parameters. Similarly, a
subnode that describes only a parameter implies no information about what
function the pins are assigned to.

Required properties:
- nvidia,lanes: An array of strings. Each string is the name of a lane.

Optional properties:
- nvidia,function: A string that is the name of the function (pad) that the
  pin or group should be assigned to. Valid values for function names are
  listed below.
- nvidia,usb3-port: USB3 port (0/1/2) to which the lane is mapped.
- nvidia,port-cap: USB port capability.

Note that not all of these properties are valid for all lanes. Lanes can be
divided into four groups:

  - otg-0, otg-1, otg-2:

    Valid functions for this group are: "xusb", "uart", "rsvd".
    nvidia,port-cap property is required when the function is xusb.

  - hsic-0:

    Valid functions for this group are: "xusb", "rsvd".

  - usb3-0, usb3-1, usb3-2:

    Do not set function for this group.
    nvidia,port-cap is required.

Example:
========

SoC file extract:
-----------------

	pinctrl@0x03520000 {
		compatible = "nvidia,tegra186-padctl";
		reg = <0x0 0x03520000 0x0 0x1000>,
			<0x0 0x02500000 0x0 0xa0000>;
		interrupts = <0 167 0x4>;
		mboxes = <&xusb_mbox>;
		mbox-names = "xusb";

		#phy-cells = <1>;
	};

Board file extract:
-------------------

	# XUSB host mode takes UTMI pad#2 and SuperSpeed pad#2 for a USB 3.0 host port
	xhci@0x03530000 {
		...
		phys = 	<&board-padctl TEGRA_PADCTL_PHY_UTMI_P(2)>,
			<&board-padctl TEGRA_PADCTL_PHY_USB3_P(2)>,
		phy-names = "utmi-2", "usb3-2";

		...
	}

	...

	# XUSB device mode takes UTMI pad#0 and SuperSpeed pad#0 for a USB3.0 device port
	xudc@0x03550000 {
		...
		phys = 	<&board-padctl TEGRA_PADCTL_PHY_UTMI_P(0)>,
			<&board-padctl TEGRA_PADCTL_PHY_USB3_P(0)>,
		phy-names = "usb2", "usb3";

		...
	}

	board-padctl: pinctrl@0x03520000 {
		pinctrl-0 = <&pinctrl_default>;
		pinctrl-names = "default";

		vbus-2-supply = <&vdd_usb3_vbus>;

		pinctrl_default: pinmux {
			usb2-micro-AB {
				nvidia,lanes = "otg-0";
				nvidia,function = "xusb";
				nvidia,port-cap = <TEGRA_PADCTL_PORT_OTG_CAP>;
			};

			usb3-micro-AB {
				nvidia,lanes = "usb3-0";
				nvidia,port-cap = <TEGRA_PADCTL_PORT_OTG_CAP>;
			};

			usb2-std-A {
				nvidia,lanes = "otg-2";
				nvidia,function = "xusb";
				nvidia,port-cap = <TEGRA_PADCTL_PORT_HOST_ONLY>;
			};

			usb3-std-A {
				nvidia,lanes = "usb3-2";
				nvidia,port-cap = <TEGRA_PADCTL_PORT_HOST_ONLY>;
			};
		};
	};
```
