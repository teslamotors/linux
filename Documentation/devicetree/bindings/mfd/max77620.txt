## Documentation/devicetree/bindings/mtd/tegra-nor.txt
```
Tegra NOR

Required Properties
- compatible: "nvidia,tegra124-nor"
- reg: address range of tegra-nor block
- interrupts: irq to be used
- nvidia,timing-default - pair of uint32 values
- nvidia,timing-read = pair of uint32 values
- nvidia,nor-mux-mode = Mux mode to be used
- nvidia,nor-read-mode = Mode of operation for SYNC memories
	Aysnc mode = 0x0
	Page Mode  = 0x1
	Burst Mode = 0x2

- nvidia,nor-page-length - Number of words in page if page mode selected
	Unsupported = 0x0
	4 word page = 0x1
	8 word page = 0x2
	16 word page = 0x3

- nvidia,nor-ready-active - Device Ready Active status
	WithData = 0x0
	BeforeData = 0x1

- nvidia,flash-map-name - Name of the flash to be probed
- nvidia,flash-width - flash width
- nvidia,num-chips - Number of chip selects. These many number of
		     cs-info child nodes should be present.

- use-advanced-sector-protection - If present PPB protect enabled
- nvidia,cs - Chipselect number
- nvidia,num_cs_gpio - Non-zero if gpio used
- nvidia,gpio-cs - GPIO number
- nvidia,phy_addr - U64 Physical address
- nvidia,phy_size - Size

- nvidia,gmi_wait_pin - Name of gmi_wait_pin specific to platform

Example:

	snor {
		reg = <0x0 0x70009000 0x0 0x1000>,
		      <0x0 0x48000000 0x0 0x04000000>;
		nvidia,timing-default = <0x30300273>, <0x00030302>;
		nvidia,timing-read = <0x30300273>, <0x00030302>;
		nvidia,nor-mux-mode = <0x0>;
		nvidia,nor-read-mode = <0x1>;
		nvidia,nor-page-length = <0x2>;
		nvidia,nor-ready-active = <0x0>;
		nvidia,flash-map-name = "cfi_probe";
		nvidia,flash-width = <0x2>;
		nvidia,num-chips = <0x1>;
		use-advanced-sector-protection;
		status = "okay";
		cs-info@0 {
			nvidia,cs = <0x0>;
			nvidia,num_cs_gpio = <0x0>;
			nvidia,phy_addr = <0x0 0x48000000>;
			nvidia,phy_size = <0x04000000>;
		};

	};
```

## Documentation/devicetree/bindings/net/can/m_ttcan.txt
```
Bosch MTTCAN controller Device Tree Bindings
-------------------------------------------------

Required properties:
- compatible		: Should be "bosch,mttcan" for M_TTCAN controllers
- reg			: physical base address and size of the M_TTCAN
			  registers map, glue logic register maps and
			  Message RAM
- reg-names		: Should be "can-regs", "glue-regs" and "msg_ram"
- interrupts		: Should be the interrupt number of M_TTCAN interrupt,
			  line 0 and line 1 can have different interrupts.
- clocks		: Clocks used by controller, should be CAN clock,
			  CAN host clock and parent PLL.
- clock-names		: Should contain "can", "can_host" and parent PLL.
- pll_source	 	: Names corresponding parent PLL
- resets		: reset number corresponding to controller reset line.
- reset-names		: Name corresponding to controller reset line.
- gpio_can_stb		: GPIO number and active level to program PHY chip
- gpio_can_en		: GPIO number and active level to enable PHY chip
- mram-params		: Message RAM configuration data.
			  Multiple M_TTCAN controller instance can share same
			  Message RAM. Location and number of elements per
			  category are configurable. Care should be taken while
			  configuring Message RAM as the memory overlap is not
			  detected and result are unpredictable behaviour.

			  The format should be as follows:
			  <offset num_sidf_elems num_xidf_elems num_rxf0_elems
			  num_rxf1_elems num_rxb_elems num_txe_elems
			  num_txb_elems num_tmc_elems>
			  The 'offset' is an address offset of the Message RAM
			  where the following elements start from.

			  M_TTCAN includes the following elements according to
			  user manual:
			  11-bit Filter	 0-128 elements / 0-128 words
			  29-bit Filter	 0-64 elements / 0-128 words
			  Rx FIFO 0	 0-64 elements / 0-1152 words
			  Rx FIFO 1	 0-64 elements / 0-1152 words
			  Rx Buffers	 0-64 elements / 0-1152 words
			  Tx Event FIFO	 0-32 elements / 0-64 words
			  Tx Buffers	 0-32 elements / 0-576 words
			  Trigger Memory 0-64 elements / 0-128 words

			  Please refer to 2.4.1 Message RAM Configuration in
			  Bosch M_TTCAN user manual for details.
- tx-config		: Tx Buffer region configuration. Tx Buffers can be
			  in sub configured as Tx Buffers, Tx Queue and TxFIFO.
			  Valid configuration are
			  * Tx Buffers + Tx Queue
			  * Tx Buffers + Tx FIFO

			  The format should be as follows
			  <num_tx_buf, num_txq, q_mode, tx_max_data_size>
			  'num_tx_buf' is number of elements configures as
			  buffers. 'num_txq' is number of elements which are
			  configured in Queue/FIFO. 'q_mode' to 1 select mode
			  as queue, 0 to select FIFO mode. 'tx_max_data_size'
			  is max payload of a message. M_TTCAN support 64 bytes
			  max payload. 'tx_max_data_size' is used optimize
			  Message RAM usage.
- rx-config		: Size of Rx elements max payload.
			  The format should be as follow
			  <rx_buf_payload, rx_fifo0_payload, rx_fif1_payload>

Example:
SoC dtsi:
mttcan0: mttcan@c310000 {
	compatible = "bosch,mttcan";
	reg    = <0x00 0x0c310000 0x00 0x400>,
		<0x00 0x0c311000 0x00 0x32>,
		<0x00 0x0c312000 0x00 0x1000>;
	reg-names = "can-regs", "glue-regs", "msg-ram";
	interrupts = <0 40 0x04 >;
	pll_source = "pllaon";
	clocks = <&tegra_car TEGRA186_CLK_CAN1>,
		<&tegra_car TEGRA186_CLK_CAN1_HOST>,
		<&tegra_car TEGRA186_CLK_PLLAON>;
	clock-names = "can","can_host","pllaon";
	resets = <&tegra_car TEGRA186_RESET_CAN1>;
	reset-names = "can";
	status = "disabled";
};

Board dts:
mttcan@c310000 {
	gpio_can_stb = <&tegra_gpio TEGRA_GPIO(AA, 0) GPIO_ACTIVE_HIGH>;
	gpio_can_en = <&tegra_gpio TEGRA_GPIO(AA, 1) GPIO_ACTIVE_HIGH>;
	mram-params = <0 16 16 8 8 8 16 16 16>;
	tx-config = <8 8 0 64>;
	rx-config = <64 64 64>;
	status = "okay";
};
```

## Documentation/devicetree/bindings/net/tegra_hv-net.txt
```
* Tegra Hypervisor Network emulation

Required properties:
- compatible: Should be "nvidia,tegra-hv-net"
- ivc: Should contain a tupple containing a reference to the tegra hypervisor
  node and an index of the IVC channel to use

Optional properties:
- mac-address: The MAC address to assign, if not available uses a random one.
- high-watermark-mult: High watermark multiplication factor for netif queue control.
  default is 50. The network queue will be stopped when the number of queued skbs
  reaches the 'high-watermark-mult' * 'the capacity in frames' is reached.
  Note this is set at a very high limit for good throughput.
- low-watermark-mult: Low watermark multiplication factor for netif queue control.
  default is 25. When the network queue is stopped and the amount of queued skbs
  falls below the 'low-watermark-mult' * 'the capacity in frames' level the network
  queue will be started. Note that high-watermark-mult must be higher than the
  low-watermark-mult value.
- max-tx-delay-msecs: The maximum timeout value for transmits (in milliseconds.)
  Any packet part of a send request that exceeds this value will be dropped.

Example:
	tegra_hv_net {
		compatible = "nvidia,tegra-hv-net";
		status = "okay";
		ivc = <&tegra_hv 2>;
	};
```

## Documentation/devicetree/bindings/net/wireless/bcmdhd/bcmdhd-wlan.txt
```
* bcmdhd-wlan devicetree bindings

This file documents the properties used by the bcmdhd-wlan driver.

Required properties:
- compatible : Must be "android,tegra-bcmdhd-wlan"

Optional properties:
- "wlan-pwr-gpio" is a gpio to power on/off wifi chip
- "wlan-rst-gpio" is a gpio to reset wifi chip
- "interrupts" is a wake on wireless gpio interrupt pin
- "edp-consumer-name" is required to populate wifi edp consumer name

MAC address properties (using the of_get_mac_address() function,
checked in this order):
- 'mac-address' is the "most recent" MAC address (6 octet binary property)
- 'local-mac-address' is the default MAC address (6 octet binary property)
- 'address' is supposed to contain a virtual address of the register set, but
  some DTS files have redefined this property to be the MAC address
  (6 octet binary property)
- 'mac-address-chosen-dtb-node' is the property name of a string property under
  the /chosen dtb node which contains the MAC address string
  "xx:xx:xx:xx:xx:xx"
- 'mac-address-file' is a string property which contains the path of a file
  which contains the MAC address string "xx:xx:xx:xx:xx:xx"

Example:
bcmdhd_wlan {
	compatible = "android,tegra-bcmdhd-wlan";
	interrupt-parent = <&gpio>;
	interrupts = <165 0x14>;
	wlan-pwr-gpio = <&gpio TEGRA_GPIO(X, 7) 0>;
	wlan-rst-gpio = <&gpio TEGRA_GPIO(CC, 5) 0>;
	edp-consumer-name = "primary-wifi";
	/* possible methods of specifying MAC address
	 * (in first to last order)
	 */
	mac-address = [00 04 4b fe ed be];
	local-mac-address = [00 04 4b fe ed bf];
	/* the next method requires the /chosen dtb node to have a string
	 * property named "nvidia,wifi-mac" which contains the MAC address
	 * string "xx:xx:xx:xx:xx:xx"
	 */
	mac-address-chosen-dtb-node = "nvidia,wifi-mac";
	/* the next method requires the filesystem file
	 * /mnt/factory/wifi/wifi_mac.txt to contain the MAC address string
	 * "xx:xx:xx:xx:xx:xx"
	 */
	mac-address-file = "/mnt/factory/wifi/wifi_mac.txt";
};
===============================================================================
* bcmdhd2-wlan devicetree bindings

This file documents the properties used by the bcmdhd2-wlan driver.

Required properties:
- compatible : Must be "nvidia,tegra-bcmdhd2-wlan"

Optional properties:
- "wlan-pwr-gpio" is a gpio to power on/off wifi chip
- "wlan-rst-gpio" is a gpio to reset wifi chip
- "interrupts" is a wake on wireless gpio interrupt pin
- "edp-consumer-name" is required to populate wifi edp consumer name

MAC address properties (using the of_get_mac_address() function):
- the bcmdhd2 2nd driver instance is no longer used, so new features
  (such as using the of_get_mac_address() function to get the MAC address)
  have not been ported to bcmdhd2 driver

Example:
bcm4329_wlan2_ {
	compatible = "nvidia,tegra-bcmdhd2-wlan";
	interrupt-parent = <&gpio>;
	interrupts = <165 0x14>;
	wlan-pwr-gpio = <&gpio TEGRA_GPIO(X, 7) 0>;
	wlan-rst-gpio = <&gpio TEGRA_GPIO(CC, 5) 0>;
	edp-consumer-name = "secondary-wifi";
};
```

## Documentation/devicetree/bindings/nvidia,fiq-debugger.txt
```
NVIDIA FIQ debugger for Tegra

Required properties:
- compatible: this driver is compatible with "nvidia,fiq-debugger"

Optional properties:
- use-console-port: the driver will search for serial port with property
		"console-port" to attach the debugger's console
- use-wdt-irq: the driver will use watchdog's IRQ as a FIQ source
- interrupts: interrupt can be specified explicitly
- reg: the uart register space can be specified explicitly

Example:
	tegra_fiq_debugger {
		compatible = "nvidia,fiq-debugger";
		use-console-port;
		interrupts = <0 123 0x4>; /* or, alternatively, use-wdt-irq; */
	};
```

## Documentation/devicetree/bindings/nvidia,tegra-xhci.txt
```
Tegra SOC XUSB controllers

The device node for a USB controller that is part of a Tegra
SOC is as described below:

Required properties :
XHCI:
 - compatible : Should be "nvidia,tegraxxx-xhci" where xxx represents chipid
   supported so far are 114,124,132,210
 - nvidia,portmap : List of all ports (2.0/3.0) available for XUSB controller
   Each bit represents port and bit is set for ports controlled by XUSB.
   If a port is also OTG port (assigned in otg_portmap), it is necessary to
   clear the corresponding bit here for host driver to check ownership
   runtime and program port capability correctly.
   0-7 bits represent USB3.0 ports with Port 0 on LSB.
   8-15 bits represent USB2.0 ports with Port 0 on bit 8.
   16-23 bits represent HSIC ports with Port 0 on bit 16.
   Ex: <0x0e02> represents following ports are enabled
   USB3.0 Port1 & USB2.0 Port 1,2,3.
 - nvidia,common_padctl : reference to pad control dt which has details
   about port mapping. Padctl is also used by xudc driver.
 - nvidia,hsic_power_on_at_boot: Specify all HSIC ports that needs to be
   powered up at boot time.
PADCTL:
 - nvidia,ss_ports : tuples mapping ss_ports, usb2_ports, ss lanes, otg property.
   Tuples to be filled in following format
   < ss_port_num usb2_port_num lane_num is_otg >
   Add as many ss ports as that are supported on the board.
   Refer to dt-bindings/usb/tegra_xhci.h for fillings the ss_ports
   property.
   - ss_port_num
     TEGRA_XHCI_SS_Px should be used to represent a ss port, where x denotes
     port num (0, 1, 2, 3)
   - usb2_port_num
     TEGRA_XHCI_USB2_Px should be used to represent a usb2 port, where x denotes
     port num (0, 1, 2, 3)
     if a ss port does not have matching usb2_port, use TEGRA_XHCI_UNUSED_PORT
     to mark unused port.
   - lane_num
     TEGRA_XHCI_LANE_x should be used to represent a ss lanes, where x denotes
     lane number.
     if a ss_port does not have matching lane, use TEGRA_XHCI_UNUSED_LANE
     to mark unused. This will remove superspeed capability for that port.
   - is_otg
     Use TEGRA_XHCI_PORT_OTG if port is a otg port or
     TEGRA_XHCI_PORT_STD to indicate standard A host port.

   Example:
   nvidia, ss_ports = < TEGRA_XHCI_SS_P0 TEGRA_XHCI_USB2_P3 TEGRA_XCHI_LANE_0 TEGRA_XHCI_PORT_STD
			TEGRA_XHCI_SS_P1 TEGRA_XHCI_USB2_P2 TEGRA_XHCI_UNUSED_LANE TEGRA_XHCI_PORT_OTG
			TEGRA_XHCI_SS_P2 TEGRA_XHCI_UNUSED_PORT TEGRA_XHCI_UNUSED_LANE TEGRA_XHCI_PORT_STD
			TEGRA_XHCI_SS_P3 TEGRA_XHCI_UNUSED_PORT TEGRA_XHCI_UNUSED_LANE TEGRA_XHCI_PORT_STD>;

   This DT property indicates that
   1. Connector 1 has SS_P0 mapped to USB2_P3 and using Lane 0 and it is a STD-A port.
   2. Connector 2 has SS_P1 mapped to USB2_P2 but LANE is un used, which means this port looses the
      ss-capability and works in hs-mode only and it is a otg-port.
   3. Connector 3 has unmapped USB2 port which means that the SS port is disabled, same for Connector 4.
   4. If an SS port does not have a mapped USB2 port then we can ignore the reset of the properties for
      that port.

Optional properties:
  - nvidia,gpio_controls_muxed_ss_lanes : SATA lane on some boards is muxed
    between SATA and XUSB. This property indicates if SATA lane is muxed and
    controlled by gpio or is it dedicated to XUSB. Assumed no gpio is present
    if this property is not defined.
  - nvidia,gpio_ss1_sata : reference to gpio that controls SATA lane muxed
    between XUSB & SATA. Only valid if above property is set. XUSB will be
    selected by setting this gpio to 1 in the driver.
  - utmi_padX : X can take number of USB2.0 ports on device.
    Ex: utmi_pad0, utmi_pad3
    provides details about vbus type used and ref to enable pin
    Over current detection is possible if vbus is controlled by XUSB.
    If not defined, vbus is assumed to be fixed and controlled by regulator
    framework. It contains 2 sub nodes.
    - nvidia,vbus_en_type : vbus source for XUSB ports. Possible values
      are 0-2 explained below. Defaults to zero when not defined.
      0 = VBUS enabled by GPIO, without PADCTL OC detection
        vbus is controlled by gpio and owned by regulator framework.
	XUSB padctl over current detection is disabled.
      1 = VBUS enabled by GPIO, with PADCTL OC detection
        vbus is controlled by gpio and owned by regulator framework.
	XUSB padctl over current detection is enabled
      2 = VBUS enabled by XUSB PADCTL with OC detection
        vbus is controlled by XUSB driver using VBUS_EN pins.
	XUSB padctl overcurrent detection is disabled.
    - nvidia,vbus_en_pin : If vbus is controlled by XUSB, enable pin for
      controlling vbus.
```
