## Documentation/devicetree/bindings/misc/bluedroid_pm.txt
```
This driver is implemented to actively manage the bluetooth radio power and
control wake interface from bluetooth radio to host processor.
Two interfaces are used to manage bluetooth radio power

RFKILL: This interface is used to toggle rfkill switches which are controlled
by gpios and voltage regulators. This interface is created only when
bluetooth radio requires one of rfkill switches [GPIO/ Voltage regulators]
Driver assumes vdd_bt_3v3 as consumer name for 3V regulator and
vddio_bt_1v8 as consumer name for 1.8V regulator

PROCFS: Using procfs interface, driver controls BT chip ext_wake GPIO to
enable/disable BT chip LPM. This interface is created only when bluetooth
module supports LPM mode control using GPIO

This driver assumes platform data is passed from the board files to configure
IO parameters needed to control bluetooth radio.

Required Properties:
- compatible: Must be  "nvidia,tegra-bluedroid_pm";

Optional Properties:
- "bluedoird_pm,shoutdown-gpio" is resource name to register radio's Enable/Shutdown gpio
- "bluedoird_pm,reset-gpio" is resource name to regster radio's reset gpio
    One of above is mandatory requirement for registering rfkill interface.

- "bluedoird_pm,ext-wake-gpio" is resource name to register radio's ext_wake gpio
- "bluedoird_pm,host-wake-gpio" is resource name to register host wake gpio

Example:
bluedroid_pm {
	compatible = "nvidia,tegra-bluedroid_pm";
	id = <0>;
	bluedoird_pm,reset-gpio = <&gpio TEGRA_GPIO(X, 1) 0>;
	bluedoird_pm,host-wake-gpio = <&gpio TEGRA_GPIO(U, 6) 0>;
	bluedoird_pm,ext-wake-gpio = <&gpio TEGRA_GPIO(EE, 1) 0>;
	interrupt-parent = <&gpio>;
	interrupts = <166 0x01>;
};
```

## Documentation/devicetree/bindings/misc/gps_wake.txt
```
This driver is implemented to parse the gps_en gpio from device tree
and create a sysfs to control the gpio in gpsd binary. Also it
registers a irq to enable the HW geofencing feature.

SYSFS: This interface is used to toggle gps_en gpio in userspace.

Required Properties:
- compatible: Must be "nvidia,tegra-gps-wake";

Optional Properties:
- gps-en is resource name for gps_en gpio
- gps-host-wake is resource name for host wake irq line

Example:
gps_wake {
	compatible = "nvidia,tegra-gps-wake";
	id = <0>;
	gps-en = <&gpio_i2c_1_20 10 0>;
	gps-host-wake = <&gpio TEGRA_GPIO(Q, 5) 0>;
	interrupt-parent = <&gpio>;
	interrupts = <TEGRA_GPIO(Q, 5) 0x01>;
	status = "disabled";
};
```

## Documentation/devicetree/bindings/misc/palmas-ldousb-in.txt
```
Dynamic ldousb input selection based on input voltage

Required Properties:
- compatible: Must be "ti,palmas-ldousb-in"
- ti,ldousb-in-threshold-voltage: Threshold voltage on input to change
               inputs i.e. IN1 or IN2. The unit is uV.
- ti,enable-in1-above-threshold: Boolean type. Enable IN1 above threshold.
               If this property is not available then enable IN2 on aboe
               threshold.
- ti,threshold-voltage-tolerance: Switch to above threshold input if the input
               voltage is beyond threshold + tolerance. The unit is uV.
- ldousb-in1-supply: IN1 regualtor supply.
- ldousb-in2-supply: IN2 regulator supply.

Example:
palmas_ldousb_in {
	compatible = "ti,palmas-ldousb-in";
	ti,ldousb-in-threshold-voltage = <3500000>;
	ti,threshold-voltage-tolerance = <200000>;
	ti,enable-in1-above-threshold;
	ldousb-in1-supply = <&palmas_smps10_out2>;
	ldousb_in2-supply = <&vdd_ac_bat_reg>;
};
```

## Documentation/devicetree/bindings/misc/tegra-fuse.txt
```
NVIDIA tegra efuse driver interface.

Required properties:
-compatible: the driver is compatible with
	"nvidia, tegra114-efuse"
	"nvidia, tegra124-efuse"
-reg: Should contain tegra-fuse registers location and length.

Example:

	efuse@7000f800 {
		compatible = "nvidia,tegra114-efuse";
		reg = <0x7000f800 0x400>;
	};
```

## Documentation/devicetree/bindings/misc/tegra_usb_modem_power.txt
```
Modem Power Management Driver
-----------------------------------------------------------------------------
This driver is nvidia's Icera modem power management driver. Current actively
supported modem is Bruce. The driver controls modem power through GPIO and
supports 3 different PHY interface since T210: EHCI HSIC, XHCI HSIC, and XHCI
UTMI.

This driver uses device tree to pass all necessary platform data now.

Required properties:
--------------------
- compatible: should be "nvidia,icera-i500" for now.
- nvidia,boot-gpio: input GPIO for modem COLDBOOT signal.
- nvidia,mdm-en-gpio: output GPIO for enabling modem.
- nvidia,reset-gpio: output GPIO for hard resetting modem.
- nvidia,phy-ehci-hsic:
- nvidia,phy-xhci-hsic:
- nvidia,phy-xhci-utmi:
			modem interface child nodes, these child nodes are
			default disabled, shim will enable corresponding node
			based on the uuid passed when flashing.

Optional properties:
-------------------
- nvidia,regulator: support for platform which may need to enable regulator
		    manually.
- nvidia,wake-gpio: input GPIO. Define this GPIO if remote wakeup is through
                    GPIO, or remote wakeup is supported natively.
- nvidia,mdm-power-report-gpio: input GPIO for modem power report.
- nvidia,pre-boost-gpio: output GPIO for modem to control pre boost regulator.
                         IN USE FOR T210 LOKI ONLY (P2530 E03 mother board only)
- nvidia,num-temp-sensors: integer which specifies temperature sensor count for
                    modem thermal reporting.
- nvidia,phy-type: integer 0, 1, or 2, which stand for EHCI HSIC, XHCI HSIC,
                    or XHCI UTMI. This property is replaced by modem interface
                    child nodes nvidia,phy-*hci-* mentioned above since T210.
                    The reason this property still being kept here is for
                    T124 & T132 backward compatible. Therefore, this property
                    has higher priority than nvidia,phy-*hci-* child nodes.

Example:

With all properties defined:

    modem {
        compatible = "nvidia,icera-i500";

        /* regulator */
        nvidia,regulator = "vdd_wwan_mdm";

        /* GPIO */
        nvidia,wake-gpio = ...;
        nvidia,boot-gpio = <&gpio TEGRA_GPIO(K, 6) GPIO_ACTIVE_LOW>;
        nvidia,mdm-power-report-gpio = ...;
        nvidia,reset-gpio = ...;
        nvidia,mdm-en-gpio = ...;
        nvidia,pre-boost-gpio = ...;

        /* temp sensors count */
        nvidia,num-temp-sensors = <3>;

        /* should be disabled by default. Bootloader will determine if this
           node will be enabled according to TNSPEC. */
        status = "disabled";

        /* modem interface child nodes */
        nvidia,phy-ehci-hsic {
            status = "disabled";
        };

        nvidia,phy-xhci-hsic {
            status = "disabled";
        };

        nvidia,phy-xhci-utmi {
            status = "disabled";
        };
    };


Example node for a T210 ERS board (E2220):

    modem {
        compatible = "nvidia,icera-i500";
        nvidia,boot-gpio = <&gpio TEGRA_GPIO(K, 6) GPIO_ACTIVE_LOW>;
        nvidia,mdm-power-report-gpio = <&gpio TEGRA_GPIO(L, 1) GPIO_ACTIVE_LOW>;
        nvidia,reset-gpio = <&gpio TEGRA_GPIO(L, 0) GPIO_ACTIVE_LOW>;
        nvidia,mdm-en-gpio = <&gpio TEGRA_GPIO(K, 7) GPIO_ACTIVE_HIGH>;
        nvidia,num-temp-sensors = <3>;
        status = "disabled";
    };
```

## Documentation/devicetree/bindings/misc/therm_est.txt
```
Thermal estimator driver.

Properties :
 - compatible : Should contain "nvidia,therm-est".
 - polling-period : Polling wait times for thermal estimation, in milliseconds.
 - tc1 : Coefficient 1 for thermal trend calculation.
 - tc2 : Coefficient 2 for thermal trend calculation.
 - node for subdev : Node for subdevice information. Required.

Properties in subdev node : Required.
 - subdev_names : list of strings. It contains list of the name of the therm
		zones used for estimation.
 - node for coeff_set : contains a set of zone specific coefficients+offset.
			This node can be numerous.

Properties in coeff_set : Required. Can be numerous.
 - toffset : Temperature offset for thermal estimation, in milli-celsius.
 - coeffs : An array of coefficients, the number of entries should be twenty
	per sub device.

Example:

	therm_est_sensor {
		device_type = "therm-est-subdev";
		polling-period = <1100>;
		tc1 = <10>;
		tc2 = <1>;
		subdev {
			subdev_names = "Tdiode_tegra", "Tboard_tegra";

			coeff_set@0 {
				toffset = <9793>;
				coeffs = <
					2 1 1 1 1 1 1 1 1 1 1 0 1 1 0 0 0 0 (-1) (-7)
					(-11) (-7) (-5) (-3) (-3) (-2) (-1) 0 0 0 1 1 1 2 2 3 4 6 11 18
				>;
			};

			coeff_set@1 {
				toffset = <708>;
				coeffs = <
					-1 -1 1 1 1 1 1 1 1 1 1 0 1 1 0 0 0 (-1) (-3) (-9)
					(-6) (-4) (-1) 0 0 0 0 0 0 0 1 1 1 2 2 5 7 10 17 20
				>;
			};
		};
	};
```

## Documentation/devicetree/bindings/mmc/sdhci-tegra.txt
```
* Nvidia sdhci-tegra controller

This file documents differences between the core properties in mmc.txt
and the properties used by the sdhci-tegra driver.

Required properties:
- compatible: Should be "nvidia,tegra186-sdhci"
- reg: Specify start address and registers count details
- interrupts: Specify the interrupts IRQ info for device

Optional properties:
- tap-delay: Specify number of cycles to delay for reading data from device
- nvidia,ddr-tap-delay: Specify number of cycles to delay for reading data from device in ddr mode.
- trim-delay: Specify number of cycles to delay for writing data to device
- ddr-trim-delay: Specify number of cycles to delay for writing data to device when in DDR mode
- dqs-trim-delay: HS400 Tap value for incoming DQS path trimmer.
- dqs-trim-delay-hs533: HS533 Tap value for incoming DQS path trimmer.
- max-clk-limit: Specify the maximum clock limit for the device
- ddr-clk-limit: Specify the maximum clock frequency in kHz for device in DDR mode
- mmc-ocr-mask: Specify OCR register masking details. Based on this value the power up voltage depending on board capabilities can be selected.
- uhs-mask: Specify modes that are masked for the device
	Mask HS200 mode: 0x20
	Mask HS400 mode: 0x40
	Mask SDR104 mode: 0x10
	Mask SDR50 mode: 0x4
	Mask DDR50 mode: 0x8
- calib-3v3-offsets and calib-1v8-offsets: Specify caliberation settings at 3.3V and at 1.8V
- compad-vref-3v3 and compad-vref-1v8: used to control Vref_sel input of calibration pad. Should be set based on pads used for controller before starting pad drive strength calibration.
- power-gpios: details of GPIO port used to power up SDIO card
- default-drv-type: Drive strength to select for SDIO devices is encoded as 8-bit char as follows
	Drive strength Type B: 0x0
	Drive strength Type A: 0x1
	Drive strength Type C: 0x2
	Drive strength Type D: 0x3
- nvidia,update-pinctrl-settings: Specify desired pin control settings if different from default pin control settings done during init.
- pwr-off-during-lp0: Some devices like SDIO devices may use this to select power off mode when in LP0 or deep sleep or SC7 state.

- power-off-rail: flag when set enables sdmmc reboot notifier
- nvidia,dll-calib-needed: DLL calibration is needed for SDMMC4 and SDMMC2 devices if they are enumerated
- pwrdet-support: flag when set indicates the sdmmc controller instance needs power detect bit programming for voltage switching.
in HS400 mode.
- nvidia,disable-auto-cal: This flag when set will disable auto calibration
- nvidia,en-io-trim-volt: Enable IO trimmer voltage
- nvidia,is-emmc: Enable this flag for eMMC devices
- nvidia,sd-device: Enable this flag for SD devices
- nvidia,limit-vddio-max-volt: enable this flag for sdmmc1/3 if it has Vddio 3.3v support.
- nvidia,enable-hs533-mode: Set this Flag toenable HS533 mode.
	---> eMMC card does not advertise HS533 mode support in device registers.
	---> This flag has to be enabled only if the card supports HS533 mode, other wise the consequences are un-known.(Errors will be seen)
- fixed-clock-freq: The first element is for ID mode. The rest of the entries are for different modes indexed as per ios timings.
	ID MODE			0
	MMC_TIMING_LEGACY	1
	MMC_TIMING_MMC_HS	2
	MMC_TIMING_SD_HS	3
	MMC_TIMING_UHS_SDR12	4
	MMC_TIMING_UHS_SDR25	5
	MMC_TIMING_UHS_SDR50	6
	MMC_TIMING_UHS_SDR104	7
	MMC_TIMING_UHS_DDR50	8
	MMC_TIMING_MMC_HS200	9
	MMC_TIMING_MMC_HS400	10
- nvidia,auto-cal-slew-override: flag to set AUTO_CAL_SLW_OVERRIDE bit in SDMMC_AUTO_CAL_CONFIG_0 register.
- nvidia,enable-cq: Set this flag to enable CQ.
- nvidia,enable-hwcq: Enable this flag to select hardware CQ support available on selected Tegra chips.

- nvidia,enable-strobe-mode: Enable enhance strobe mode when eMMC device runs at HS400 mode.
- nvidia,en-periodic-calib: Enable periodic calibration support for sdmmc1/sdmmc3. Auto calibration sequence will be run at interval of 100ms during sdmmc1/sdmmc3 interfaces are active.
- nvidia,adma3-enable: boolean property to enable ADMA3 for the sdhci controller instance if supported by the Tegra chip.
- nvidia,en-32bit-bc: Enables 32 bit block count support on sdhci controller, if HW supports.

- nvidia,en-periodic-cflush: Enables periodic cache flush for sdmmc device to improve performance. This check is not required for
 SD and SDIO devices since they do not have volatile cache memory. So, set it only for eMMC device when required.
- nvidia,periodic-cflush-to: Sets the periodic cache flush timeout value.

Example:

	sdhci@3460000 {
		compatible = "nvidia,tegra186-sdhci";
		reg = <0x0 0x3460000 0x0 0x210>;
		interrupts = < 0 65 0x04>;
		max-clk-limit = <200000000>;
                ddr-clk-limit = <48000000>;
		tap-delay = <9>;
		nvidia,ddr-tap-delay = <9>;
		trim-delay = <5>;
		ddr-trim-delay = <5>;
		dqs-trim-delay = <63>;
		dqs-trim-delay-hs533 = <40>;
		mmc-ocr-mask = <0>;
		uhs-mask = <0x60>;
		calib-3v3-offsets = <0x0505>;
		calib-1v8-offsets = <0x0505>;
		compad-vref-3v3 = <0x7>;
		compad-vref-1v8 = <0x7>;
		nvidia,enable-hs533-mode;
		nvidia,limit-vddio-max-volt;
		nvidia,en-io-trim-volt;
		nvidia,disable-auto-cal;
		pwrdet-support;
		nvidia,dll-calib-needed;
		pwr-off-during-lp0;

		nvidia,enable-strobe-mode;
		nvidia,en-periodic-calib;
		nvidia,enable-cq;
		nvidia,enable-hwcq;
		nvidia,is-emmc;
		nvidia,auto-cal-slew-override;
		nvidia,update-pinctrl-settings;
		pinctrl-names = "sdmmc_schmitt_enable", "sdmmc_schmitt_disable", "sdmmc_clk_schmitt_enable", "sdmmc_clk_schmitt_disable";
		pinctrl-0 = <&sdmmc3_schmitt_enable_state>;
		pinctrl-1 = <&sdmmc3_schmitt_disable_state>;
		pinctrl-2 = <&sdmmc3_clk_schmitt_enable_state>;
		pinctrl-3 = <&sdmmc3_clk_schmitt_disable_state>;
		pll_source = "pll_p", "pll_c4_out2";
		resets = <&tegra_car TEGRA186_RESET_SDMMC4>;
		reset-names = "sdmmc";
		clocks = <&tegra_car TEGRA186_CLK_SDMMC4>,
		       <&tegra_car TEGRA186_CLK_PLLP_GRTTA>,
		       <&tegra_car TEGRA186_CLK_PLLC4_OUT2>;
		clock-names = "sdmmc4", "pll_p", "pll_c4_out2";
		nvidia,clk-name = "sdmmc4";
		fixed-clock-freq = <25500000 25500000 24000000 47000000 24000000 47000000 94000000 204000000 0 0 0>;
	};

	sdhci@3420000 {
		compatible = "nvidia,tegra186-sdhci";
		reg = <0x0 0x3460000 0x0 0x210>;
		interrupts = < 0 65 0x04>;
		power-off-rail;
		cd-gpios = <&tegra_gpio TEGRA_GPIO(P, 5) 0>;
		power-gpios = <180>;
		default-drv-type = <1>;
		nvidia,clk-name = "sdmmc2";
		nvidia,adma3-enable;
		nvidia,sd-device;
	};
```
