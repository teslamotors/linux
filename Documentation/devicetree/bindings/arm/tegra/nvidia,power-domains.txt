## Documentation/devicetree/bindings/extcon/extcon-gpio-states.txt
```
EXTCON FOR GPIO-STATES

Required Properties:
 - compatible : Should be "extcon-gpio-states";

Optional Properties:
 - extcon-gpio,name: Name of extcon device.
 - gpios: List of teh gpios.
 - extcon-gpio,irq-flags: IRQ flags for GPIO.
 - extcon-gpio,debounce: Debounce time in ms.
 - extcon-gpio,wait-for-gpio-scan: Wait timeout for scanning all gpio states
	after chnage found in gpio and debounce timeof gpio is completed.
 - extcon-gpio,out-cable-names: Output cable names.
 - extcon-gpio,cable-states: GPIO states and ther corresponding output cable
	state. This is array of the data for table as
		gpio-state <-> output cable-state
- cable-connected-on-boot: Cable connected on boot. It should be cable index
	in the output cable names. The number start from 0. Absence of this
	property will be assume as there is no cable connected. This property
	will be valid if there is no gpios provided for cable states.
- wakeup-source: Boolean, device can wake-up the system.


This driver also supports the extcon interface for different cable without
gpios. On this case, if property cable-connected-on-boot provided then
it will be consider this as the default cable otherwise it will assume
that there is no cable connected. Later on, through extcon sysfs, the
state can be chnaged.

extcon-gpio {
	compatible = "extcon-gpio-states";
       	gpio = <&gpio 20 0 &gpio 30 0>;
	extcon-gpio,cable-states = <0x00 0x00
				    0x01 0x01
				    0x02 0x02
				    0x03 0x4>;
	extcon-gpio,out-cable-names = "vbus", "host", "otg-y-cable";
};
```

## Documentation/devicetree/bindings/extcon/extcon-gpio.txt
```
EXTCON FOR GPIO

Required Properties:
 - compatible : Should be "extcon-gpio";

Optional Properties:
 - extcon-gpio,name: Name of extcon device.
 - extcon-gpio,irq-flags: IRQ flags for GPIO.
 - extcon-gpio,debounce: Debounce time in ms.
 - extcon-gpio,connection-state-low: boolean, Connection state with
		gpio state. True if gpio low means connected.
 - extcon-gpio,default-connected: Tells whether the connection is
		default there or not when gpio is not provided.

extcon-gpio {
	compatible = "extcon-gpio";
       	gpio = <&gpio, 20, 0>;
};
```

## Documentation/devicetree/bindings/firmware/nvidia,tegra210-bpmp.txt
```
NVIDIA BPMP data

Required properties:
- compatible: "nvidia,tegra210-bpmp"
- carveout-start: Starting physical address of the BPMP carveout area (DRAM
  area associated with bpmp firmware)
- carveout-size: Size of the BPMP carveout area

Example:
	bpmp {
		compatible = "nvidia,tegra210-bpmp";
		carveout-start = <0x80005000>;
		carveout-size = <0x10000>;
	};
```

## Documentation/devicetree/bindings/gpio/gpio-tacho.txt
```
Bindings for a tachometer reading a GPIO line

Required properties:
- compatible : "gpio-tachometer"
- gpios: Specifies the pin that receives fan tachometer pulse

Optional properties:
- pulses-per-rev: The number of pulses generated from the fan per
	revolution. This depends on how the motor in the fan is designed.
	e.g.) 4-pole motor generates 2 pulses per revolution
	      6-pole motor generates 3 pulses per revolution

Examples:

	tachometer {
		compatible = "gpio-tachometer";
		gpio = <&gpg1 5 0>;
		pulses-per-rev = <2>;
		status = "okay";
	};
```
