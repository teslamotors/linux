## Documentation/devicetree/bindings/arm/tegra/nvidia,tegra-dvfs-rail.txt
```
NVIDIA Tegra DVFS rail data in the board DTS file:

Required properties:
- compatible : Must be one of the following
	"nvidia,tegra210-dvfs-rail"

- vdd_cpu-supply : Must contain phandle pointing to the regulator for CPU rail.
- vdd_gpu-supply : Must contain phandle pointing to the regulator for GPU rail.
- vdd_core-supply : Must contain phandle pointing to the regulator for SoC rail.

One and only one of the above properties must be specified for each rail node.

Optional properties:
- vdd_cpu_dfll-supply : Must contain phandle pointing to the regulator for CPU
rail in DFLL closed loop mode. This property is required if 'vdd_cpu-supply'
property is pointing to fixed regulator node. Otherwise, it is ignored.
- vmin-cdev : phandle pointing to the cooling device node that contains
properties applied to minimum rail voltage management with temperature
- vmax-cdev : phandle pointing to the cooling device node that contains
properties applied to maximum rail voltage management with temperature
- scaling-cdev : phandle pointing to the cooling device node that contains
properties applied to scaling rail voltage with temperature

- status : standard device availability property
- reg : can be any number but same as used in the node name

NVIDIA Tegra DVFS cooling device data in the board DTS file:

Required properties:
- the required cooling device properties from binding thermal.txt
- compatible : Must be one of the following
	"nvidia,tegra210-rail-vmin-cdev"
	"nvidia,tegra210-rail-vmax-cdev"
	"nvidia,tegra210-rail-scaling-cdev"
- nvidia,trips : an ordered list of phandles with optional specifiers;
each phandle must point to the trip point node in one of the thermal zones,
phnadle specifier if present contains voltage constraint (in mV) corresponding
to trip point temperature

Trips list in "nvidia,tegra210-rail-vmin-cdev" compatible node:
- must have constraints specifying minimum rail voltage
- at least one phandle + constraint pair must be specified; multiple pairs
must have ascending order of trip-point temperatures, and descending order
of constraints (decreasing voltage/temperature relation)
- each trip point referenced in the list must be mapped to the respective
cooling device according to thermal.txt binding with both minimum cooling
device and maximum cooling device state equal to the position index of the
respective phandle in the trip point list
- the 1st constraint is applied in temperature interval below the 1st trip
point; all other constraints are applied below the corresponding trip point and
above the previous trip point; no constraint is applied above the last trip.

Trips list in "nvidia,tegra210-rail-vmax-cdev" compatible node:
- must have constraints specifying maximum rail voltage
- at least one phandle + constraint pair must be specified; multiple pairs
must have ascending order of trip-point temperatures, and descending order
of constraints (decreasing voltage/temperature relation)
- each trip point referenced in the list must be mapped to the respective
cooling device according to thermal.txt binding with both minimum cooling device
state and maximum cooling device state equal to the position index of the
respective phandle in the trip point list
- no constraints applied below the 1st trip point; all constraints except the
last one are applied in temperature interval above the corresponding trip point
and below the next trip-point; the last constraint applied above the last trip.

Trips list in "nvidia,tegra210-rail-scaling-cdev" compatible node:
- must have constraints specifying minimum rail voltage
- at least two phandle + constraint pairs must be specified; multiple pairs
must have ascending order of trip-point temperatures
- the 1st trip point in the list is for reference only and should not be mapped
to cooling device; all other trip point referenced in the list must be mapped to
the respective cooling device according to thermal.txt binding with both minimum
cooling device state and maximum cooling device state equal to the position
index of the respective phandle in the trip point list minus one
- the 1st constraint is applied below the 2nd trip point; the other constraints
except the last one are applied in temperature interval above the corresponding
trip point and below the next trip point; the last constraint applied above the
last trip point.

Optional properties:
- nvidia,constraint : nvidia,trips list entries include constraint specifier;
if this property is not present, list includes only trip point phandles
- cdev-type : cooling device type to be used for device registration; if not
present, the rail property name that contains phandle to the device will be
used

- status : standard device availability property
- reg : can be any number but same as used in the node name

DVFS rail nodes can be placed at root, or included into dvfs-rails parent node.
In the latter case "reg" property is required, and parent node must be specified
as simple bus with the following required properties:

- compatible : Must be "simple-bus"
- #address-cells: Must be 1.
- #size-cells: Must be 0.

Example:

dvfs_rails {
	compatible = "simple-bus";
	#address-cells = <1>;
	#size-cells = <0>;

	vdd-cpu-rail@0 {
		reg = <0>;
		compatible = "nvidia,tegra210-dvfs-rail";
		vdd_cpu-supply = <&pmicxxx_sd0>;
		vmin-cdev = <&cpu_vmin_cdev>;
	};

	vdd-core-rail@1 {
		reg = <1>;
		compatible = "nvidia,tegra210-dvfs-rail";
		vdd_core-supply = <&pmicxxx_sd1>;
	};

	vdd-gpu-rail@2 {
		reg = <2>;
		compatible = "nvidia,tegra210-dvfs-rail";
		vdd_gpu-supply = <&pmicxxx_sd6>;
		scaling-cdev = <&gpu_scaling_cdev>;
	};

	cpu_vmin_cdev: vdd-cpu-vmin-cdev@5 {
		reg = <5>;
		cooling-min-state = <0>;
		cooling-max-state = <2>;
		#cooling-cells = <2>;
		compatible = "nvidia,tegra210-rail-vmin-cdev";
		cdev-type = "cpu_cold";
		nvidia,constraint;
		nvidia,trips = <&cpu_vmin1 950 &cpu_vmin2 900>;
	};

	gpu_scaling_cdev: vdd-gpu-scaling-cdev@7 {
		reg = <7>;
		cooling-min-state = <0>;
		cooling-max-state = <1>;
		#cooling-cells = <2>;
		compatible = "nvidia,tegra210-rail-scaling-cdev";
		cdev-type = "gpu_scaling";
		nvidia,constraint;
		nvidia,trips = <&gpu_scaling0 950 &gpu_scaling1 0>;
	};
};

...

thermal-zones {
	CPU_therm {
		trips {
			cpu_vmin1: cpu-vmin1 {
				temperature = <20000>;
				hysteresis = <1000>;
				type = "active";
			};
			cpu_vmin1: cpu-vmin2 {
				temperature = <50000>;
				hysteresis = <1000>;
				type = "active";
			};
		};
		cooling-maps {
			vdd-cpu-map1 {
				trip = <&cpu_vmin1>;
				cooling-device = <&cpu_vmin_cdev 1 1>;
			};
			vdd-cpu-map2 {
				trip = <&cpu_vmin2>;
				cooling-device = <&cpu_vmin_cdev 2 2>;
			};
		};
	};
	GPU_therm {
		trips {
			/* Reference only trip, not mapped */
			gpu_scaling0: gpu-scaling0 {
				temperature = <(-10000)>;
				hysteresis = <0>;
				type = "active";
			};

			gpu_scaling1: gpu-scaling1 {
				temperature = <20000>;
				hysteresis = <1000>;
				type = "active";
			};
		};
		cooling-maps {
			vdd-gpu-map1 {
				trip = <&gpu_scaling1>;
				cooling-device = <&gpu_scaling_cdev 1 1>;
			};
		};
	};
};

Example with CPU rail scaled in DFLL closed loop mode,
and fixed when PLL is used as CPU clock source :

dvfs_rails {
	compatible = "simple-bus";
	#address-cells = <1>;
	#size-cells = <0>;

	vdd-cpu-rail@0 {
		reg = <0>;
		compatible = "nvidia,tegra210-dvfs-rail";
		vdd_cpu-supply = <&cpu_fixed_reg>;
		vdd_cpu_dfll-supply = <&cpu_pwm_reg>;
	};

	vdd-core-rail@1 {
		reg = <1>;
	....
};
```

## Documentation/devicetree/bindings/arm/turbo.txt
```
Turbo platforms device tree bindings
---------------------------------------

- TRAV eval board:
    Required root node properties:
      - compatible = "turbo,trav", "turbo,trav-eval";
```

## Documentation/devicetree/bindings/ata/tegra-sata.txt
```
Tegra124 SoC SATA AHCI controller

Required properties :
- compatible : "nvidia,tegra124-ahci".
- reg : Should contain 2 entries:
  - AHCI register set (SATA BAR5)
  - SATA register set
- interrupts : Defines the interrupt used by SATA
- clocks : Must contain an entry for each entry in clock-names.
  See ../clocks/clock-bindings.txt for details.
- clock-names : Must include the following entries:
  - sata
  - sata-oob
  - cml1
  - pll_e
- resets : Must contain an entry for each entry in reset-names.
  - pll_e
  See ../reset/reset.txt for details.
- reset-names : Must include the following entries:
  - sata
  - sata-oob
  - sata-cold
- phys : Must contain an entry for each entry in phy-names.
  See ../phy/phy-bindings.txt for details.
- phy-names : Must include the following entries:
  - sata-phy : XUSB PADCTL SATA PHY
- target-5v-supply : Defines the SATA 5V power regulator
- target-12v-supply : Defines the SATA 12V power regulator
- nvidia,disable-features : Defines features to be disabled
 - devslp
 - hipm
 - dipm
 - slumber
 - partial
 - ncq
- nvidia,link-flags : Defines link flags
 - max_power
 - min_power
 - med_power
- pinctrl-names : Define pinctrls for devslp pin
 - pinctrl-0: the pincontrol settings to configure devslp pin
 - pinctrl-1: the pincontrol settings to place devslp pin in pull up state
```

## Documentation/devicetree/bindings/bus/nvidia,tegra20-nor.txt
```
Device tree bindings for NVIDIA Tegra20/30 NOR Bus

The NOR controller supports a number of memory types, including synchronous NOR,
asynchronous NOR, and other flash memories with similar interfaces, such as
MuxOneNAND. One could also connect high speed devices like FPGAs, DSPs,
CAN chips, Wi-Fi chips etc.

The actual devices are instantiated from the child nodes of a NOR node.

Required properties:

 - compatible: should be "nvidia,tegra20-nor", "nvidia,tegra30-nor"
 - reg: Should contain NOR controller registers location and length.
 - clocks: Must contain one entry, for the module clock.
   See ../clocks/clock-bindings.txt for details.
 - resets : Must contain an entry for each entry in reset-names.
   See ../reset/reset.txt for details.
 - reset-names : Must include the following entries:
  - nor
 - #address-cells: Must be set to 2 to allow memory address translation
 - #size-cells:	Must be set to 1 to allow CS address passing
 - ranges: Must be set up to reflect the memory layout with four integer
 		values for each chip-select line in use.
 - nvidia,config: This property represents the SNOR_CONFIG_0 register.

Note that the NOR controller does not have any internal chip-select address
decoding and if you want to access multiple devices external chip-select
decoding must be provided.

Optional properties:

 - nvidia,cs-timing: The timing array represents the SNOR_TIMING0_0 and
   SNOR_TIMING1_0 registers for the NOR controller. If unset reset-values will
   be used. See reference documentation for detailed description of the timing
   registers.

Example with two SJA1000 CAN controllers connected to the NOR bus:

	nor@70009000 {
		status = "okay";
		compatible = "nvidia,tegra20-nor", "nvidia,tegra30-nor";
		reg = <0x70009000 0x1000>;
		#address-cells = <2>;
		#size-cells = <1>;
		clocks = <&tegra_car TEGRA30_CLK_NOR>;
		resets = < &tegra_car 42>;
		reset-names = "nor";
		ranges = <
			0 0 0x48000000 0x00000100
			1 0 0x48040000 0x00000100
		>;

		can@0,0 {
			compatible = "nxp,sja1000";
			reg = <0 0 0x100>;
			interrupt-parent = <&gpio>;
			interrupts = <TEGRA_GPIO(B, 5) IRQ_TYPE_EDGE_RISING>;
			nxp,external-clock-frequency = <24000000>;
			nxp,tx-output-config = <0x16>;
			nxp,clock-out-frequency = <24000000>;
			reg-io-width = <2>;
		};


		can@1,0 {
			compatible = "nxp,sja1000";
			reg = <1 0 0x100>;
			interrupt-parent = <&gpio>;
			interrupts = <TEGRA_GPIO(A, 6) IRQ_TYPE_EDGE_RISING>;
			nxp,external-clock-frequency = <24000000>;
			nxp,tx-output-config = <0x16>;
			reg-io-width = <2>;
	};
```

## Documentation/devicetree/bindings/clock/trav-clock.txt
```
* Turbo TRAV Clock Controller

TRAV clock controller has various blocks which are instantiated
independently from the device-tree. These clock controllers
generate and supply clocks to various hardware blocks within
the SoC.

Each clock is assigned an identifier and client nodes can use
this identifier to specify the clock which they consume. All
available clocks are defined as preprocessor macros in
dt-bindings/clock/trav-clk.h header and can be used in
device tree sources.

External clocks:

There are several clocks that are generated outside the SoC. It
is expected that they are defined using standard clock bindings
with following clock-output-names:

 - "fin_pll" - PLL input clock from XXTI

Required Properties for Clock Controller:

 - compatible: clock controllers will use one of the following
	compatible strings to indicate the clock controller
	functionality.

	- "turbo,trav-clock-cmu"
	- "turbo,trav-clock-peric"

 - reg: physical base address of the controller and the length of
	memory mapped region.

 - #clock-cells: should be 1.

 - clocks: list of clock identifiers which are fed as the input to
	the given clock controller. Please refer the next section to
	find the input clocks for a given controller.

- clock-names: list of names of clocks which are fed as the input
	to the given clock controller.

Input clocks for cmu clock controller:
	- fin_pll

Input clocks for peric clock controller:
	- fin_pll
	- dout_cmu_pll_shared0_div4
	- dout_cmu_peric_shared1div36
	- dout_cmu_peric_shared0div3_tbuclk
	- dout_cmu_peric_shared0div20
	- dout_cmu_peric_shared1div4_dmaclk
```

## Documentation/devicetree/bindings/cpufreq/cluster_clk_private_t18x.txt
```
cluster clock private device for t18x
-----------------------------
tegra18x cluster parameters can be overriden by cluster clock private registers.
These registers are not exposed to ARM_SW and can only be updated by MCE. For Hw
verification these registers are exposed to ARM_SW. For final release these
registers have to be made private and these bindings have to be removed
from ARM_SW.

Required properties:
- compatible: "nvidia,t18x-cluster-clk-priv".
- reg: base address and size for below cluster clocks.
       sys_clock
       b_cluster_clk_priv
       b_cluster_clk_pub
       m_cluster_clk_priv
       m_cluster_clk_pub

- status: "okay" or "disabled" to enable/disable the node.

Optional properties:


Example:
--------
	cluster_clk_priv@0x0e0b0000  {
		compatible = "nvidia,t18x-cluster-clk-priv";
			#address-cells = <2>;
			#size-cells = <2>;
		reg = < 0x0 0x0e0a0000 0x0 0x64 >, /* B cluster clk priv base */
		      < 0x0 0x0e0b0000 0x0 0x64 >; /* m cluster clk priv base */
		status = "disabled";
	};
```
