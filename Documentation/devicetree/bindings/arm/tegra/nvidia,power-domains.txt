## Documentation/devicetree/bindings/edp/nvidia,tegra124-cpu-edp-capping.txt
```
Tegra CPU EDP Management

Any technique for constraining peak current (or power) consumption of
a power rail constitutes EDP management. An EDP management technique
is "dynamic" if its operation depends on parameters which vary at runtime.

This document describes a binding for configuring the dynamic EDP
management algorithm commonly used to manage EDP on the VDD_CPU rail
of Tegra devices.

The algorithm dynamically limits CPU frequency as a function of
temperature, number of cores active, and which cluster is active. (The
algorithm assumes that VDD_CPU powers one or more CPU clusters which
run mutually exclusively). The algorithm computes the maximum
allowable frequency using

- the active cluster's voltage/frequency curve (queried at runtime)
- the VDD_CPU leakage (queried at runtime)
- the active cluster's CPU power model (expressed
     according to nvidia,tegra-ppm.txt)

Required properties:
- compatible: the value "nvidia,tegra124-cpu-edp-capping"
- nvidia,edp_limit: the EDP limit expressed in mA

Optional properties:
- the optional properties supported by binding nvidia,tegra-ppm.txt
- nvidia,power_model: an ordered list of phandles. The corresponding nodes
    each contain the properties for a single cluster. Omitting
    nvidia,power_model indicates a single cluster whose properties are found
    in this very node.
- nvidia,regulator_idle_limit: the current limit in mA which the VDD_CPU
    regulator can drive in its "idle" mode.

Required per-cluster properties:
- the required properties from binding nvidia,tegra-ppm.txt
- nvidia,edp_clk: a string or phandle naming the cluster's clock
- nvidia,freq_step: the granularity in kHz of allowable clock frequencies

Optional per-cluster properties:
- nvidia,hard_cap: a list N frequency caps in kHz assuming the cluster has
    N cores. These caps are applied regardless of temperature.

Example:

	cpu_edp {
		compatible = "nvidia,tegra124-cpu-edp-capping";
		nvidia,freq_step = <12750000>;
		nvidia,edp_clk = "cpu_g";
		nvidia,tegra-ppm-cdyn = <950000 1399000 2166000 3041000>;
		nvidia,tegra-ppm-leakage_weights = <450 670 870 1000>;
		nvidia,tegra-ppm-min_leakage = <30>;
		nvidia,tegra-ppm-leakage_coeffs = <
			  (-309609464) (197786326) (-40763150) (1613941)
			  .... // 60 additional values omitted for brevity
			>;
		nvidia,edp_limit = <14000>;
	};

Example with two clusters:

        cpu_edp {
                compatible = "nvidia,tegra124-cpu-edp-capping";
                nvidia,power_model = <&{/cpu_edp/cluster0}
                                      &{/cpu_edp/cluster1}>;
		nvidia,edp_limit = <14000>;
                cluster0 {
                        nvidia,freq_step = <12750000>;
                        nvidia,edp_clk = "cpu_g";
                        nvidia,tegra-ppm-cdyn = <950000 1399000 2166000 3041000>;
                        nvidia,tegra-ppm-leakage_weights = <450 670 870 1000>;
                        nvidia,tegra-ppm-min_leakage = <30>;
                        nvidia,tegra-ppm-leakage_coeffs = <
					... // 64 values omitted for brevity
                                >;
                };
                cluster1 {
                        nvidia,freq_step = <25500000>;
                        nvidia,edp_clk = "cpu_lp";
                        nvidia,tegra-ppm-cdyn = <450000 839000>;
                        nvidia,tegra-ppm-leakage_weights = <670 1000>;
                        nvidia,tegra-ppm-min_leakage = <16>;
                        nvidia,tegra-ppm-leakage_coeffs = <
					... // 64 values omitted for brevity
                                >;
                };
        };
```

## Documentation/devicetree/bindings/edp/nvidia,tegra124-gpu-edp-capping.txt
```
Tegra GPU EDP Management

Any technique for constraining peak current (or power) consumption of
a power rail constitutes EDP management. An EDP management technique
is "dynamic" if its operation depends on parameters which vary at runtime.

This document describes a binding for configuring the dynamic EDP
management algorithm commonly used to manage EDP on the VDD_GPU rail
of Tegra devices.

The algorithm dynamically limits GPU frequency as a function of
temperature. It computes the maximum allowable frequency using
- the GPU's voltage/frequency curve (queried at runtime)
- the VDD_GPU leakage (queried at runtime)
- a GPU power model (expressed according to nvidia,tegra-ppm.txt)

Required properties:
- compatible: the value "nvidia,tegra124-gpu-edp-capping"
- nvidia,edp_limit: the EDP limit expressed in mA
- nvidia,edp_clk: a string or phandle idenitfying the clock whose
    voltage/frequency curve needs to be queried
- nvidia,freq_step: the granularity in kHz of allowable clock frequencies
- nvidia,edp_cap_clk: a string or phandle identifying the
    clock that the algorithm should use to cap edp_clk frequency
- the many required properties from binding nvidia,tegra-ppm.txt

Example:
	gpu_edp {
		compatible = "nvidia,tegra124-gpu-edp-capping";
		nvidia,freq_step = <12000000>;
		nvidia,edp_clk = "gbus";
		nvidia,edp_cap_clk = "edp.gbus";
		nvidia,tegra-ppm-cdyn = <10646000>;
		nvidia,tegra-ppm-min_leakage = <30>;
		nvidia,tegra-ppm-leakage_coeffs = <
			(  -208796792) (   37746202) (  -9648869) (   725660)
			(   704446675) ( -133808535) (  34470023) ( -2464142)
			(  -783701649) (  146557393) ( -38623024) (  2654269)
			(   292709580) (  -51246839) (  13984499) (  -934964)
			(   115095343) (  -65602614) (  11251896) (  -838394)
			(  -394753929) (  263095142) ( -49006854) (  3326269)
			(   441644020) ( -313320338) (  61612126) ( -3916786)
			(  -164021554) (  118634317) ( -24406245) (  1517573)
			(   -38857760) (   12243796) (  -1964159) (   181232)
			(   143265078) (  -71110695) (  13985680) (  -917947)
			(  -171456530) (   98906114) ( -21261015) (  1216159)
			(    67437536) (  -40520060) (   9265259) (  -484818)
			(     1795940) (    -345535) (     83004) (   -20007)
			(    -8549105) (    6333235) (  -1479815) (   115441)
			(    12192546) (  -10880741) (   2632212) (  -161404)
			(    -5328587) (    4953756) (  -1215038) (    64556)
			>;
		nvidia,edp_limit = <11200>;
	};
```

## Documentation/devicetree/bindings/edp/nvidia,tegra124-sysedp-dynamic-capping.txt
```
System-EDP Consumers:

Required properties:
- compatible: "nvidia,tegra124-sysedp-dynamic-capping"
- nvidia,corecap: This is an array of tegra_sysedp_corecap structs. The order
  and contents of each corecap line refers to a unsigned int value inside the
  tegra_sysedp_corecap struct.  Here's the order of the values expected per
  line of data:
	- AP power (milliwatts): Power required by the AP+DRAM when the CPU power
	  and GPU and EMC frequencies are capped.
	- CPU Priority CPU Max Power (milliwatts): Maximum power given to the CPU
	  when the CPU has the priority.
	- CPU Priority GPU Max Frequency (kHz) (or Max Power (mW)): Maximum GPU
	  frequency (or power) allowed when the CPU has the priority. (See
	  nvidia,gpu_cap_as_mw).
	- CPU Priority EMC Max Frequency (kHz): Maximum EMC frequency allowed when
	  the CPU has the priority.
	- GPU Priority CPU Max Power (milliwatts): Maximum power given to the CPU
	  when the GPU has the priority.
	- GPU Priority GPU Max Frequency (kHz) (or Max Power (mW)): Maximum GPU
	  frequency (or power) allowed when the GPU has the priority. (See
	  nvidia,gpu_cap_as_mw).
	- GPU Priority EMC Max Frequency (kHz): Maximum EMC frequency allowed when
	  the GPU has the priority.
	- Throttle power (milliwatts): The amount of power returned to the system
	  when the SOC_THERM OC signal throttles the CPU and GPU frequencies.
	  This is the amount of power with 100% throttle depth.
	- CPU Priority GPU Supplemental Frequency (kHz) (Optional): Maximum GPU
	  frequency allowed when the CPU has the priority. (See
	  nvidia,gpu_supp_freq).
	- GPU Priority GPU Supplemental Frequency (kHz) (Optional): Maximum GPU
	  frequency allowed when the GPU has the priority. (See
	  nvidia,gpu_supp_freq).
  Note that the order of AP Power must start with the smallest power and
  should increase for each entry.
- nvidia,core_gain: The percentage of gain applied to the AP+DRAM budget power.
  A value of 100 means to multiply by 1.0.
- nvidia,init_req_watts defines the initial AP+DRAM budget before the
  sysedp_dynamic_capping gets a calculated budget from the sysedp module.
- nvidia,throttle_depth: The percentage of gain applied to the throttle power.
  A value of 100 means to multiply by 1.0.  Expected values are between 0-100%.
  This value should be matched to the HW SOC_THERM throttle depth choice.
- nvidia,cap_method: The calculation to use when determining which corecap
  entry is associated with the AP+DRAM budget. For systems with voltage
  comparators, the value should be 3.  For systems without voltage comparators,
  but with modem overcurrent signals, the value should be 2.  For all other
  systems, the value should be set to 1.

Optional properties:
- nvidia,gpu_cap_as_mw: if present, this property indicates that the
  GPU caps are power limits in mW as opposed to frequency limits in
  kHz
- nvidia,gpu_supp_freq: This property must to be used in tandem with
  nvidia,gpu_cap_as_mw. If present, this property indicates that there
  are two additional columns in the nvidia,corecap tables, which contain
  the gpu frequency tables in KHz corresponding to a typical part at 70C.
  These columns are required if the GPU caps are expressed in terms of mW
  instead of KHz, to supplement the information available to choose
  between GPU priority mode vs CPU Priority Mode.

Example:
	sysedp-dynamic-capping {
		compatible = "nvidia,tegra124-sysedp-dynamic-capping";
		nvidia,corecap = <
		   5000   2000 100000 933000   2000 100000 933000    500
		  10000   7000 100000 933000   3500 400000 933000   2000
		  15000  10000 200000 933000   4000 600000 933000   4000
		  20000  10000 500000 933000   5000 700000 933000   8000
		>;
		nvidia,core_gain = <100>;
		nvidia,init_req_watts = <20000>;
		nvidia,throttle_depth = <75>;
		nvidia,cap_method = <3>;
	};

Example 2:
	sysedp-dynamic-capping {
		compatible = "nvidia,tegra124-sysedp-dynamic-capping";
		nvidia,gpu_cap_as_mw;
		nvidia,gpu_supp_freq;
		nvidia,corecap = <
		   5000   2000 1200 933000   2000 1200 933000    500   77  77
		  10000   7000 1200 933000   3500 3800 933000   2000  231 308
		  15000  10000 2400 933000   4000 6000 933000   4000  384 538
		  20000  10000 5000 933000   5000 7000 933000   8000  461 768
		>;
		nvidia,core_gain = <100>;
		nvidia,init_req_watts = <20000>;
		nvidia,throttle_depth = <75>;
		nvidia,cap_method = <3>;
	};
```

## Documentation/devicetree/bindings/edp/nvidia,tegra124-sysedp.txt
```
System-EDP

Required properties:
- compatible: "nvidia,tegra124-sysedp"

Optional properties:
- nvidia,margin: This defines the margin when calculating the budget
  for dynamic capping.
- nvidia,min_budget: This defines the minimum budget for dynamic capping.
- nvidia,initial_budget: This is the initial power budget listed in milliwatts.
  If the system does not include sysedp_batmon_calc device, this budget will
  be used as a fixed budget for the system.  If this option is not present,
  the initial budget will be set to 1000000 mW.

Optional Child Nodes:
- consumers: This node contains a set of subnodes describing different
  devices on the system and their power consumption states.

Optional subnodes of consumers:
- consumerX - These nodes define the power consumption state for one
  consumer device on the system.

Required properties of each consumerX node:
- nvidia,consumer_name: This property is the name of the consumer.
- nvidia,states: This property lists the operating power state of the consumer
  in milliwatts. For example, if "nvidia,states" is set to "<0 300>", then
  that consumer will consume either 0mW or 300mW depending on the state set
  by that consumer.

Example:
	sysedp {
		compatible = "nvidia,tegra124-sysedp";
		nvidia,margin = <0>;
		nvidia,min_budget = <0>;
		nvidia,initial_budget = <30000>;

		consumers {
			consumer1 {
				nvidia,consumer_name = "ov5693";
				nvidia,states = <0 300>;
			};
			consumer2 {
				nvidia,consumer_name = "mt9m114";
				nvidia,states = <0 150>;
			};
			consumer3 {
				nvidia,consumer_name = "speaker";
				nvidia,states = <0 1080>;
			};
			consumer4 {
				nvidia,consumer_name = "wifi";
				nvidia,states = <0 1020>;
			};
			consumer5 {
				nvidia,consumer_name = "pwm-backlight";
				nvidia,states = <0 125 250 375 500 625 750 875 1000 1125 1250>;
			};
			consumer6 {
				nvidia,consumer_name = "sdhci-tegra.2";
				nvidia,states = <0 966>;
			};
			consumer7 {
				nvidia,consumer_name = "sdhci-tegra.3";
				nvidia,states = <0 966>;
			};
			consumer8 {
				nvidia,consumer_name = "as364x";
				nvidia,states = <0 350 700 1050 1400 1750 2100 2450 2800 3150 3500>;
			};
			consumer9 {
				nvidia,consumer_name = "modem";
				nvidia,states = <0 4100>;
			};
		};
	};
```

## Documentation/devicetree/bindings/edp/nvidia,tegra124-sysedp_reactive_capping.txt
```
System-EDP Reactive Capping:

Required properties:
- compatible: "nvidia,tegra124-sysedp_reactive_capping"
- nvidia,max_capping_mw: This defines the maximum allowed power for this consumer
  in milliwatts.
- nvidia,step_alarm_mw: When the interrupt is triggered, increase the consumer's
  power by this amount in milliwatts.
- nvidia,step_relax_mw: After relax_ms time since the last interrupt has fired,
  reduce this consumer's required power by this amount in milliwatts.
- nvidia,relax_ms: This defines the delay in milliseconds after an interrupt
  triggers before relaxing this consumer's power requirements.
- interrupt-parent: This points to the parent device that will own the
  translation of the interrupt lines.
- interrupts: This provides the mapping to the parent which will translate
  the interrupt into the virtual irq value and flags used by
  request_threaded_irq(). Only 1 interrupt (2 values) should be defined.

Optional properties:
- nvidia,threshold_warning: If used, this node provides a message to be printed
  when this consumer's interrupt gets trigerred.

Required sub-nodes:
- sysedpc: This node contains one subnode which needs one property defined:

Require parameter inside sysedpc subnode
  - nvidia,name: This is the name of the sysedp consumer defined

Example:
	sysedp_reactive_capping@1 {
		compatible = "nvidia,tegra124-sysedp_reactive_capping";
		nvidia,max_capping_mw = <15000>;
		nvidia,step_alarm_mw = <1000>;
		nvidia,step_relax_mw = <500>;
		nvidia,relax_ms = <250>;
		nvidia,threshold_warning = "WARNING - SYSTEM Voltage Droop detected, please refer to the Power management application note";
		interrupt-parent = <&soctherm>;
		interrupts = <1 0x2002>;

		sysedpc {
			nvidia,name = "voltmon_oc1";
		}
	};
```

## Documentation/devicetree/bindings/extcon/extcon-adc-jack.txt
```
ADC jack extcon driver

Required Properties:
- compatible : Must be "extcon-adc-jack";
- extcon-adc-jack,states: States of the cable and min/max of ADC.
	The array should be define as
	<state1, adc1_min, adc1_max,
	 state2, adc2_min, adc2_max>;
	extcon-adc-jack can be refer for more details.
- extcon-adc-jack,cable-names: Cable names. Multiple names can be provided
	here.
- extcon-adc-jack,name: name of the extcon device.

Optional Properties:
- extcon-adc-jack,handling-delay: ADC read should be read after this much of
		time.
- extcon-adc-jack,irq-flags: irq flags used for the @irq
- io-channel-names: Name of the channel on IIO.

extcon-adc-jack {
	compatible = "extcon-adc-jack";
	interrupt = <8 0>;
	extcon-adc-jack,cable-names = "ID", "ID-A";
	extcon-adc-jack,states = <1 100 200
				  3 300 400>;
};
```
