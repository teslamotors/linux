## Documentation/devicetree/bindings/cpufreq/nvidia,cpufreq-tegra.txt
```
NVIDIA Tegra cpufreq scaling tables

This binding specifies format of scaling data for NVIDIA Tegra cpufreq driver.

Required properties :
- compatible : Must be one of the following
        "nvidia,tegra210-cpufreq"

Optional properties:
- status : standard DT availability property.

Optional  child nodes :
- cpu-scaling-data : specifies cpufreq scaling table data for CPU clock.
  If this node is not present or not available, default frequency table
  constructed by the driver from CPU DVFS tables is used.
- emc-scaling-data : specifies cpufreq scaling table data for EMC clock floor
  rate request based on CPU clock frequency.
  If the node is not present or not available, default EMC_TO_CPU limit ratio
  table hard-coded in the kernel is used.


* cpu-scaling-data node properties.

Required properties :
- freq-table : array of frequencies converted to cpufreq driver targets as
  described below. Must be in kHz, in increasing order.

Optional properties:
- status : standard DT availability property.
- preserve-across-suspend : if specified, cpufreq governor scaling limits are
  preserved during suspend/resume operations; if not present, cpufreq governor
  scaling limits are set to frequency defined in tegra suspend platform data
  during suspend/resume operations.preserve_cpu_speed
- clip-to-dvfs-down : if specified, freq-table entries are clipped down to CPU
  DVFS table; if not present, freq-table entries are clipped up to CPU DVFS
  table.

  Conversion from freq-table entries to cpufreq driver targets:

  If clip-to-dvfs-down property is present:
  any freq-table entry below bottom DVFS step is kept unchanged
  any freq-table entry exactly at one of the DVFS steps is kept unchanged
  any freq-table entry between two DVFS steps is replaced with lower step
  any freq-table entry above top DVFS step is replaced with top step

  If clip-to-dvfs-down property is not present:
  any freq-table entry below bottom DVFS step is replaced with bottom step
  any freq-table entry exactly at one of the DVFS steps is kept unchanged
  any freq-table entry between two DVFS steps is replaced with upper step
  any freq-table entry above top DVFS step is replaced with top step


* emc-scaling-data node properties.

Required properties :
- emc-cpu-limit-table : array of frequencies to specify EMC and CPU rates
  relation as described below:

	if F[0] > CPU frequency, then EMC frequency is unrestricted by CPU
	if F[i+2] > CPU frequency >= F[i], then EMC frequency >= F[i+1],
	i = 0, ... N-4
	if CPU frequency >= F[N-2], then EMC frequency >= F[N-1]

	N is array size, must be even
	i = 0 ... N-1 is 0-based position index within array
	F[i] value of array cell at index i

   All frequencies are in kHz. CPU frequencies at even positions must be in
   increasing order. EMC frequencies at odd positions are clipped down to EMC
   maximum rate.

Optional properties:
- status : standard DT availability property.


Example:

cpufreq {
        compatible = "nvidia,tegra210-cpufreq";
        cpu-scaling-data {
                freq-table = <
                        200000
                        300000
                        800000
                        1000000
                        1500000
                        2000000
                        2100000
                >;
        };

	emc-scaling-data {
		emc-cpu-limit-table = <
			/* CPU    EMC */
			100000  95000
			200000  185000
			300000  375000
			800000  550000
			1000000 750000
			1500000	1600000
		>;
	};
};
```

## Documentation/devicetree/bindings/cpufreq/tegra_cpufreq_t18x.txt
```
* Device tree binding for Nvidia Tegra18x cpufreq driver for EDVD device
--------------------------------------------

This document defines the device-specific binding for the Tegra18x cpufreq
driver. It should not contain bindings for generic tegra cpufreq driver
which are common across all the tegra cpufreq platform driver.

The Tegra18x cpufreq driver adjusts CPU frequency by writing voltage and
freq hint in EDVD per core volt freq request registers. It calculates per
core cpufreq by reading per core cycle counters. Cycles are measured by
reading EDVD per core clock count registers and divided by ref clock counter.
The ressult is multiplied by ref clock.

Tegra18x cpufreq driver considers these EDVD registers as device to measure
and adjust cpu freq. There is one instance of EDVD for the Denver cluster
and one for the A57 cluster.

Required properties:
- compatible: should be "nvidia,tegra18x-cpufreq".
- reg: an array of four 64-bit unsigned integers.
       the base address and size for Denver EDVD aperture and the base
       address and size for the A57 EDVD aperture.

- status: "okay" or "disabled" to enable/disable the node.

Optional properties:
- freq_table_step_size:
  Cpu frequency table step size. If not provided, default value 4.

  For example, if list of original available frequencies(in KHz) are:
  345600 384000 422400 460800 499200 537600 576000 614400 652800 691200
  729600 768000 806400 844800 883200 921600 960000 998400 1036800 1075200
  1113600 1152000 1190400 1228800 1267200 1305600 1344000 1382400 1420800
  1459200 1497600 1536000 1574400 1612800 1651200 1689600 1728000 1766400
  1804800 1843200

  Setting freq_table_step_size to 1 will include all these frequencies in
  cpufreq table as available frequencies.

  Setting freq_table_step_size to 2 will skip alternative entries and will
  include remaining entries in cpufreq table as available frequencies.
  With freq_table_step_size as 2, cpufreq table available frequencies will be:
  345600 422400 499200 576000 652800 729600 806400 883200 960000 1036800
  1113600 1190400 1267200 1344000 1420800 1497600 1574400 1651200 1728000
  1804800 1843200

  Similarly, freq_table_step_size of value 3 will skip every 2nd and 3rd entries
  in groups of 3 entries consecutively.

- nvidia,enable-autocc3: Enable auto_cc3.
  Auto cc3 is the idle state where freq request is not considered for the cpus
  in WFI/WFE.


Example 1:
----------
       cpufreq@e070000 {
               compatible = "nvidia,tegra18x-cpufreq";
               reg = <0x0 0x0e070000 0x0 0x1000>, /* M/Denver cluster */
                     <0x0 0x0e060000 0x0 0x1000>; /* B/ARM cluster */
               status = "disabled";
       };

Example 2:
----------
       cpufreq@e070000 {
               compatible = "nvidia,tegra18x-cpufreq";
               reg = <0x0 0x0e070000 0x0 0x1000>, /* M/Denver cluster */
                     <0x0 0x0e060000 0x0 0x1000>; /* B/ARM cluster */
               freq_table_step_size = /bits/ 16 <1>;
       };

Example 3: cpufreq and auto-cc3 enabled
----------
       cpufreq@e070000 {
               compatible = "nvidia,tegra18x-cpufreq";
               reg = <0x0 0x0e070000 0x0 0x1000>, /* M/Denver cluster */
                     <0x0 0x0e060000 0x0 0x1000>; /* B/ARM cluster */
               status = "okay";
               nvidia,enable-autocc3;
       };
```

## Documentation/devicetree/bindings/display/bridge/ti,ds90ub948.txt
```
TI DS90UB948-Q1 2K FPD-Link III to OpenLDI Deserializer
=======================================================

This is the binding for Texas Instruments DS90UB948-Q1 bridge deserializer.

This device supports I2C only.

Required properties:

- compatible: "ti,ds90ub948"

Optional properties:

- regulators: List of regulator name strings to enable for operation of device.
- config: List of <register address>,<value> pairs to be set to configure
  device on powerup.  The register addresses and values are 8bit.

Example
-------

ti948: ds90ub948@0 {
	compatible = "ti,ds90ub948";
	reg = <0x2c>;

	regulators: "vcc",
	            "vcc_disp";
	config:
	        /* set error count to max */
	        <0x41>, <0x1f>,
	        /* sets output mode, no change noticed */
	        <0x49>, <0xe0>,
	        /* speed up I2C, 0xE is around 480KHz */
	        <0x26>, <0x0e>,
	        /* speed up I2C, 0xE is around 480KHz */
	        <0x27>, <0x0e>,
	        /* sets GPIO0 as an input */
	        <0x1D>, <0x13>,
	        /* set GPIO2 high, backlight PWM (set to 0x50 for normal use) */
	        <0x1E>, <0x50>,
	        /* sets GPIO3 as an output with remote control for touch XRES */
	        <0x1F>, <0x05>,
	        /* set GPIO5 high, backlight enable on new display */
	        <0x20>, <0x09>,
	        /* set GPIO7 and GPIO8 high to enable touch power and prox sense */
	        <0x21>, <0x91>;
};
```

## Documentation/devicetree/bindings/display/bridge/ti,ds90ub949.txt
```
TI DS90UB949-Q1 1080p HDMI to FPD-Link III bridge serializer
============================================================

This is the binding for Texas Instruments DS90UB949-Q1 bridge serializer.

This device supports I2C only.

Required properties:

- compatible: "ti,ds90ub949"

Optional properties:

- regulators: List of regulator name strings to enable for operation of device.
- config: List of <register address>,<value> pairs to be set to configure
  device on powerup.  The register addresses and values are 8bit.

Example
-------

ti949: ds90ub949@0 {
	compatible = "ti,ds90ub949";
	reg = <0x18>;

	regulators: "vcc",
	            "vcc_hdmi";
	config:
	        /* GPIO0 is an output with remote value */
	        <0x0D>, <0x25>,
	        /* GPIO3 is an input for XRES */
	        <0x0F>, <0x03>,
	        /* GPIO2 is an input for backlight PWM */
	        <0x0E>, <0x30>,
	        /* Enables forward channel I2C pass through */
	        <0x17>, <0x9e>,
	        /* Enables PORT1 registers I2C access */
	        <0x1E>, <0x04>;
};
```

## Documentation/devicetree/bindings/display/nvidia,tegra18x-smartdimmer.txt
```
Tegra Smartdimmer Driver
------------------------

This file documents the the DT bindings of the smartdimmer driver for Tegra
186.

Required properties:
- #status: Set to "okay" to enable smartdimmer at boot or "disabled" to turn
  off
- #nvidia,sw-update-delay: The frame delay while setting gain vis-a-vis
  backlight change. Set to 0, 1, 2, or 3 to determine  number of frames to
  skip while applying gain
- #nvidia,aggressiveness: Sets the smartdimmer aggressiveness. This affects
  the maximum number of pixels that can be saturated.The following are
  allowed values:
  1 - 5%
  2 - 10%
  3 - 15%
  4 - 20%
  5 - 25%
- #nvidia,gain_table: Table of the gain that needs to be applied across 32
  buckets representing different pixel groups from 0 to 255. The array is
  flattened from a 2D array of gain tables of 32 entries each representing
  the 32 buckets.
- #nvidia,backlight_table: Table of the backlight compensation corresponding
  to the gain table applied


Example:

smartdimmer {
	status = "disabled";
	nvidia,sw-update-delay = <0>;
	nvidia,aggressiveness = <5>;
	nvidia,sd-window-enable = <0>;
	nvidia,gain_table = <
		0x4000 0x4000 0x4000 0x4000 0x4000 0x4000 0x4000 0x4000
		0x4000 0x4000 0x4000 0x4000 0x4000 0x4000 0x4000 0x4000
		0x4000 0x4000 0x4000 0x4000 0x4000 0x4000 0x4000 0x4000
		0x4000 0x4000 0x4000 0x4000 0x4000 0x4000 0x4000 0x4000
		......
	>;
	nvidia,backlight_table = <
		255 245 235 226 217 209 201 194 187 180 174 168 162 157
		152 147 142 138 134 130 126 122 119 115 112 109 106 103
		100 98 95 93 90 88 86 84 82 80 78 76 74 73 71 69 68 66
		65 63 62 61 59
	>;
}
```

## Documentation/devicetree/bindings/edp/nvidia,tegra-ppm.txt
```
Tegra Processor Power Model

The node for any device with a single significant voltage rail, a
single significant clock domain, and N cores may implement this binding
to indicate a power model for the device.

The power model, known as tegra_ppm (or Tegra Processor Power Model),
can be described concisely as follows:

    total_power = V * (I_active + I_leakage * weight[active_cores])
    I_active = C[active_cores] * V * F
    I_leakage = max( min_leakage, leakage_model(V, IDDQ, T) )

leakage_model is a tricubic polynomial. It computes leakage in mA
based on voltage in Volts, quiescient current in Amps, and temperature
in deciCelcius. These unusual units serve to keep the coefficients at
a similar order of magnitude and thus alleviate one source of
quantization error in the model.

Required properties:
- nvidia,tegra-ppm-cdyn: An array of N capacitances in femtofarads. The first
      entry applies when 1 core is active. The last entry applies when all N
      are active.
- nvidia,tegra-ppm-leakage_coeffs: An array of 64 coefficients for the leakage
      model. Each coefficient is a 32-bit two's complement integer.

Optional properties
- nvidia,tegra-ppm-leakage_weights: An array of N weights expressed permill.
      The first entry applies when 1 core is active. The last entry applies
      when all N cores are active. If not specified and N=1, defaults to 1000
      (i.e. unity).
- nvidia,tegra-ppm-coeff_scale: scale factor for the leakage coefficients. If
      not specified, defaults to 10^5.
- nvidia,tegra-ppm-min_leakage: leakage floor in mA
```
