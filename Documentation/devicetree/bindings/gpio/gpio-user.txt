## Documentation/devicetree/bindings/i2c/max929x.txt
```
max929x properties

Required properties:
- compatible:
	Should be one of
		maxim,max9291
		maxim,max9293
- reg: I2C address (7-bit unshifted)

Optional properties:
- maxim,enable-gpio: gpio to enable vs. reset the chip

Example:
	max9291@40 {
		compatible = "maxim,max9291";
		reg = <0x40>;
		status = "okay";
		maxim,enable-gpio = <&tegra_gpio TEGRA_GPIO(O, 1) 0>;
	};
```

## Documentation/devicetree/bindings/i2c/ti,sn65dsi85.txt
```
TI SN65DSI85 MIPI DSI to LVDS Bridge
===================================

The sn65dsi85 node:
sn65dsi85 node must be contained in i2c parent node. This node represents
TI SN65DSI85 MIPI DSI to LVDS Bridge.

Required properties:
- compatible: Should contain "ti,sn65dsi85".
- reg: I2C address for chip.

Optional properties:
- ti,enable-gpio: gpio to enable and reset chip.
- ti,pll-refclk-cfg: is the value for SN65DSI85_PLL_REFCLK_CFG register.
- ti,dsi_cfg1: is the value for SN65DSI85_DSI_CFG1 register.
- ti,dsi-cha-clk-range: is the value for SN65DSI85_DSI_CHA_CLK_RANGE register.
- ti,dsi-chb-clk-range: is the value for SN65DSI85_DSI_CHB_CLK_RANGE register.
- ti,disable-assr: can be 0 or 1 to enable or disable ASSR support.
  Default is set to zero.
- ti,dp-ssc-cfg: is the value for SN65DSI85_DP_SSC_CFG register.
- ti,video_cha_line_low: is the value for SN65DSI85_VIDEO_CHA_LINE_LOW
  register.
- ti,video_cha_line_high: is the value for SN65DSI85_VIDEO_CHA_LINE_HIGH
  register.
- ti,video_chb_line_low: is the value for SN65DSI85_VIDEO_CHB_LINE_LOW
  register.
- ti,video_chb_line_high: is the value for SN65DSI85_VIDEO_CHB_LINE_HIGH
  register.
- ti,cha_vert_disp_size_low: is the value for SN65DSI85_CHA_VERT_DISP_SIZE_LOW
  register.
- ti,cha_vert_disp_size_heigh: is the value for
  SN65DSI85_CHA_VERT_DISP_SIZE_HEIGH register.
- ti,h-pulse-width-low: is the value for SN65DSI85_CHA_HSYNC_PULSE_WIDTH_LOW
  register.
- ti,h-pulse-width-high: is the value for SN65DSI85_CHA_HSYNC_PULSE_WIDTH_HEIGH
  register.
- ti,v-pulse-width-low: is the value for SN65DSI85_CHA_VSYNC_PULSE_WIDTH_LOW
  register.
- ti,v-pulse-width-high: is the value for SN65DSI85_CHA_VSYNC_PULSE_WIDTH_HIGH
  register.
- ti,h-back-porch: is the value for SN65DSI85_CHA_HORIZONTAL_BACK_PORCH
  register.
- ti,v-back-porch: is the value for SN65DSI85_CHA_VERTICAL_BACK_PORCH register.
- ti,h-front-porch: is the value for SN65DSI85_CHA_HORIZONTAL_FRONT_PORCH
  register.
- ti,v-front-porch: is the value for SN65DSI85_CHA_VERTICAL_FRONT_PORCH
  register.

Example:

i2c@7000c000 {
	sn65dsi85@2d {
		compatible = "ti,sn65dsi85";
		reg = <0x2d>;
		status = "okay";
	};
}:
```

## Documentation/devicetree/bindings/i2c/ti,sn65dsi86.txt
```
TI SN65DSI86 MIPI DSI to EDP Bridge
===================================

The sn65dsi86 node:
sn65dsi86 node must be contained in i2c parent node. This node represents
TI SN65DSI86 MIPI DSI to EDP Bridge.

Required properties:
- compatible: Should contain "ti,sn65dsi86".
- reg: I2C address for chip.

Optional properties:
- ti,enable-gpio: gpio port to enable and reset chip.
- ti,pll-refclk-cfg: init value for the register 0x0a. Default value is 0x02.
- ti,dp-ssc-cfg: init value for the register 0x93. Default value is 0x20.
- ti,disable-assr: 0 or 1 to enable or disable ASSR support.
  Default value is 0.
- ti,negative-hsync: 0 or 1 to be normal or negative polarity of H-Sync
  pulse. Default value is 0.
- ti,negative-vsync: 0 or 1 to be normal or negative polarity of V-Sync
  pulse. Default value is 0.
- ti,enable-colorbar: 0 or 1 to disable or enable the color-bar test pattern
  generator. Default value is 0.

Properties to be obsolete:
- ti,h-pulse-width-high: init value for the register 0x2D. Default value
  is 0x00. (only bit7 is used to set the H-Sync polarity negative)
- ti,v-pulse-width-high: init value for the register 0x31. Default value
  is 0x00. (only bit7 is used to set the V-Sync polarity negative)

Properties not in use (ignored):
- ti,dsi_cfg1: init value for the register 0x10. Default value is 0x26.
- ti,dsi-cha-clk-range: init value for the register 0x12. Default value
  is 0x55.
- ti,dsi-chb-clk-range: init value for the register 0x13. Default value
  is 0x00.
- ti,video_cha_line_low: init value for the register 0x20. Default value
  is 0x80.
- ti,video_cha_line_high: init value for the register 0x21. Default value
  is 0x07.
- ti,video_chb_line_low: init value for the register 0x22. Default value
  is -1.
- ti,video_chb_line_high: init value for the register 0x23. Default value
  is 0x00.
- ti,cha_vert_disp_size_low: init value for the register 0x24. Default value
  is 0x38.
- ti,cha_vert_disp_size_high: init value for the register 0x25. Default value
  is 0x04.
- ti,h-pulse-width-low: init value for the register 0x2C. Default value
  is 0x10.
- ti,v-pulse-width-low: init value for the register 0x30. Default value
  is 0x0e.
- ti,h-back-porch: init value for the register 0x34. Default value is 0x98.
- ti,v-back-porch: init value for the register 0x36. Default value is 0x13.
- ti,h-front-porch: init value for the register 0x38. Default value is 0x10.
- ti,v-front-porch: init value for the register 0x3a. Default value is 0x03.

Example:

i2c@7000c000 {
	sn65dsi86@2d {
		compatible = "ti,sn65dsi86";
		reg = <0x2d>;
		status = "okay";
	};
}:
```

## Documentation/devicetree/bindings/iio/adc/palmas-gpadc.txt
```
* Palmas general purpose ADC IP block devicetree bindings

Required properties:
- compatible : Must be "ti,palmas-gpadc".

Optional sub-nodes:
ti,channel0-current-microamp: Channel 0 current in uA.
	Valid values 0uA, 5uA, 15uA, 20uA.
ti,channel3-current-microamp: Channel 3 current in uA.
	Valid value 0uA, 10uA, 400uA, 800uA.
ti,enable-channel3-dual-current: Enable dual current on channel 3.
ti,enable-extended-delay: Enable extended delay.

Optional sub-node:
The Palmas ADC node has optional subnode to define the iio mapping.
It is the name with "iio_map". This node has again subnode to define
the property of the channel. The sub subnode has following properties:
- ti,adc-channel-number: ADC channel numbber.
- ti,adc-consumer-device: Consumer device name.
- ti,adc-consumer-channel: ADC consumer channel name.

Example:

pmic {
	compatible = "ti,twl6035-pmic", "ti,palmas-pmic";
	...
	gpadc {
		compatible = "ti,palmas-gpadc";
		interrupts = <18 0
			      16 0
			      17 0>;
		ti,channel0-current-microamp = <5>;
		ti,channel3-current-microamp = <10>;
	};
	...
};
```

## Documentation/devicetree/bindings/iio/ak8963c-compass.txt
```
* AKM 8963/8975/09911 compass sensor

nvi_ (NVI = NVidia/Invensense) drivers use the NVidia Sensor (NVS) framework.
See the nvs.txt documentation for NVS DT capabilities.
The nvi_ak89xx compass sensor driver supports the AK8963, AK8975, and
AK09911 devices as stand-alone or behind an Invensense MPU.

Required properties:
- compatible: Device or generic name.
	      Supported device names:
	      - ak,ak89xx
	      - ak,ak8963
	      - ak,ak8975
	      - ak,ak09911
  Note: If the part is known and is populated, then it can be specified:
	Example: compatible = "ak,ak8963";
	When specifying a device this way, the driver will assume this specific
	device is populated during system boot and will not verify its
	existence.  If, however, the device is unknown or may not be populated,
	then the label, ak89xx, (Example: compatible = "ak,ak89xx";),
	must be used.  This tells the driver to find which device is used.  If
	the device is not found, the driver will unload itself.  This requires
	regulators to be setup correctly for the probe function.
- reg: i2c address of the device. It should be 0x0C or 0x0D.
  Note: the AKM09911 also supports I2C addresses 0x0E and 0x0F.

Optional properties:
- status: set to "ok" or "okay" for normal operation.  Set to anything else
	  to unload the driver without ever communicating with the device.
  Note: The "anything else" above is typically "disabled".
	Since the driver will unload without communicating with the device, the
	device will be left in its POR state.
- magnetic_field_disable: Setting this property to <1> will disable the device
                          and unload the driver.
- vdd-supply: regulator supply for the chip
- vid-supply: regulator supply for the chip
  Note: These are required if the driver is to control the regulators.
- magnetic_field_matrix:  Orientation matrix for this device.
- nvi_config: This configures the device's I2C connection.
              The string options are: auto
	                              mpu
	                              host
	      auto = the driver will auto detect the connection.
	      mpu = the device is connected to an Invensense auxilary bus.
	      host = the device is connected to the host AP.
	      If this property is not defined, auto will be used.

Example:
	ak89xx@0d {
		compatible = "ak,ak89xx";
                reg = <0x0d>;
                magnetic_field_matrix = [ff 00 00 00 ff 00 00 00 01];
        };
```

## Documentation/devicetree/bindings/iio/bmp280-pressure.txt
```
* Bosch BMP 180/280 pressure sensor

nvi_ (NVI = NVidia/Invensense) drivers use the NVidia Sensor (NVS) framework.
See the nvs.txt documentation for NVS DT capabilities.
The nvi_bmpX80 pressure sensor driver supports the BMP180 and BMP280 devices
as stand-alone or behind an Invensense MPU.
If the part is known and is populated, then it can be specified in the DT:
Example: bmp280@77.
By specifying a device this way, the driver will assume this specific device
is populated during system boot and will not verify its existence. If, however,
the device is unknown or may not be populated, then the label, ak89xx,
(e.g. bmpX80@77), must be used.  This tells the driver to find which device is
used.  If the device is not found, the driver will unload itself.  This also
requires that regulators be setup correctly for the probe function.

Required properties:
- compatible: Device or generic name.
	      Supported names:
	      - bmp,bmpX80
	      - bmp,bmp180
	      - bmp,bmp280
  Note: If the part is known and is populated, then it can be specified:
	Example: compatible = "bmp,bmp280";
	When specifying a device this way, the driver will assume this specific
	device is populated during system boot and will not verify its
	existence.  If, however, the device is unknown or may not be populated,
	then the label, bmpX80, (Example: compatible = "bmp,bmpX80";),
	must be used.  This tells the driver to find which device is used.  If
	the device is not found, the driver will unload itself.  This requires
	regulators to be setup correctly for the probe function.
- reg: i2c address of the device. It should be 0x76 or 0x77.

Optional properties:
- status: set to "ok" or "okay" for normal operation.  Set to anything else
	  to unload the driver without ever communicating with the device.
  Note: The "anything else" above is typically "disabled".
	Since the driver will unload without communicating with the device, the
	device will be left in its POR state.
- pressure_disable: Setting this property to <1> will disable the device and
		    unload the driver.
- vdd-supply: regulator supply for the chip
- vddio-supply: regulator supply for the chip
  Note: These are required if the driver is to control the regulators.
- nvi_config: This configures the device's I2C connection.
              The string options are: auto
	                              mpu
	                              host
	      auto = the driver will auto detect the connection.
	      mpu = the device is connected to an Invensense auxilary bus.
	      host = the device is connected to the host AP.
	      If this property is not defined, auto will be used.

Example:
	bmpX80@77 {
                compatible = "bmp,bmpX80";
                reg = <0x77>;
        };
```

## Documentation/devicetree/bindings/iio/cm3217-als.txt
```
* Capella CM3217 ambient light sensor

nvs_ drivers use the NVidia Sensor (NVS) framework.
See the nvs.txt documentation for NVS DT capabilities.

Required properties:
- compatible: must be "capella,cm3217"
- reg: i2c address of the device. It should be 0x10.

Optional properties:
- status: set to "ok" or "okay" for normal operation.  Set to anything else
	  to unload the driver without ever communicating with the device.
  Note: The "anything else" above is typically "disabled".
	Since the driver will unload without communicating with the device, the
	device will be left in its POR state.
	This device's POR comes up in an operational mode and will draw power.
	If it is desired to unload the driver leaving the device in a low power
	sleep state, then use the individual sensor disable mechanism below.
- light_disable: Setting this property to <1> will disable the device and
                 unload the driver.
- vdd-supply: regulator supply for the chip
  Note: This is required if the driver is to control the regulator.

Example:
	cm3217@10 {
		compatible = "capella,cm3217";
		reg = <0x10>;
		vdd-supply = <&palmas_smps9>;
	};
```
