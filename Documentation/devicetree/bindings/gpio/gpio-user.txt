## Documentation/devicetree/bindings/iommu/nvidia,tegra-smmu.txt
```
NVIDIA Tegra 30 IOMMU H/W, SMMU (System Memory Management Unit)

Required properties:
- compatible : one or more of "nvidia,tegra210-smmu", "nvidia,tegra132-smmu"
               or "nvidia,tegra124-smmu"
- reg : Should contain 2 register banks, one for smmu register aperture and
        one for ahb arb
- interrupts : Should contain MC General interrupt.
- nvidia,#asids : # of ASIDs
- dma-window : IOVA start address and length.

Example:
	smmu {
		compatible = "nvidia,tegra210-smmu";
		reg = <0x0 0x70019000 0x0 0x1000
		       0x0 0x6000c000 0x0 0x1000>;
		nvidia,#asids = <128>;		/* # of ASIDs */
		dma-window = <0x0 0x80000000 0x0 0x7ff00000>;	/* IOVA start & length */
	};
```

## Documentation/devicetree/bindings/leds/leds-cy8c.txt
```
LED connected to I2C (CY8C uC controller)

Required properties:
- compatible : should be "nvidia,cy8c_led".

Each LED is represented as a sub-node of the cy8c_led device. Each
node's name represents the name of the corresponding LED.

LED sub-node properties:
- label :  (optional)
	see Documentation/devicetree/bindings/leds/common.txt
- reg : i2c regmap address

Examples:
	i2c@7000c000 {
		nv_foster_led@09 {
			compatible = "nvidia,cy8c_led";
			label = "led_lightbar";
			reg = <0x09>;
			#address-cells = <1>;
			#size-cells = <0>;
	};
};
```

## Documentation/devicetree/bindings/media/gpio-ir-receiver.txt
```
Device-Tree bindings for GPIO IR receiver

Required properties:
	- compatible: should be "gpio-ir-receiver".
	- gpios: specifies GPIO used for IR signal reception.

Optional properties:
	- min-delay: minimum delay(ms) to send IR event reset for raw IR decoding.
	- linux,rc-map-name: Linux specific remote control map name.
	- allowed-protos: 64 bit integer, platform specific allowed
			  IR protocols.

Example node:

	ir: ir-receiver {
		compatible = "gpio-ir-receiver";
		gpios = <&gpio0 19 1>;
		min-delay = <500>;
		linux,rc-map-name = "rc-rc6-mce";
		allowed-protos = <0x00000000 0x00000080>;
	};
```

## Documentation/devicetree/bindings/media/tegra-dtv.txt
```
NVIDIA tegra dtv controller

This file documents the properties used by the tegra-dtv driver

Required properties:
- compatible : Should be similar to "nvidia,tegra210-dtv"
- reg : Should contain dtv register location and length
- nvidia,dma-request-selector : Request selector for this DTV controller.
- dmas : Phandle for apbdma dma controller and request selector.
- dma-names : "rx" or "tx" based on the direction of transfer.

Example:

	dtv@7000C300 {
		compatible = "nvidia,tegra210-dtv";
		reg = <0x7000c300 0x100>;
		nvidia,dma-request-selector = <11>;
		dmas = < &apbdma 11 >;
		dma-names = "rx";
	}
```

## Documentation/devicetree/bindings/media/tegra-isc-mgr.txt
```
NVIDIA tegra isc mgr driver

This file documents the properties used by the isc-mgr driver in tegra platform

Required properties:
- compatible : Should be "nvidia,isc-mgr"
- i2c-bus : Should contain the i2c bus number that the device is attached to tegra for controlling the isc
- csi-port : Should contain the csi port number that the device is attached to tegra for image streaming

Optional properties:
- pwdn-gpios : Should contain the list for gpios to control power in order of aggregator and camera instances
- pwr-items : Map power items to the GPIO item specified in the pwdn-gpios list, starting from 0. For example,
              pwr-item 0 is for the deserializer, while pwr-item 1, 2, 3, 4 are for links 0, 1, 2, 3
- default-power-on : If this property is used, while probing the device, pwdn-gpios are powered on
- interrupt-parent : Should contain interrupt parent for gpio interrupt
- interrupts : Should contain the gpio number that is connected to status pin in isc device

Example:
isc-mgr.0 {
    compatible = "nvidia,isc-mgr";
    i2c-bus = <2>;
    csi-port = <0>;
    pwdn-gpios = < &gpio TEGRA_GPIO(X, 1) GPIO_ACTIVE_HIGH  /* GMSL_IN1_PDN */
        &gpio TEGRA_GPIO(H, 2) GPIO_ACTIVE_HIGH     /* TA_TV1_TV2_ENA */
        &gpio TEGRA_GPIO(H, 5) GPIO_ACTIVE_HIGH>;   /* TA_TV3_TV4_ENA */
    pwr-items =  <0 1 1 2 2>; /* map pwr-items to pwdn-gpios */
    /* default-power-on; */ /* Deactivate pwdn-gpios */
    interrupt-parent = <&gpio>;
    interrupts = <TEGRA_GPIO(V, 2) 2>; /* gpio PS3 : falling edge sensitive */
    status = "okay";
};
```
