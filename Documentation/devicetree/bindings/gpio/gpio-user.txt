## Documentation/devicetree/bindings/iio/ltr659-ps.txt
```
* LTR 558/659 ALS/proximity sensor

nvs_ drivers use the NVidia Sensor (NVS) framework.
See the nvs.txt documentation for NVS DT capabilities.
The nvs_ltr659 ALS/proximity sensor driver supports the LTR558 and LTR659
devices.

Required properties:
- compatible: Device or generic name.
	      Supported device names:
	      - liteon,ltrX5X
	      - liteon,ltr558als
	      - liteon,ltr659ps
  Note: If the part is known and is populated, then it can be specified:
	Example: compatible = "liteon,ltr659ps";
	When specifying a device this way, the driver will assume this specific
	device is populated during system boot and will not verify its
	existence.  If, however, the device is unknown or may not be populated,
	then the label, ltrX5X, (Example: compatible = "liteon,ltrX5X";),
	must be used.  This tells the driver to find which device is used.  If
	the device is not found, the driver will unload itself.  This requires
	regulators to be setup correctly for the probe function.
- reg: i2c address of the device. It is 0x23.

Optional properties:
- status: set to "ok" or "okay" for normal operation.  Set to anything else
	  to unload the driver without ever communicating with the device.
  Note: The "anything else" above is typically "disabled".
	Since the driver will unload without communicating with the device, the
	device will be left in its POR state.
- light_disable: Setting this property to <1> will disable the light sensor.
- proximity_disable: Setting this property to <1> will disable the proximity
                     sensor.
  Note: If the device supports both light and proximity, then to disable the
        entire device so that the driver unloads, all sensors must be disabled:
	light_disable = <1>;
	proximity_disable = <1>;
- vdd-supply: regulator supply for chip
- vled-supply: regulator supply for led anode.
  Note: These are required if the driver is to control the regulators.

Example:

	ltr659@23 {
		compatible = "liteon,ltrX5X";
		reg = <0x23>;
		vdd-supply = <&palmas_smps9>;
		vled-supply = <&palmas_smps8>;
	};
```

## Documentation/devicetree/bindings/iio/meter/ina219.txt
```
DT binding document for INA219 iio/meter driver.

Required properties:
- compatible: Must be one of
	"ti,ina219"
- reg: I2C slave address of device.

- ti,rail-name: Name of the rail for whose monitoring is required.
- ti,trigger-config: Trigger configuration for the device in trigger mode.
- ti,continuous-config:  Device configuration in continuous mode. In this mode
	device will keep scanning the inputs.
- address-cells: Number of address in child node. Must be 1.
- size-cells: Size of address cell. Must be 0.

Optional properties:
- ti,calibration-data: Calibration data.
- ti,power-lsb: LSB power.
- ti,divisor: Divisor.
- ti,shunt-resistor-mohm: Shunt resistance in milliohm.
- ti,precision-multiplier: Precision multplier.

Example:
	ina219@41{
		compatible = "ti,ina219x";
		reg = <0x41>;
		ti,rail-name = "VDD_BAT_CHG";
		ti,continuous-config = <0x0407>;
		ti,trigger-config = <0x0403>;
		ti,calibration-data = <0x0E90>;
		ti,power-lsb = <6866>;
		ti,divisor = <25>;
		ti,precision-multiplier = <1000>;
	}; 
```

## Documentation/devicetree/bindings/iio/meter/ina230.txt
```
DT binding document for INA230 iio/meter driver.

Required properties:
- compatible: Must be one of
	"ti,ina226", "ti,ina230", "ti,hpa01112", "ti,hpa02149".
- reg: I2C slave address of device.

- ti,rail-name: Name of the rail for whose monitoring is required.
- ti,trigger-config: Trigger configuration for the device in trigger mode.
- ti,continuous-config:  Device configuration in continuous mode. In this mode
	device will keep scanning the inputs.
- address-cells: Number of address in child node. Must be 1.
- size-cells: Size of address cell. Must be 0.

Optional properties:
- ti,current-threshold: Threshold current for alert generation.
- ti,enable-alert-latch: Boolean to tell whether alert is latched or not.
- ti,resistor: Resistor value.
- ti,minimum-core-online: Minimum online cpu for starting the monitoring.
- ti,calibration-data: Calibration data.
- ti,power-lsb: LSB power.
- ti,divisor: Divisor.
- ti,shunt-resistor-mohm: Shunt resistance in milliohm.
- ti,precision-multiplier: Precision multplier.
- ti,shunt-polartiy-inverted: Boolean to tell whether shunt polarity is
	inverted or not.

Example:
	ina230@41{
		compatible = "ti,ina230x";
		reg = <0x41>;
		ti,rail-name = "VDD_BAT_CHG";
		ti,continuous-config = <0x0407>;
		ti,trigger-config = <0x0403>;
		ti,calibration-data = <0x0E90>;
		ti,resistor = <5>; 
		ti,power-lsb = <6866>;
		ti,divisor = <25>;
		ti,precision-multiplier = <1000>;
	}; 
```

## Documentation/devicetree/bindings/iio/meter/ina3221.txt
```
DT binding document for INA3221 iio/meter driver.

Required properties:
- compatible: Must be "ti,ina3221x".
- reg: I2C slave address of device.

- ti,trigger-config: Trigger configuration for the device in trigger mode.
- ti,continuous-config:  Device configuration in continuous mode. In this mode
	device will keep scanning the inputs.
- address-cells: Number of address in child node. Must be 1.
- size-cells: Size of address cell. Must be 0.

Optional sub-nodes:
	Device has 3 input channels and channel specific information
is provided through the child node. Each channel will have different child
node. The channel number is identified by the reg properties on each of node.
Required subnode properties:
- reg: channel number. 0 for channel 0, 1 for channel 1 and 2 for channel 2.
- ti,rail-mae: Name of the channel in string.

Optional subnode properties:
- ti,current-warning-limit-ma: Cureent warning limit for the given channel.
- ti,current-critical-limit-ma: Current critical limit for the given channel.
- ti,shunt-resistor-mohm: Shunt register in milli ohm.

IIO channel properties:
It follows same mechanism for iio properties detailed on ../iio-bindings.txt
The iio cells size must be 1.
	#io-channel-cells = <1>;
The ina3221 driver provides following monitoring:
	voltage, current, current_trigger, power, power_trigger.
	The sequence of index assigned in drivers are:
		voltage, current, current_trigger, power, power_trigger
	The above monitoring is provided for channel 0, 1 and 2.
The sysfs are
	in_voltage0_input, in_current0_input, in_current0_trigger_input
	in_power0_input, in_power0_trigger_input
	in_voltage1_input, in_current1_input, in_current1_trigger_input,
	in_power1_input, in_power1_trigger_input
	in_voltage2_input, in_current2_input, in_current2_trigger_input,
	in_power2_input,in_power2_trigger_input
The channel index are in above sequence starting from 0.

To ease the DT entry, the macros are added in header dt-bindings/iio/meter/ina3221x.h
The Voltage/current/power macros are defines and can be use with INA3221_CHAN_INDEX to
get the proper index.
Example: For Channel 0, normal power it is INA3221_CHAN_INDEX(0, POWER, NORMAL)
for channel 2, normal current it is INA3221_CHAN_INDEX(2, CURRENT, NORMAL).

The typical macro for voltage/current and powers are:
	INA3221_VOLTAGE, INA3221_CURRENT, INA3221_POWER
The typical macro for normal/trigger are INA3221_NORMAL and INA3221_TRIGGER.

The INA3221_CHAN_INDEX defined as:
#define INA3221_CHAN_INDEX(chan, type, add) (chan * 5 + INA3221_##type + INA3221_##add)

Example:
	ina3221x@40 {
		compatible = "ti,ina3221x";
		reg = <0x40>;
		ti,trigger-config = <0x7003>;
		ti,continuous-config = <0x7c07>;
		#address-cells = <1>;
		#size-cells = <0>;
		#io-channel-cells = <1>;

		channel@0 {
			reg = <0x0>;
			ti,rail-name = "VDD_BAT";
			ti,current-warning-limit-ma = <8000>;
			ti,current-critical-limit-ma = <9000>;
			ti,shunt-resistor-mohm = <1>;
		};

		channel@1 {
			reg = <0x1>;
			ti,rail-name = "VDD_CPU";
			ti,shunt-resistor-mohm = <1>;
		};

		channel@2 {
			reg = <0x2>;
			ti,rail-name = "VDD_GPU";
			ti,shunt-resistor-mohm = <1>;
		};
	};


clients {
	io-channels = <&ina3221x INA3221_CHAN_INDEX(0, CURRENT, NORMAL)>;
	io-channel-names = "battery-current"
}
```

## Documentation/devicetree/bindings/input/touchscreen/maxim_sti_ts.txt
```
Maxim touch.

Required properties:
- compatible.
- reg.
- spi-max-frequency.
- interrupt-parent.
- interrupts.
- maxim_sti,reset-gpio.
- maxim_sti,touch_fusion.
- maxim_sti,config_file.
- maxim_sti,fw_name.
- maxim_sti,nl_family.
- maxim_sti,nl_mc_groups.
- maxim_sti,chip_access_method.
- maxim_sti,default_reset_state.
- maxim_sti,tx_buf_size.
- maxim_sti,rx_buf_size.

Sample:
	spi@7000d400 {
		maxim_sti@0 {
			status = "okay";
			compatible = "maxim,maxim_sti";
			spi-max-frequency = <12000000>;
			reg = <0>; /* chip select */
			interrupt-parent = <&gpio>;
			interrupts = <TEGRA_GPIO(K, 2) 0x02>;
			maxim_sti,reset-gpio = <TEGRA_GPIO(K, 4)>;
			maxim_sti,touch_fusion = "/vendor/bin/touch_fusion";
			maxim_sti,config_file = "/vendor/firmware/touch_fusion.cfg";
			maxim_sti,fw_name = "maxim_fp35.bin";
			maxim_sti,nl_family = "touch_fusion";
			maxim_sti,nl_mc_groups = <5>;
			maxim_sti,chip_access_method = <2>;
			maxim_sti,default_reset_state = <0>;
			maxim_sti,tx_buf_size = <4100>;
			maxim_sti,rx_buf_size = <4100>;
			controller-data {
				nvidia,enable-hw-based-cs;
				nvidia,rx-clk-tap-delay = <0>;
				nvidia,tx-clk-tap-delay = <0>;
			};
		};
	};
```

## Documentation/devicetree/bindings/input/touchscreen/raydium_rm_ts_spidev.txt
```
raydium touch.

Required properties:
- compatible : should be "raydium,rm_ts_spidev".
- reg: Should contain registers location and length.
- interrupts: Should contain touch interrupts.
- rx-clk-tap-delay: should contain rx_clk_tap_delay in tegra_spi_device_controller_data
- tx-clk-tap-delay: should contain tx_clk_tap_delay in tegra_spi_device_controller_data
- reset-gpio: gpio spec for touch reset
- platform-id: value for spec platform_id in rm_spi_ts_platform_data
- name-of-clock: spec clock name for name_of_clock in rm_spi_ts_platform_data
- name-of-clock-con: spec clock name for name_of_clock_con in rm_spi_ts_platform_data
- gpio-sensor-select0: gpio select 0 pin definition for different skus/platforms
- gpio-sensor-select1: gpio select 1 pin definition for different skus/platforms

Example:

		spi-touch@0 {
			compatible = "raydium,rm_ts_spidev";
			reg = <0>; /* spi chip select 0 */
			spi-max-frequency = <12000000>;
			interrupt-parent = <&gpio>;
			interrupts = <82 0x01>; /* GPIO_PK2 */
			reset-gpio = <&gpio 84 0>; /* GPIO_PK4 */
			config = <0>;
			platform-id = <0x8>;
			name-of-clock = "clk_out_2";
			name-of-clock-con = "extern2";
			gpio-sensor-select0;
			/* 0x3 in this case (0x1(select1) << 1 | 0x1(select0)) */
			gpio-sensor-select1;
		};
```

## Documentation/devicetree/bindings/interrupt-controller/tegra-agic.txt
```
Tegra AGIC Interrupt Controller Bindings
----------------------------------------

AGIC is based on generic interrupt controller ARM IP GIC400. The
GIC-400 complies to AMBA AXI4 protocol and Version 2 of the ARM
GIC Architecture Specification. The GIC-400 implements the GICv2
Security Extension.

Required properties:
 - compatible: should be set to "nvidia,tegra210-agic"
 - reg: should contain AGIC distributor and cpu interface base
   address
 - interrupt-controller: detect this node as an interrupt-controller
 - no-gic-extension: This gic is standalone int controller and does
   not have external interrupt controller to support.
 - not-per-cpu: This gic is shared between the CPU's and the adsp and
   does not provide per-cpu interface.
 - interrupts: The Agic is a secondary GIC, hence requires the
   interrupt number which is wired to the primary GIC.

Example:
	tegra_agic: agic-controller {
		compatible = "nvidia,tegra210-agic";
		interrupt-controller;
		#interrupt-cells = <4>;
		no-gic-extension;
		not-per-cpu;
		reg = <0x0 0x702f9000 0x0 0x2000>,
		      <0x0 0x702fa000 0x0 0x2000>;
		interrupts = <0 102 0xf04>;
	};


The devices using AGIC as interrupt-parent need to add a 4 cell property
for an interrupt to be used. The first 3 cell properties are same as that
for a GIC interrupt. The last cell represents the default routing of the
interrupt.

Example:
	adsp {
	     compatible = "nvidia,tegra210-adsp";
	     interrupt-parent = <&tegra_agic>;
	     interrupts = <GIC_SPI INT_AMISC_MBOX_EMPTY1 IRQ_TYPE_LEVEL_HIGH ROUTE_TO_HOST>, /* MBOX SEND */
			     <GIC_SPI INT_AMISC_MBOX_FULL0 IRQ_TYPE_LEVEL_HIGH ROUTE_TO_HOST>, /* MBOX RECV */
			     <GIC_SPI INT_ADSP_WDT IRQ_TYPE_LEVEL_HIGH ROUTE_TO_HOST>, /* Watchdog */
			     <GIC_SPI INT_WFI IRQ_TYPE_LEVEL_HIGH ROUTE_TO_HOST>, /* WFI */
			     <GIC_SPI INT_AMC_ERR IRQ_TYPE_LEVEL_HIGH ROUTE_TO_HOST>, /* AMC ERR IRQ */
			     <GIC_SPI INT_ADSP_ACTMON IRQ_TYPE_LEVEL_HIGH ROUTE_TO_HOST>, /* ADSP ACTMON IRQ */
			     <GIC_SPI INT_AMISC_MBOX_EMPTY0 IRQ_TYPE_LEVEL_HIGH ROUTE_TO_ADSP>, /* ADSP MBOX SEND */
			     <GIC_SPI INT_AMISC_MBOX_FULL1 IRQ_TYPE_LEVEL_HIGH ROUTE_TO_ADSP>, /* ADSP MBOX RECV */
			     <GIC_SPI INT_AMISC_MBOX_FULL2 IRQ_TYPE_LEVEL_HIGH ROUTE_TO_ADSP>; /* ADSP FIQ HANDLER */
	     status = "disabled";
	};
```

## Documentation/devicetree/bindings/interrupt-controller/tegra-t18x-agic.txt
```
Tegra AGIC Interrupt Controller Bindings
----------------------------------------

AGIC is based on generic interrupt controller ARM IP GIC400. The
GIC-400 complies to AMBA AXI4 protocol and Version 2 of the ARM
GIC Architecture Specification. The GIC-400 implements the GICv2
Security Extension.

Required properties:
 - compatible: should be set to "nvidia,tegra18x-agic"
 - reg: should contain AGIC distributor and cpu interface base
   address
 - interrupt-controller: detect this node as an interrupt-controller
 - no-gic-extension: This gic is standalone int controller and does
   not have external interrupt controller to support.
 - not-per-cpu: This gic is shared between the CPU's and the adsp and
   does not provide per-cpu interface.
 - interrupts: The Agic is a secondary GIC, hence requires the
   interrupt number which is wired to the primary GIC.

Example:
	tegra_agic: agic-controller@2a41000 {
		compatible = "nvidia,tegra18x-agic";
		interrupt-controller;
		#interrupt-cells = <4>;
		no-gic-extension;
		not-per-cpu;
		reg = <0x0 0x02a41000 0x0 0x1000>,
		      <0x0 0x02a42000 0x0 0x2000>;
		interrupts = <0 145 0xf04>;
		status = "disabled";
	};


The devices using AGIC as interrupt-parent need to add a 4 cell property
for an interrupt to be used. The first 3 cell properties are same as that
for a GIC interrupt. The last cell represents the default routing of the
interrupt.

Example:
	adsp@2993000 {
		compatible = "nvidia,tegra18x-adsp";
		interrupt-parent = <&tegra_agic>;
		interrupts = <GIC_SPI INT_AMISC_MBOX_EMPTY1 IRQ_TYPE_LEVEL_HIGH
				ROUTE_TO_HOST_INTF0>, /* MBOX SEND */
			     <GIC_SPI INT_AMISC_MBOX_FULL0 IRQ_TYPE_LEVEL_HIGH
				ROUTE_TO_HOST_INTF0>,  /* MBOX RECV */
			     <GIC_SPI INT_ATKE_WDT_IRQ IRQ_TYPE_LEVEL_HIGH
				ROUTE_TO_HOST_INTF0>, /* ATKE Watchdog */
			     <GIC_SPI INT_WFI IRQ_TYPE_LEVEL_HIGH
				ROUTE_TO_HOST_INTF0>, /* WFI */
			     <GIC_SPI INT_AMC_ERR IRQ_TYPE_LEVEL_HIGH
				ROUTE_TO_HOST_INTF0>, /* AMC ERR IRQ */
			     <GIC_SPI INT_ADSP_ACTMON IRQ_TYPE_LEVEL_HIGH
				ROUTE_TO_HOST_INTF0>, /* ADSP ACTMON IRQ */
			     <GIC_SPI INT_AMISC_MBOX_EMPTY0 IRQ_TYPE_LEVEL_HIGH
				ROUTE_TO_ADSP>, /* ADSP MBOX SEND */
			     <GIC_SPI INT_AMISC_MBOX_FULL1 IRQ_TYPE_LEVEL_HIGH
				ROUTE_TO_ADSP>, /* ADSP MBOX RECV */
			     <GIC_SPI INT_AMISC_MBOX_FULL2 IRQ_TYPE_LEVEL_HIGH
				ROUTE_TO_ADSP>, /* ADSP FIQ HANDLER */
			     <GIC_SPI INT_ATKE_TMR0 IRQ_TYPE_LEVEL_HIGH
				ROUTE_TO_ADSP>, /* ATKE TIMER 0 */
			     <GIC_SPI INT_ATKE_TMR1 IRQ_TYPE_LEVEL_HIGH
				ROUTE_TO_ADSP>, /* ATKE TIMER 1 */
			     <GIC_SPI INT_SHSP2APE_DB IRQ_TYPE_LEVEL_HIGH
				ROUTE_TO_ADSP>; /* SHSP2APE */
	};
```
