## Documentation/devicetree/bindings/usb/udc-tegra.txt
```
* Nvidia USB tegra device controller

This file documents the properties used by the tegra-udc driver.

Required properties:
- compatible: Should be similar to "nvidia,tegra210-udc"
- reg: Specify start address and registers count details
- interrupts: Specify the interrupts IRQ info for device

Optional properties:
- nvidia,port-otg: Specify whether given port supports otg or not.
- nvidia,charging-supported: Specify whether needs charging through USB.
- nvidia,enable-pmu-vbus-detection: Specify whether vbus detection is supported from PMU.
- nvidia,enable-aca-nv-charger-detection: Enables aca-nv-charger detection.
- nvidia,enable-aca-rid-detection: Enables ACA ID resistances detection.
- nvidia,id-detection-type: Specify how usb id detection type on the platform.
	0 - if detection is through USB controller
	1 - if detection is through PMU extcon
	2 - if enable through sysfs interface.
- nvidia,qc2-input-voltage: Specify the input voltage needed to support QC2.0 charger.
	TEGRA_USB_QC2_5V - if input voltage is 5V
	TEGRA_USB_QC2_9V - if input voltage is 9V
	TEGRA_USB_QC2_12V - if input voltage is 12V
	TEGRA_USB_QC2_20V - if input voltage is 20V
- nvidia,qc2-current-limit-ua: Specify the QC2.0 charger current limit in microamperes.
- nvidia,dcp-current-limit-ua: If needs to overried standard DCP charger current limit (1.5A), specify the value in microamperes.
- nvidia,enable-xhci-host: Specify whether this port is taken by XUSB.
- avdd_usb-supply: Specify the phandle of corresponding regulator device tree node.
- avdd_pll_utmip-supply: Specify the phandle of corresponding regulator device tree node.
- usb_bat_chg-supply: Specify the phandle of corresponding current regulator device tree node.
- extcon-cables: Specify the phandles and index of different extcon needed.
- extcon-cable-names: Specify the cable names needed from extcon.

Example:
	udc@0x7d000000 {
		compatible = "nvidia,tegra210-udc";
		reg = <0x0 0x7d000000 0x0 0x4000>;
		interrupts = <0 20 0x04>;

		nvidia,port-otg;
		nvidia,charging-supported;
		nvidia,enable-pmu-vbus-detection;
		nvidia,qc2-input-voltage = <TEGRA_USB_QC2_9V>;
		nvidia,qc2-current-limit-ua = <1200000>;
		nvidia,dcp-current-limit-ua = <1800000>;
		avdd_usb-supply = <&ldousb_reg>;
		avdd_pll_utmip-supply = <&palmas_smps8>;
		usb_bat_chg-supply = <&battery_charger>;
		status = "okay";
	};
```

## Documentation/devicetree/bindings/video/backlight/pwm-backlight.txt
```
For pwm-backlight bindings

1. backlight node
 Required properties:
  - compatible: "pwm-backlight"
  - pwms: OF device-tree PWM specification (see PWM binding[0])
  - lth-brightness: low threshold brightness to retain the linearity of the graph when the intensity
    of backlight goes to zero(OFF) when the value in not zero almost nearing to zero(some x%)
  - pwm-gpio: specifies a GPIO used for pwm pin if there is.
  - bl-measured: Arrays for backlight calibration, which is usually for linear backlight response.
  - brightness-levels: Array of distinct brightness levels. Typically these
      are in the range from 0 to 255, but any range starting at 0 will do.
      The actual brightness level (PWM duty cycle) will be interpolated
      from these values. 0 means a 0% duty cycle (darkest/off), while the
      last value in the array represents a 100% duty cycle (brightest).
  - default-brightness-level: the default brightness level (index into the
      array defined by the "brightness-levels" property)
  - power-supply: regulator for supply voltage

  The following "max-brightness" and "default-brightness" are mutually exclusive
  with "brightness-levels" and "default-brightness-level".
  It is used in case where levels are not available on the backlight device
  and the device can interpolate values.
  In this case the minimum value that is considered is 0.

  - max-brightness: the maximum brighness value that is allowed by the
       backlight device.
  - default-brightness: the default brighness value that is allowed by the
       backlight device.

 Optional properties:
  - pwm-names: a list of names for the PWM devices specified in the
               "pwms" property (see PWM binding[0])
  - enable-gpios: contains a single GPIO specifier for the GPIO which enables
                  and disables the backlight (see GPIO binding[1])

 It is possible for backlight node to have child backlight node.
  - Child node represents one of multiple backlight settings nodes, which are pwm-backlight based.
    In this case, "lth-brightness", "pwm-gpio", "bl-measured", "brightness-levels",
    "default-brightness-level", "max-brightness" and "default-brightness" properties
    need to be prepared underneath each child node, instead of backlight parent node.

1.A) child backlight node
 Child backlight node must be contained in backlight parent node.
 It is possible to have multiple backlight nodes. Additionally, child backlight node
 should have its own compatible property.

  - compatible: Can be arbitrary, but each child backlight node should have unique name.
  - pwms: OF device-tree PWM specification (see PWM binding[0]). If pwms is not searched
    underneath backlight node, then, search pwm device in this node.

[0]: Documentation/devicetree/bindings/pwm/pwm.txt
[1]: Documentation/devicetree/bindings/gpio/gpio.txt

Examples:

	backlight {
		compatible = "pwm-backlight";
		pwms = <&pwm 0 5000000>;
		brightness-levels = <0 4 8 16 32 64 128 255>;
		default-brightness-level = <6>;

		power-supply = <&vdd_bl_reg>;
		enable-gpios = <&gpio 58 0>;
	};

or

	backlight {
		compatible = "pwm-backlight";
		pwms = <&pwm 1 1000000>;
		max-brightness = <255>;
		default-brightness = <224>;
	};

or

	backlight {
		compatible = "pwm-backlight";
		pwms = <&pwm 1 5000000>;
		bl-device {
			status = "okay";
			compatible = "a,wuxga-8-0-bl";
			brightness-levels = <0 4 8 16 32 64 128 255>;
			default-brightness-level = <6>;
		};
	};

or

	backlight {
		compatible = "pwm-backlight";
		pwms = <&pwm 1 40161>;
		bl-device {
			status = "okay";
			compatible = "a,wuxga-8-0-bl";
			max-brightness = <255>;
			default-brightness = <191>;
			bl-measured = < 0 1 2 4 5 6 7 8
					10 11 12 13 14 15 16 18
					19 20 21 22 23 24 25 26
					27 29 30 31 32 33 34 35
					36 38 39 40 41 42 44 45
					46 47 48 49 50 52 53 54
					55 56 57 58 59 61 62 63
					64 65 67 68 69 70 71 72
					73 75 76 77 78 79 80 81
					82 83 84 85 86 87 88 89
					90 91 92 93 94 96 97 98
					99 100 101 102 103 104 105 106
					107 108 109 110 111 112 112 113
					114 115 115 116 117 117 118 119
					120 122 123 124 125 126 128 129
					130 131 132 133 134 135 135 136
					137 138 139 140 141 142 143 145
					146 147 148 149 150 151 152 153
					154 155 156 157 158 159 160 161
					161 162 163 164 164 165 166 166
					167 168 169 170 171 173 174 175
					176 177 178 179 180 181 182 183
					183 184 185 186 187 188 189 189
					190 191 192 193 193 194 195 196
					197 198 199 200 200 201 202 203
					204 205 206 207 208 209 210 211
					212 213 214 216 217 218 219 220
					221 222 223 224 225 226 227 228
					229 230 231 232 233 234 235 235
					236 237 238 239 240 241 242 243
					244 245 247 248 249 250 251 251
					252 252 253 253 254 254 255 255 >;
		};
	};
```

## Documentation/devicetree/bindings/video/ds90ub947-q1.txt
```
DS90UB947-Q1 1080p OpenLDS to FPD-Link III Serializer driver

Required properties:
- compatible : should be "ti,ds90ub947-q1".

Sub-node properties:
- reg : i2c regmap address (app firmware)
- init-regs : an array of 8b values. The array should contain consecutive
    groups of 3 values, each group containing reg address, mask, and data.
	Data is written to each register using the mask, in a read/modify/write fashion.

Examples:
	i2c@3180000 {
		ds90ub947-q1@0c {
			compatible = "ti,ds90ub947-q1";
			reg = <0x0c>;

			/* Set OLDI_IN_MODE to single-pixel mode */
			/* Write 1 to bit 6 of register 0x47. Additional reg writes
			 * would simply be appended to this array */
			init-regs = <0x47 0x40 0x40>;
		};
	};
};
```

## Documentation/devicetree/bindings/video/nvidia,nvavp.txt
```
Device-Tree bindings for tegra nvavp driver

Required properties:
- compatible: value should be "nvidia,tegra114-nvavp"/"nvidia,tegra124-nvavp"/"nvidia,tegra30-nvavp"
- reg: physical base address of mailbox, nvavp vector table
- interrupts: interrupt number to the cpu.

Note: nvavp should is child of the host1x
Example:
	nvavp {
		compatible = "nvidia,tegra114-nvavp";
		interrupts = <0 4 0x04>; /* mailbox AVP IRQ */
		reg = <0x60001000 0x0000e200>;
	};
```

## Documentation/devicetree/bindings/video/nvidia,tegra114-dc.txt
```
NVIDIA Tegra114 Display Controller
==================================

1) The dc node:
 dc node must be contained in host1x parent node. This node represents
 NVIDIA Tegra114 Display controller.

 Required properties:
 - name: dc
 - compatible: Should contain "nvidia,tegra114-dc".
 - reg: Physical base address and length of the controller's registers.
 - interrupts: The interrupt outputs from the controller.
 - nvidia,memory-clients: This is the "swgroup" ID in the Tegra TRM term.
 - nvidia,dc-flags: can be 0 or below flags
   TEGRA_DC_FLAG_ENABLED is to enable display controller in probe time.
   TEGRA_DC_FLAG_SET_EARLY_MODE together with TEGRA_DC_FLAG_ENABLED is to enable
   early modeset during kernel boot.
 - nvidia,emc-clk-rate: Initially required embedded memory controller clk rate.
 - nvidia,cmu-enable: Toggle switch for color management unit.
 - nvidia,low-v-win: If low_v_win is set, we can lower vdd_core when that windows
   is the only one active.
 - nvidia,fb-bpp: Bits per pixel of fb.
 - nvidia,fb-flags: Window is updated in display controller device probe. Should be TEGRA_FB_FLIP_ON_PROBE,
   or 0
 - avdd_hdmi-supply: phandle to the regulator device tree node for HDMI supply voltage,
   HDMI_AVDD.
 - avdd_hdmi_pll-supply: phandle to the regulator device tree node for HDMI pll supply.
 - vdd_hdmi_5v0-supply: phandle to the regulator device tree node for HDMI 5V source.

Example

	host1x {
		/* tegradc.0 */
		dc@54200000 {
			status = "okay";
			compatible = "nvidia,tegra114-dc";
			reg = <0x54200000 0x00040000>;
			interrupts = <0 73 0x04>;
			nvidia,memory-clients = <2>;
			nvidia,dc-flags = <TEGRA_DC_FLAG_ENABLED>;
			nvidia,emc-clk-rate = <204000000>;
			nvidia,cmu-enable = <1>;
			nvidia,low-v-win = <0x2>;
			nvidia,fb-bpp = <32>; /* bits per pixel */
			nvidia,fb-flags = <TEGRA_FB_FLIP_ON_PROBE>;
		};
		/* tegradc.1 */
		dc@54240000 {
			status = "okay";
			compatible = "nvidia,tegra114-dc";
			reg = <0x54240000 0x00040000>;
			interrupts = <0 74 0x04>;
			nvidia,memory-clients = <3>;
			nvidia,dc-flags = <TEGRA_DC_FLAG_ENABLED>;
			nvidia,emc-clk-rate = <300000000>;
			nvidia,fb-bpp = <32>; /* bits per pixel */
			nvidia,fb-flags = <TEGRA_FB_FLIP_ON_PROBE>;
			avdd_hdmi-supply = <&palmas_ldoln>;
			avdd_hdmi_pll-supply = <&palmas_ldo1>;
			vdd_hdmi_5v0-supply = <&vdd_hdmi>;
		};
	}
```
