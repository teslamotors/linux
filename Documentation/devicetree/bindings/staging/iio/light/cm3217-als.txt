## Documentation/devicetree/bindings/video/nvidia,tegra210-hdmi.txt
```
NVIDIA TEGRA210 High Definition Multimedia Interface
====================================================

1) The sor1 node:
 sor1 node must be contained in host1x parent node. This node represents NVIDIA TEGRA210
 High Definition Multimedia Interface.

 Required properties
 - name: sor1
 - compatible: Should contain "nvidia,tegra210-hdmi".
 - reg: Physical base address and length of the controller's registers.
 - interrupts: The interrupt outputs from the controller.

 Optional properties:
 - nvidia,ddc-i2c-bus: phandle of an I2C controller used for DDC EDID probing
 - nvidia,hpd-gpio: specifies a GPIO used for hotplug detection,
   if invalid gpio number is provided driver will imply display is always connceted.
   invalid gpio can be like 0xffffffff mentioned as second entry in this parameter.
 - nvidia,hotplug-report: With 1, it will have optional hotplug report callback
   which does only set DDC_SDA and DDC_SCL pull downs to be active when hotplug
   is detected, otherwise keep them disabled.
 - nvidia,sor1-output-type: preferred secondary panel type. Can either be "hdmi"
   or "dp".

 1.A) The hdmi-display node:
 hdmi-display must be contained in sor1 parent node. This node represents hdmi display node.

 Required properties
 - name: hdmi-display
 - compatible: Should contain hdmi,display".

 Optional properties:
 - nvidia,edid: supplies a binary EDID blob

 1.A.i) NVIDIA Display Controller Modes
 This must be contained in hdmi-display parent node. This contains supported modes.

 Required properties:
 - name: Should be "display-timings"

 - Child nodes represent modes. Several modes can be prepared.

 1.A.i.x) NVIDIA Display Controller Mode timing
 This must be contained in display-timings parent node. This contains mode settings, including
 display timings. For hdmi out-type case, display-timings properties are only valid in case of
 hdmi fb console mode.

 Required properties:
 - name: Can be arbitrary, but each sibling node should have unique name.
 - hactive, vactive: display resolution.
 - hfront-porch, hback-porch, hsync-len: horizontal display timing parameters
   in pixels.
 - vfront-porch, vback-porch, vsync-len: vertical display timing parameters in
   lines.
 - clock-frequency: display clock in Hz.
 - nvidia,h-ref-to-sync: H reference to HSYNC. This specifies the start position of HSYNC
   with respect to H reference point.
 - nvidia,v-ref-to-sync: V reference to VSYNC. This specifies the start position of VSYNC
   with respect to V reference point.

 1.A.j) NVIDIA Display Default Output Settings
 This must be contained in hdmi-display parent node. This is default output settings.

 Required properties:
 - name: Should be "disp-default-out".
 - nvidia,out-type: Output type. Should be TEGRA_DC_OUT_HDMI.
 - nvidia,out-width: Width in struct fb_var_screeninfo. width of picture in mm.
 - nvidia,out-height: Height in struct fb_var_screeninfo. height of picture in mm.
 - nvidia,out-rotation: It specifies panel rotation in degree.
 - nvidia,out-flags: One item or an array of several tuples items can be chosen.
   List of items is TEGRA_DC_OUT_HOTPLUG_HIGH, TEGRA_DC_OUT_HOTPLUG_LOW,
   TEGRA_DC_OUT_NVHDCP_POLICY_ON_DEMAND, TEGRA_DC_OUT_NVHDCP_POLICY_ALWAYS_ON,
   TEGRA_DC_OUT_CONTINUOUS_MODE, TEGRA_DC_OUT_ONE_SHOT_MODE,
   TEGRA_DC_OUT_N_SHOT_MODE, TEGRA_DC_OUT_ONE_SHOT_LP_MODE,
   TEGRA_DC_OUT_INITIALIZED_MODE and TEGRA_DC_OUT_HOTPLUG_WAKE_LP0.
   If several items are written, bitwise OR is operated for them, internally.
 - nvidia,out-hdcp-policy: One of TEGRA_DC_OUT_HDCP_POLICY_ALWAYS_ON,
   TEGRA_DC_OUT_HDCP_POLICY_ALWAYS_OFF
 - nvidia,out-parent-clk: Parent clk for display controller.
 - nvidia,out-max-pixclk: Maximum pixel clock in pico-seconds.
 - nvidia,dither: Dither option. Should be TEGRA_DC_UNDEFINED_DITHER or
   TEGRA_DC_DISABLE_DITHER or TEGRA_DC_ORDERED_DITHER or TEGRA_DC_ERRDIFF_DITHER
   or TEGRA_DC_TEMPORAL_DITHER.
 - nvidia,out-align: Display data alignment. Should be TEGRA_DC_ALIGN_MSB or TEGRA_DC_ALIGN_LSB.
 - nvidia,out-order: Display data order. Should be TEGRA_DC_ORDER_RED_BLUE or
   TEGRA_DC_ORDER_BLUE_RED.
 - nvidia,out-depth: Display base color size. 3, 6, 8, 9, 12, 15, 16, 18 and 24 for
   BASE_COLOR_SIZE111, BASE_COLOR_SIZE222, BASE_COLOR_SIZE332, BASE_COLOR_SIZE333,
   BASE_COLOR_SIZE444, BASE_COLOR_SIZE555, BASE_COLOR_SIZE565, BASE_COLOR_SIZE666,
   and BASE_COLOR_SIZE888, respectively. In default, BASE_COLOR_SIZE888 is chosen.
   For hdmi out-type case, depth selection is only valid for hdmi fb console mode,
   otherwise, BASE_COLOR_SIZE888 is chosen as a default.
 - nvidia,out-xres: Visible resolution for width.
 - nvidia,out-yres: Visible resolution for height.

 1.A.k) NVIDIA Display Controller Smart Dimmer Settings
 This must be contained in hdmi-display parent node. This is smart dimmer settings.

 Required properties:
 - name: Should be "smartdimmer".
 - nvidia,use-auto-pwm: With enabled, hardware adjust the backlight PWM control
   signal directly.
 - nvidia,hw-update-delay: It determines the delay of the update of the hardware
   enhancement value (K) that is applied to the pixels.
 - nvidia,bin-width: It is the width of the histogram bins, in quantisation level.
   0xffffffff, 1, 2, 4 or 8 can be written, 0xffffffff, which means 2's compliment
   of -1, indicates automatic based on aggressiveness.
 - nvidia,aggressiveness: The aggressiveness level of the smart dimmer algorithm.
 - nvidia,use-vid-luma: With enabled, it uses video luminance control of luminance.
 - nvidia,phase-in-adjustments: Software backlight phase-in
 - nvidia,k-limit-enable: When enabled, Max.K is taken from K_LIMIT register (nvidia,k-limit)
   rather than computed from nvidia,aggressiveness.
 - nvidia,k-limit: When nvidia,k-limit-enable is enabled, limits raw K independently of
   aggressiveness.
 - nvidia,sd-window-enable: When enabled, constrain histogram (and therefore backlight)
   to a rectangular subset of display.
 - nvidia,soft-clipping-enable: When enabled, enhancement gain (K) is reduced for pixels
   above nvidia,soft-clipping-threshold level to avoid saturation.
 - nvidia,soft-clipping-threshold: Threshold at which pixel enhancement gain is reduced.
 - nvidia,smooth-k-enable: When enabled, max raw K change per frame is limited to
   nvidia,smooth-k-incr.
 - nvidia,smooth-k-incr: When nvidia,smooth-k-enable is enabled, the raw K is changed
   at most by smooth-k-incr per frame.
 - nvidia,coeff: Luminance calculation coefficients used to convert the red green and
   blue color components into a luminance value. The conversion is performed according to
   the following equation: Luminance = (R*R_COEFF + G*G_COEFF + B*B_COEFF) >> 4.
   Need to write blue, green, red coefficient for luminance calculation in sequence.
 - nvidia,fc: Flicker control that prevents rapid and frequent changes
   in the enhancement value. Need to write time_limit, threshold in sequence.
 - nvidia,blp: Defines the parameters for the backlight temporal response model. Need to
   write time_constant for the response curve and step that determines the instantaneous
   portion of the target value of enhancement that is applied: <time_constant, step>.
 - nvidia,bltf: Backlight transfer function. Each points on the transfer function curve
   defines how the backlight output changes with respect to the control input. The 17th point
   is defined to be the maximum value.
 - nvidia,lut: Enhancement value (K) look up table. each LUT entry contains the value of k
   for each of the three color components (R_LUT, G_LUT, B_LUT in sequence).
   There are nine entries in total.
 - nvidia,use-vpulse2: With enabled, run histogram on vpulse2 rather than vsync.
 - nvidia,bl-device-name: Backlight device name.
 - nvidia,bias0: By default set to BIAS_MSB to allow for work around a HW issue, but can
   be overridden with this property.

 1.A.l) NVIDIA Display Controller Color Management Unit Settings
 This must be contained in hdmi-display node. This is color management unit settings.

 Required properties:
 - name: Should be "cmu".
 - nvidia,cmu-csc: CMU color space conversion matrix. It is 3X3 matrix.
 - nvidia,cmu-lut2: CMU LUT2. Should be 960 u8 arrays.

 1.B) the prod-settings node:
 the prod-settings node holds prod settings for hdmi tmds.
 Optinonal properties:
 - #prod-cells: Indicate how many entries are there on prod setting tupples per
   configuration. Absence of this property assume that prod-cells are 3

 1.B.i) the prod nodes:
 the "prod" node holds the default tmds settings and the status is always
 "okay". other nodes are optional. prod_c_<N>M: holds the prod settings for a
 particular frequency ranging between 54 and 600 Mhz. For example: "prod_c_75M"
 holds prod settings for a maximum frequency of 75 MHz.

 required properties:
 - prod: This is a set of tuples used to program registers through the prod settings API.
   The fields of each tuple are [offset, bitmask, value]
 optional properties:
 - status: can be "okay" or "disabled" if this property is not present, "okay"
   is assumed


Example

	host1x {
		sor1 {
			status = "okay";
			compatible = "nvidia,tegra210-hdmi";
			reg = <0x54280000 0x00040000>;
			interrupts = <0 75 0x04>;
			nvidia,ddc-i2c-bus = <&hdmi_ddc>;
			nvidia,hpd-gpio = <&gpio TEGRA_GPIO(N, 7) 1>; /* PN7 */
			hdmi-display {
				status = "okay";
				disp-default-out {
					nvidia,out-type = <TEGRA_DC_OUT_HDMI>;
					nvidia,out-flags = <TEGRA_DC_OUT_HOTPLUG_HIGH>;
					nvidia,out-parent-clk = "pll_d2";
					nvidia,out-max-pixclk = <3367>; /* KHZ2PICOS(297000) */
					nvidia,out-align = <TEGRA_DC_ALIGN_MSB>;
					nvidia,out-order = <TEGRA_DC_ORDER_RED_BLUE>;
					nvidia,out-xres = <1920>;
					nvidia,out-yres = <1080>;
				};
			};
			prod-settings {
				#prod-cells = <3>
				prod {
					prod = <
						0x000003a0 0xfffffffe 0x00000001 //INPUT_CONTROL
						0x0000005c 0xf0fff8ff 0x01000000 //PLL0
						0x00000060 0xff0fe0ff 0x00300f80 //PLL1
						0x00000068 0xf0ffffff 0x09000000 //PLL3
						0x00000138 0x00000000 0x373f3f3f //LANE_DRIVE_CURRENT
						0x00000148 0x00000000 0x00000000 //LANE_PREEMPHASIS
						0x00000170 0xffbf00ff 0x00401000 //LANE_PADCTL
					>;
				};
				prod_c_600M {
					status = "okay";
					prod = <
						0x000003a0 0xfffffffd 0x00000002
						0x0000005c 0xf0fff8ff 0x01000300
						0x00000060 0xff0fe0ff 0x00300980
						0x00000068 0xf0ffffff 0x08000000
						0x00000138 0x00000000 0x33373737
						0x00000148 0x00000000 0x00000000
						0x00000170 0xffbf00ff 0x00406600
					>;
				};
			};
		};
	};
	hdmi_ddc: i2c@7000c700 {
		clock-frequency = <100000>;
	};
```

## Documentation/devicetree/bindings/watchdog/nvidia,tegra-wdt-t18x.txt
```
* NVIDIA Tegra18x Watchdog controller

Required properties:

- compatible: Should be "nvidia,tegra-wdt-t18x"
- reg: Should contain WDT and corresponding timer source
  registers location and length.

Optional properties for recovery mode:

- interrupts: interrupt number to the cpu
- nvidia,wdt-cluster-id: ID of the cpu cluster monitored by this WDT instance.
- nvidia,enable-on-init: toggle switch for enable during init
- nvidia,heartbeat-init: default timeout in secs (120 secs if not specified)
- nvidia,shutdown-timeout: timeout in secs during shutdown before watchdog
			reset occurs. same as heartbeat if not specified.
- nvidia,expiry-count: total expiration levels supported by the watchdog.
       Should be 1 if not specified.
- nvidia,extend-watchdog-suspend: Boolean. Extend the disable of watchdog
	timer to syscore suspend and re-eanble on syscore resume. If this
	is selected then do not disable watchdog timer in device suspend
	otherwise disable in device suspend.

Optional properties for debug purpose:

- nvidia,disable-debug-reset:
	Disable system wide debug reset assertion at fourth expiration of the
	counter. WDT debug reset can be intercepted by debug logic, e.g. to
	preserve information. This reset should be enabled if not specified.
- nvidia,disable-por-reset:
	Disable internal full system reset at fifth expiration of the counter.
	WDT POR reset cannot be intercepted and acts as a Power On Reset. This
	reset should be enabled if not specified.

Examples:

watchdog@30c0000 {
       compatible = "nvidia,tegra-wdt-18x";
       reg = <0x0 0x030c0000 0x0 0x10000
              0x0 0x03090000 0x0 0x10000>;
       nvidia,expiry-count = <5>;
       status = "disabled";
};

watchdog@30d0000 {
       compatible = "nvidia,tegra-wdt-18x";
       reg = <0x0 0x030c0000 0x0 0x10000
              0x0 0x030a0000 0x0 0x10000>;
       nvidia,expiry-count = <5>;
       status = "disabled";
};
```

## Documentation/devicetree/bindings/watchdog/palmas-wdt.txt
```
Palmas Watchdog Timer.

Palmas watchdog timer support driver for configuring the watchdog inside
the Palmas series PMICs.

Required properties:
-compatible: Must be "ti,palmas-wdt" or "ti,palmas-watchdog".

Optional properties:
-ti,watchdog-init-timeout: Watchdog initial time period if it need
	to be start during system initialisation without user space.
-ti,watchdog-interrupt-mode: bool, Watchdog timer support two modes, Periodic
	and interrupt mode. Enable interrupt mode with this property. Absence
	of this property will set to periodic mode.

This node should be under the Palmas main node.

Example:
	palmas@58 {
		::::
		watchdog {
			compatible = "ti,palmas-watchdog";
			ti,watchdog-init-timeout = <64>;
			ti,watchdog-interrupt-mode;
		};
		::::
	};
```

## Documentation/devicetree/bindings/watchdog/tegra-wdt.txt
```
* NVIDIA Tegra Watchdog controller

Required properties:

- compatible: Should be "nvidia,tegra-wdt"
- reg: Should contain WDT and corresponding timer source
  registers location and length.

Optional properties:

- interrupts: interrupt number to the cpu
- nvidia,expiry-count: total expiry count of WDT (1 if not specified)
- nvidia,enable-on-init: Toggle switch for enable during init
- nvidia,heartbeat-init: default timeout in secs (120 secs if not specified)
- nvidia,extend-watchdog-suspend: Boolean. Extend the disable of watchdog
	timer to syscore suspend and re-eanble on syscore resume. If this
	is selected then do not disable watchdog timer in device suspend
	otherwise disable in device suspend.

Examples:

watchdog@60005100 {
	compatible = "nvidia,tegra-wdt";
	reg = <0x0 0x60005100 0x0 0x20		/* WDT0 registers */
		0x0 0x60005070 0x0 0x8>;	/* TMR7 registers */
	interrupts = <0 123 0x04>;
	nvidia,expiry-count = <4>;
	status = "disabled";
};
```
