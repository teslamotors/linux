## Documentation/devicetree/bindings/staging/iio/light/cm3217-als.txt
```
* Capella CM3217 ambient light sensor

Required properties:
- compatible: must be "capella,cm3217-siio"
- reg: i2c address of the device. It should be 0x10.
- vdd-supply: regulator supply for the chip

Optional propertied:
- illuminance,integration-time: minimum sampling period in nano seconds.
  default: ""480000""
- illuminance,max-range: maximum range of this sensor's value in SI units.
  default: "78643.2"
- illuminance,resolution: conversion factor from sensor raw units to lux.
  default: "307"
- illuminance,power-consumed: rough estimate of this sensor's power consumption in mA.
  default: "1670"

Example:
	cm3217@10 {
		compatible = "capella,cm3217-siio";
		reg = <0x10>;
		vdd-supply = <&palmas_smps9>;
		illuminance,integration-time = "480000";
		illuminance,max-range = "78643.2";
		illuminance,resolution = "7675";
		illuminance,power-consumed = "1670"; /* milli Watt */
	};
```

## Documentation/devicetree/bindings/staging/iio/light/ltr659-ps.txt
```
* LTR659 proximity sensor

Required properties:
- compatible: must be "lite-on,ltr659"
- reg: i2c address of the device. It is 0x23.
- threshold: threshold of proximity value to detect head near/far from sensor.
- vdd-supply: regulator supply for chip
- vled-supply: regulator supply for led anode.

Example:

	ltr659@23 {
		compatible = "lite-on,ltr659";
		reg = <0x23>;
		threshold = <125>;
		vdd-supply = <&palmas_smps9>;
		vled-supply = <&palmas_smps8>;
	};
```

## Documentation/devicetree/bindings/tegra_hv/tegra_hv.txt
```
* Tegra Hypervisor manager (tegra_hv)

Required properties:
- compatible: Should be "nvidia,tegra-hv".

Optional properties:
- server-to-peers: Array of guest IDs of the peers this guest is server to.
Note that if you use loopbacks at least your guest ID should be included.

Required sub-node:
- queues: configuration about this guest

  Required properties:
  - #address-cells: Should be <1>
  - #size-cells: Should be <0>

  Any other sub-nodes contain each ivc channel configuration; Properties
  required are:
    - reg: ID of the channel (single cell address)
    - peers: Tupple of guest IDs this channel pertains to. If none of them is
    the running guest's ID, then the ivc channel entry is ignored.
    - nframes: Number of queue entries
    - frame-size: Size of each frame in bytes. Note that it's good practice to
    keep this aligned to 16.

Example:
	tegra_hv: hyp {
		compatible = "nvidia,tegra-hv";
		status = "okay";

		server-to-peers = <0 1>;

		queues {
			#address-cells = <1>;
			#size-cells = <0>;

			/* guest 0 <-> guest 1 (frame based) */
			ivc0 {
				reg = <0>;
				peers = <0 1>;
				nframes = <2>;
				frame-size = <50>;
			};

			/* guest 0 <-> guest 1 (comm) */
			ivc1 {
				reg = <1>;
				peers = <0 1>;
				nframes = <4>;
				frame-size = <16>;
			};

			/* guest 0 <-> guest 1 (net) */
			ivc2 {
				reg = <2>;
				peers = <0 1>;
				nframes = <32>;
				frame-size = <1536>;
			};

			/* guest 0 <-> guest 0 (loop) */
			ivc5 {
				reg = <5>;
				peers = <0 0>;
				nframes = <4>;
				frame-size = <16>;
			};

			/* guest 0 <-> guest 0 (loop) */
			ivc6 {
				reg = <6>;
				peers = <0 0>;
				nframes = <4>;
				frame-size = <16>;
			};

		};
	};
```

## Documentation/devicetree/bindings/thermal/max77620-thermal.txt
```
Maxim 77620 thermal sensor

Required Properties:
- maxim,hot-die-threshold-temp: Hot die threshold
	temperature. On reaching this teperature
	thermal_zone device gets updated.

Example:
max77620: max77620@3c {
	compatible = "maxim,max77620";
	reg = <0x3c>;
	interrupts = <0 86 IRQ_TYPE_NONE>;

	maxim,hot-die-threshold-temp = <110000>;
}
```

## Documentation/devicetree/bindings/thermal/userspace-alert.txt
```
* Userspace thermal alert cooling device node

Provides the facility for userspace to know whether a thermal alert
occurred or not for a perticular temperature trip value. This is Supported
by adding a Thermal cooling device.

This cooling device is intended with single trip point.

Required properties:
- compatible:           "userspace-therm-alert";

- cdev-type:		Name of cdev.
  Type: string
  Size: one cell

- #cooling-cells:       Provides cooling device specific information.
  Type: unsigned        Must be at least 2, to represent minimum followed
  Size: one cell        by maximum cooling state.

Optional properties:
- cooling-min-level:    The smallest cooling state.
  Type: unsigned
  Size: one cell

- cooling-max-level:    The largest cooling state.
  Type: unsigned
  Size: one cell

For more information on cooling device refer,
	Documentation/devicetree/bindings/thermal/thermal.txt


Examples:
	userspace-alert {
		compatible = "userspace-therm-alert";
		cdev-type = "userspace-alert";
		cooling-min-state = <0>;
		cooling-max-state = <1>;
		#cooling-cells = <2>;
	};

	thermal-zones {
		Tdiode{
			status = "okay";

			thermal-zone-params {
				governor-name = "pid_thermal_gov";
			};

			trips {
				trip_usr_alert {
					temperature = <60000>;
					type = "passive";
					hysteresis = <1>;
					writable;
				};
			};

			cooling-maps {
				map0 {
					trip = <&{/thermal-zones/Tdiode_tegra/trips/trip_usr_alert}>;
					cdev-type = "userspace-alert";
					cooling-device = <&{/userspace-alert} THERMAL_NO_LIMIT THERMAL_NO_LIMIT>;
				};
			};
		};
```

## Documentation/devicetree/bindings/tty/serial/tegra_hv-comm.txt
```
* Tegra Hypervisor Serial emulation (tegra_hv_comm)

Required properties:
- compatible: Should be "nvidia,tegra-hv-comm"
- ivc: Should contain a tupple containing a reference to the tegra hypervisor
  node and an index of the IVC channel to use

Example:
	tegra_hv_comm {
		compatible = "nvidia,tegra-hv-comm";
		status = "okay";
		/* ivc channel to use definition (second one in tegra_hv) */
		ivc = <&tegra_hv 1>;
	};
```

## Documentation/devicetree/bindings/ufs/ufshcd-pltfrm.txt
```
* Universal Flash Storage (UFS) Host Controller

UFSHC nodes are defined to describe on-chip UFS host controllers.
Each UFS controller instance should have its own node.

Required properties:
- compatible        : compatible list, contains "jedec,ufs-1.1"
- interrupts        : <interrupt mapping for UFS host controller IRQ>
- reg               : <registers mapping>

Optional properties:
- vdd-hba-supply        : phandle to UFS host controller supply regulator node
- vcc-supply            : phandle to VCC supply regulator node
- vccq-supply           : phandle to VCCQ supply regulator node
- vccq2-supply          : phandle to VCCQ2 supply regulator node
- vcc-supply-1p8        : For embedded UFS devices, valid VCC range is 1.7-1.95V
                          or 2.7-3.6V. This boolean property when set, specifies
			  to use low voltage range of 1.7-1.95V. Note for external
			  UFS cards this property is invalid and valid VCC range is
			  always 2.7-3.6V.
- vcc-max-microamp      : specifies max. load that can be drawn from vcc supply
- vccq-max-microamp     : specifies max. load that can be drawn from vccq supply
- vccq2-max-microamp    : specifies max. load that can be drawn from vccq2 supply
- <name>-fixed-regulator : boolean property specifying that <name>-supply is a fixed regulator

- clocks                : List of phandle and clock specifier pairs
- clock-names           : List of clock input name strings sorted in the same
                          order as the clocks property.
- freq-table-hz		: Array of <min max> operating frequencies stored in the same
                          order as the clocks property. If this property is not
			  defined or a value in the array is "0" then it is assumed
			  that the frequency is set by the parent clock or a
			  fixed rate clock source.

- nvidia,enable-rx-calib : Enables rx calibration functionality.
			   It is required for UFS High Speed modes.
- nvidia,enable-x2-config : Enables 2 lane register programming support.
			   Should be enabled if 2 lanes are dedicated to UFS.
- nvidia,enable-hs-mode : Flag to enable UFS High Speed modes.
- nvidia,mask-fast-auto-mode :  Flag to disable fast auto mode.
				When enabled UFS Fast auto mode will not be supported and
				fast mode will be supported.
- nvidia,mask-hs-mode-b : Flag to disable hs_rate_b series.
			  When enabled UFS hs_rate_b series will not be supported and
			  hs_rate_a series will be supported.
- ufs_tegra->max_hs_gear : Flag to set Max UFS HS Gear. Values are defined as below.
			   UFS_HS_G1 = <1>;
			   UFS_HS_G2 = <2>;
		           UFS_HS_G3 = <3>;
- ufs_tegra->max_hs_gear : Flag to set Max UFS PWM Gear. Values are defined as below.
			   UFS_PWM_G1 = <1>;
			   UFS_PWM_G2 = <2>;
			   UFS_PWM_G3 = <3>;
			   UFS_PWM_G4 = <4>;
			   UFS_PWM_G5 = <5>;
			   UFS_PWM_G6 = <6>;
			   UFS_PWM_G7 = <7>;

Note: If above properties are not defined it can be assumed that the supply
regulators or clocks are always on.

Example:
	ufshc@0xfc598000 {
		compatible = "jedec,ufs-1.1";
		reg = <0xfc598000 0x800>;
		interrupts = <0 28 0>;

		vdd-hba-supply = <&xxx_reg0>;
		vdd-hba-fixed-regulator;
		vcc-supply = <&xxx_reg1>;
		vcc-supply-1p8;
		vccq-supply = <&xxx_reg2>;
		vccq2-supply = <&xxx_reg3>;
		vcc-max-microamp = 500000;
		vccq-max-microamp = 200000;
		vccq2-max-microamp = 200000;

		clocks = <&core 0>, <&ref 0>, <&iface 0>;
		clock-names = "core_clk", "ref_clk", "iface_clk";
		freq-table-hz = <100000000 200000000>, <0 0>, <0 0>;
	};
```

## Documentation/devicetree/bindings/usb/nvidia,tegra186-xhci.txt
```
Device tree binding for NVIDIA Tegra XUSB host mode controller (XHCI)
============================

The Tegra xHCI controller complies to xHCI specifications which supports
both USB 2.0 HighSpeed/FullSpeed/LowSpeed and USB 3.0 SuperSpeed protocols.

Required properties:
--------------------
 - compatible: For Tegra186, must contain "nvidia,tegra186-xhci".
 - mboxes: Must contain an entry for the XUSB mailbox channel.
   See ../mailbox/mailbox.txt for details.
 - mbox-names: Must include the following entries:
   - xusb

Required properties for Tegra186:
---------------------------------
 - avddio_usb-supply: 3.3V supply to USB 2.0 pads.
 - avdd_pll_utmip-supply: 1.8V supply to UTMI PLL.
 - hvdd_usb-supply: 1.8V supply to PEX USB 3.0 pads.

 - phys: Must contain an entry for each entry in phy-names.
   See ../phy/phy-bindings.txt for details.
 - phy-names: Should include an entry for each PHY used by the controller.
   Names must be of the form "<type>-<number>" where <type> is one of "utmi",
   "hsic", or "usb3" and <number> is a 0-based index.
   On Tegra186, there may be up to:
   - 3 USB3 PHYs, SuperSpeed (SSTX+/SSTX-/SSRX+/SSRX-) data lines
   - 3 UTMI PHYs, USB 2.0 (D+/D-) data lines
   - 1 HSIC PHYs, HSIC (DATA/STROBE) data lines

Optional properties:
--------------------
 - nvidia,pmc-usb-wakes-disabled: set if platform doesn't support/require waking system from
   suspend with USB events.
 - extcon-cables: OTG support. Must contains an excon-cable entry which detects
   USB ID pin. See ../extcon/extcon-gpio-states.txt for details.
   When the extcon cable state is 1, OTG port will transition to host mode.
 - extcon-cable-names: Must be "id".

Example:
--------
	xhci@3530000 {
		compatible = "nvidia,tegra186-xhci";
		mboxes = <&xusb_mbox>;
		mbox-names = "xusb";
		phys = <&padctl TEGRA_PADCTL_PHY_UTMI_P(0)>, /* USB 2.0 micro-AB, J20 */
			<&padctl TEGRA_PADCTL_PHY_UTMI_P(1)>, /* USB 3.0 STD-A, J19 */
			<&padctl TEGRA_PADCTL_PHY_USB3_P(1)>; /* USB 3.0 STD-A, J19 */
		phy-names = "utmi-0", "utmi-1", "usb3-1";

		avddio_usb-supply = <&spmic_sd3_3v3>;
		avdd_pll_utmip-supply = <&spmic_sd2_1v8>;
		hvdd_usb-supply =  <&spmic_sd2_1v8>;

		extcon-cables = <&vbus_id_extcon 1>;
		extcon-cable-names = "id";
		#extcon-cells = <1>;
	};
```

## Documentation/devicetree/bindings/usb/nvidia,tegra186-xudc.txt
```
Device tree binding for NVIDIA Tegra XUSB device mode controller (XUDC)
============================

The Tegra XUDC controller supports both USB 2.0 HighSpeed/FullSpeed and
USB 3.0 SuperSpeed protocols.

Required properties:
--------------------
 - compatible: For Tegra186, must contain "nvidia,tegra186-xudc".

Required properties for Tegra186:
---------------------------------
 - avdd-usb-supply: 3.3V supply to USB 2.0 pads.
 - dvdd-pex-supply: 1.0V supply to PEX USB 3.0 pads.
 - hvdd-pex-supply: 1.8V high-voltage supply to PEX USB 3.0 pads.
 - dvdd-pex-pll-supply: 1.0V supply to PEX USB 3.0 PLL.
 - hvdd-pex-pll-supply: 1.8V high-voltage supply to PEX PLL.

 - phys: Must contain an entry for each entry in phy-names.
   See ../phy/phy-bindings.txt for details.
 - phy-names: Should include an entry for each PHY used by the controller.
   Names must be "usb2", and "usb3" if support SuperSpeed device mode.
   - "usb3" phy, SuperSpeed (SSTX+/SSTX-/SSRX+/SSRX-) data lines
   - "usb2" phy, USB 2.0 (D+/D-) data lines

Optional properties:
--------------------
 - extcon-cables: OTG support. Must contains an excon-cable entry which detects
   USB VBUS pin. See ../extcon/extcon-gpio-states.txt for details.
   When the extcon cable state is 1, OTG port will transition to device mode.
 - extcon-cable-names: Must be "vbus".

Example:
--------
	xudc@3550000 {
		compatible = "nvidia,tegra186-xudc";
		phys = <&padctl TEGRA_PADCTL_PHY_UTMI_P(0)>, /* USB 3.0 micro-AB, J503 */
			<&padctl TEGRA_PADCTL_PHY_USB3_P(1)>; /* USB 3.0 micro-AB, J503 */
		phy-names = "usb2", "usb3";

		avdd-usb-supply = <&spmic_sd3_3v3>;
		dvdd-pex-supply = <&spmic_ldo7_1v0>;
		hvdd-pex-supply =  <&vdd_1v8_sw>;
		dvdd-pex-pll-supply = <&spmic_ldo7_1v0>;
		hvdd-pex-pll-supply = <&vdd_1v8_sw>;

		extcon-cables = <&vbus_id_extcon 0>;
		extcon-cable-names = "vbus";
		#extcon-cells = <1>;
	};
```

## Documentation/devicetree/bindings/usb/otg-tegra.txt
```
* Nvidia USB tegra otg controller

This file documents the properties used by the tegra-otg driver.

Required properties:
- compatible: Should be similar to "nvidia,tegra132-otg"
- reg: Specify start address and registers count details
- interrupts: Specify the interrupts IRQ info for device

Optional properties:
- nvidia,turn-off-vbus-in-lp0: Specify whether vbus should be powered power during LP0.
- nvidia,enable-y-cable-detection: Enables y-cable detection.
- nvidia,enable-aca-nv-charger-detection: Enables aca-nv-charger detection.
- nvidia,enable-aca-rid-detection: Enables ACA ID resistances detection.
- nvidia,enable-pmu-vbus-detection: Enables vbus detection through PMU.
- nvidia,id-detection-type: Specify how usb id detection type on the platform.
    0 - if detection is through USB controller
    1 - if detection is through PMU extcon
    2 - if enable through sysfs interface.
- nvidia,enable-host-peripheral-transitions: Enables host to peripheral transitions
  and vice versa
- nvidia,enable-xhci-host: Specify whether this port is taken by XUSB.
- extcon-cables: Specify the phandles and index of different extcon needed.
- extcon-cable-names: Specify the cable names needed from extcon.
- usb_vbus-supply: Specify the phandle to the vbus regulator device tree node.
- usb_bat_chg-supply: Specify the phandle of corresponding current regulator device tree node.

Example:
        otg@0x7d000000 {
                compatible = "nvidia,tegra132-otg";
                reg = <0x0 0x7d000000 0x0 0x4000>;
                interrupts = <0 20 0x04>;

                nvidia,enable-y-cable-detection;
                nvidia,enable-pmu-vbus-detection;
                nvidia,id-detection-type = <1>;
                extcon-cables = <&palmas_extcon 0 &palmas_extcon 1>;
                extcon-cable-names = "vbus", "id";
                #extcon-cells = <1>;
                usb_vbus-supply = <&usb0_vbus>;
                status = "okay";
        };
```
