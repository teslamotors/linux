## Documentation/devicetree/bindings/platform/tegra/tegra-hsp.txt
```
* NVIDIA Tegra Hardware Synchronization Primitives (HSP) bindings

Tegra HSP unit is designed to support synchronization among processors on the
SoC for various tasks where shared resources need to be accessed exclusively
or inter-processor communications support.

Required properties:

- compatible: should be "nvidia,tegra186-hsp"

- reg: base address and length of the HSP aperture

- interrupts: interrupts corresponding to interrupt-names

- interrupt-names: where applicable:
  - "doorbell":	CPU doorbell interrupt
  - "sharedN":	shared interrupt number N (N in 0..7)
  - "emptyN":	mailbox number N empty interrupt (N in 0..7)
  - "fullN":	mailbox number N full interrupt (N in 0..7)

- nvidia,doorbell: doorbell identifier of the local doorbell

Symbolic doorbell constants are defined in:
  <dt-bindings/platform/t186/tegra-hsp.h>
```

## Documentation/devicetree/bindings/platform/tegra/tegra-ivc-channel.txt
```
NVIDIA Tegra IVC channel bindings

Each IVC channel represents the unique communication protocol defined
between kernel running on CCPLEX CPUs and remote CPU core. Each IVC
channel has two memory buffers, one for each direction. The RX buffer
is for messages sent by the remote CPU, the TX channel for
messages sent to the remote CPU.

Both IPC memory buffers are have two headers followed by data
frames. The first write header is updated only by the producer and the
second read header is updated only by the consumer. The header and
frame sizes are multiples of 64-byte cache lines.

== IVC channel top-level node ==

List of IVC channels implemented by remote core to talk to CCPLEX.
The top-level node defines the AST region shared by IVC channels below
it.

Required properties:
- #address-cells: Number of address cells in each subnode.
  Must be set to <1>.
- #size-cells: Number of size cells in each subnode.
  Must be set to <0>.

== IVC channel sub nodes ==

Each IVC channel implemented by the remote CPU must be represented as
a separate child node within the top-level node.

Required properties:
- compatible: Should represent the protocol to be used on this IVC channel.
  See other binding documents in this directory for potential values.
  For example:
  "nvidia,tegra186-ivc-protocol-echo" for ivc echo test channel.
- reg: Address of the rx and tx buffers, respectively, inside the IVC region.
  Must be a multiple of 64.
- nvidia,frame-size: Size of the data frame. Must be a multiple of 64.
- nvidia,frame-count: Number of frames in rx or tx buffers.

Optional properties:
- reg-names: Names of the rx and tx buffers, respectively.

Example:

ivc-channels {
	#address-cells = <1>;
	#size-cells = <0>;
	echo@0 {
		compatible = "nvidia,tegra186-ivc-protocol-echo";
		reg = <0x0000>, <0x0480>;
		reg-names = "rx-echo", "tx-echo";
		nvidia,frame-size = <64>;
		nvidia,frame-count = <16>;
	};
}
```

## Documentation/devicetree/bindings/platform/tegra/tegra-sce-ivc.txt
```
NVIDIA Tegra SCE aux CPU, with communication via the "IVC" IPC protocol.

SCE is an aux CPU which talks to CCPLEX over IVC.

The SCE FW implements IVC, and uses HSP IRQs as part of IVC.  The
SCE FW expects AST regions 0/1/2 are already set up for the SCE to
access FW in DRAM, SYSRAM if applicable, and the IVC memory.

== SCE top-level node ==

The SCE core is represented by the top-level node including direct HW resources
such as clocks, resets etc.

Required properties:
- compatible: Should be "nvidia,tegra186-sce-ivc" for T18x.
- reg: Address entries (SCE EVP, SCE PM. SCE CFG BASE, SCE CPU AST,
  SCE DMA AST)
  Formatted as per standard rules for this property.
- reg-names: "sce-evp",  "sce-pm", "sce-cfg", "ast-cpu", "ast-dma"
  as per the reg property.
- clock-names: Names of the clocks required by SCE.
  Must include following entry:
  - sce-apb
- clocks: Should contain an entry for each entry in clock-names.
  See ../clock/clock-bindings.txt for details.
- reset-names: Names of the resets required for SCE.
  Must include following entries:
  - sce-apb
  - sce-nsysporeset
  - sce-nreset
  - sce-dbgresetn
  - sce-presetdbgn
  - sce-actmon
  - sce-pm
  - sce-dma
  - sce-hsp
  - tsctnsce
  - sce-tke
  - sce-gte
  - sce-cfg
- resets: Should contain an entry for each entry in reset-names.
  See ../reset/reset.txt for details.
- nvidia,ivc-channels: List of IVC channel regions.
  For each IVC channel regions (usually, there is only one region):
  - an OF phandle pointing to the list,
  - the region number for Tegra AST,
  - the base address of the region in the remote processor (for address space
    translation),
  - the length of the region in bytes (must be a power of two).
  For IVC channel details, please refer to: ./tegra-ivc-channel.txt

Optional properties:
- nvidia,stream-id: should contain the SMMU Stream ID used.

== SCE sub nodes ==

* hsp

Describes the hardware synchronization primitive(s) used between CCPLEX
and SCE to signal incoming IVC messages or IVC write room.

Required property:
- compatible: Should match with the device driver implementing the
    cross-processor synchronization primitive.

If the HSP doorbell is used for IVC notifications:

- compatible: "nvidia,tegra186-hsp-doorbell"

- nvidia,hsp-doorbell: <HSP-phandle HSP-ID HSP-DB>
  * HSP is a set of HW synchronization primitives used in Tegra to allow
    multiple processors to share resources and communicate together.
  * HSP-ID is NVIDIA Tegra HSP unique source ID for SCE, used in IPC.
  * HSP-DB is NVIDIA Tegra HSP unique doorbell number allotted to SCE.
    A HSP doorbell allows a set of source agents in Tegra to request the
    attention of specified target agent. In general the agents are processors
    and doorbell used as part of an IPC protocol.
  * For more HSP details, refer: ./tegra-hsp.txt.

If the HSP shared mailbox is used for IVC notifications:

- nvidia,hsp-shared-mailbox: <HSP-phandle MBOX-NUMBER HSP-phandle MBOX-NUMBER...>
  * HSP is a set of HW synchronization primitives used in Tegra to allow
    multiple processors to share resources and communicate together.
  * MBOX-NUMBER is number of shared mailbox pair
  * For more HSP details, refer: ../tegra-hsp.txt.

- nvidia,hsp-shared-mailbox-names:
  Must include following entry:
  - ivc-pair

If the HSP shared mailbox is used for boot synchronization:

- nvidia,hsp-shared-mailbox: <HSP-phandle MBOX-NUMBER...>
- nvidia,hsp-shared-mailbox-names:
  Must include following entry:
  - cmd-pair

== Possible example ==

tegra_sce: rtcpu@b000000 {
	compatible = "nvidia,tegra186-sce-ivc";
	nvidia,stream-id = <TEGRA_SID_RCE>;
	reg =	<0 0xb000000 0 0x1000>,
		<0 0xb1f0000 0 0x40000>,
		<0 0xb230000 0 0x10000>,
		<0 0xb040000 0 0x10000>,
                <0 0xb050000 0 0x10000>;
	reg-names = "sce-evp", "sce-pm", "sce-cfg", "ast-cpu", "ast-dma";
	clocks = <&tegra_car TEGRA186_CLK_SCE_APB>;
	clock-names = "sce-apb";
	resets =
		<&tegra_car TEGRA186_RESET_SCE_APB>,
		<&tegra_car TEGRA186_RESET_SCE_NSYSPORESET>,
		<&tegra_car TEGRA186_RESET_SCE_NRESET>,
		<&tegra_car TEGRA186_RESET_SCE_DBGRESETN>,
		<&tegra_car TEGRA186_RESET_SCE_PRESETDBGN>,
		<&tegra_car TEGRA186_RESET_SCE_ACTMON>,
		<&tegra_car TEGRA186_RESET_SCE_PM>,
		<&tegra_car TEGRA186_RESET_SCE_DMA>,
		<&tegra_car TEGRA186_RESET_SCE_HSP>,
		<&tegra_car TEGRA186_RESET_TSCTNSCE>,
		<&tegra_car TEGRA186_RESET_SCE_TKE>,
		<&tegra_car TEGRA186_RESET_SCE_GTE>,
		<&tegra_car TEGRA186_RESET_SCE_CFG>;
	reset-names =
		"sce-apb",
		"sce-nsysporeset",
		"sce-nreset",
		"sce-dbgresetn",
		"sce-presetdbgn",
		"sce-actmon",
		"sce-pm",
		"sce-dma",
		"sce-hsp",
		"tsctnsce",
		"sce-tke",
		"sce-gte",
		"sce-cfg";
	nvidia,ivc-channels = <&tegra_camera_ivc 0x90000000 0x10000>;

	hsp {
		compatible = "nvidia,tegra186-hsp-mailbox";
		nvidia,hsp-shared-mailbox = <&sce_hsp 1 &sce_hsp 7>;
		nvidia,hsp-shared-mailbox-names = "ivc-pair", "cmd-pair";
	};
};
```

## Documentation/devicetree/bindings/platform/tegra/tegra-wakeup-monitor.txt
```
* Nvidia tegra-wakeup-monitor

Required properties:
- compatible: The driver is compatible with
  "nvidia,tegra_wakeup_monitor"

- nvidia,wifi-wakeup-source : assign the wifi wakeup source.
- nvidia,rtc-wakeup-source : assign the rtc wakeup source.

Example:

tegra_wakeup_monitor {
	compatible = "nvidia,tegra_wakeup_monitor";
	nvidia,wifi-wakeup-source = <6>;
	nvidia,rtc-wakeup-source = <18>;
};
```

## Documentation/devicetree/bindings/platforms/tegra/jetson-tk1-board-info.txt
```
Jetson TK1 Board Info
~~~~~~~~~~~~~~~~~~~~~

This document describes various DT properties under board_info for NVIDIA
Tegra based Jetson TK1 development platform.

board_info DT node shows up in proc fs in:
	/proc/device-tree/chosen/board_info

Properties description:
- id: Board ID. For Jetson TK1 this property should be 0x177.
- bom: BOM version of the board in ASCII value.
- major_revision: Major revision of the board in ASCII value.
- minor_revision: Minor revision of the board in hexadecimal.
- name: This will give the Board name, i.e., NVIDIA Jetson TK1.
- sku: SKU information.
```

## Documentation/devicetree/bindings/power/bq2477x-charger.txt
```
bq2477x charger
~~~~~~~~~~~~~~~

Required properties :
 - compatible : should contain "ti,bq2477x".
 - ti,dac-ichg : Charge current that must be programmed
 - ti,dac-v : The maximum charge voltage that must be programmed
 - ti,dac-minsv : The minimum System voltage that must be programmed
 - ti,dac-iin : The input current that must be programmed
 - ti,wdt-refresh-timeout : watch dog timer that must be programmed
 - charger-detect-gpio : the GPIO used for AC adapter detection
 - ti,charger-detect-gpio-active-low : The flag that determines if AC adapter
	presence is indicated by active low. Set this to 1 if active low
	indicates adapter is present, else 0.

Example:

	bq2477x@6a {
		compatible = "ti,bq2477x";
		reg = <0x6a>;
		ti,dac-ichg = <2240>;
		ti,dac-v = <9008>;
		ti,dac-minsv = <4608>;
		ti,dac-iin = <4992>;
		ti,wdt-refresh-timeout = <40>;
		charger-detect-gpio = <&gpio 85 0>;
		ti,charger-detect-gpio-active-low = <1>;
	 };
```

## Documentation/devicetree/bindings/power/power_supply_extcon.txt
```
* power_suppl_extcon devicetree bindings
This driver responsible for generating UI notification fro USB and AC
power supply.

Required properties:
- compatible : Must be "power-supply-extcon"

Required properties:
-------------------
- extcon-cables: Extcon device handles.
- extcon-cable-names: name of power supply cables. Must be:
		"usb-charger", "ta-charger", "qc2-charger", "maxim-charger",
		"fast-charger", "slow-charger", "downstream-charger"
		"apple-500ma", "apple-1a", "apple-2a", "y-cable"

Optional properties:
-------------------
- power-supply,extcon-dev: Extcon device name for the charger cables.
- power-supply,y-cable-extcon-dev: extcon device name for the y-cable.

Example:
	psy_extcon {
		compatible = "power-supply-extcon";
		extcon-cables = <&ehanlde 0> <&ehandle 1> ...;
		extcon-cable-names = "usb-charger", "ta-charger", ...;
	};
```

## Documentation/devicetree/bindings/power_supply/bq27441_battery.txt
```
bq27441 battery
~~~~~~~~~~~~~~~~

Required properties :
 - compatible : Should contain "ti,bq27441".
 - ti,tz-name : Thermal zone name.
Optional properties :
 - ti,design-capacity : The designed battery capacity used for
   gauge's predictions. in mAh.
 - ti,design-energy : The designed battery energy. in mWh.
 - ti,taper-rate : The current threshold below which your charger
   IC is set to stop charging once it considers the battery to be
   full. in mA.
 - ti,terminate-voltage : Should be set to the minimum operating
   voltage of your system. This is the target where the gauge
   typically reports 0% capacity. in mV.
 - ti,v-at-chg-term : Voltage at charge termination. in mV.
 - ti,kernel-threshold-soc: Minimum SoC for kernel read from device.
        Bootloader jumps to kernel when SoC is more than this value.
        Driver make this SoC as 0% before reporting it to the framework.
 - ti,kernel-maximum-soc: Maximum SoC for kernel read from device.
        Kernel read maximum SoC from device for given battery. Kernel
        translate the SoC to 100% before reporting to framework if it
        reads equal/more than this value.
 - ti,enable-temp-prop:should enable temp prop if platform supports
        battery temp reading through fuel gauge chip or ADC channel.

Note:
Battery current monitoring:
	Driver supports the battery current monitoring through IIO interface
	and if platform supports it then following properties are required to
	enable it as per iio-binding.txt.

	io-channels = <&ina3221x INA3221_CHAN_INDEX(0, CURRENT, NORMAL)>;
	io-channel-names = "battery-current";

	Here iio-channel name for battry current is "battery-current".

Vbus input power monitoring:
        Driver supports the vbus input power monitoring through IIO interface
        and if platform supports it then following properties are required to
        enable it as per iio-binding.txt.

        io-channels = <&ina3221x INA3221_CHAN_INDEX(1, POWER, NORMAL)>;
        io-channel-names = "vbus-input-power";

        Here iio-channel name for battry current is "vbus-input-power".

Example:

	bq27441@55 {
		compatible = "ti,bq27441";
		ti,design-capacity = <7800>;
		ti,design-energy = <28314>;
		ti,taper-rate = <167>;
		ti,terminate-voltage = <3150>;
		ti,v-at-chg-term = <4200>;
		ti,tz-name = "battery-temp";
		ti,kernel-threshold-soc = <5>;
		ti,kernel-maximum-soc = <99>;
	};
```

## Documentation/devicetree/bindings/power_supply/power_supply_extcon.txt
```
power_supply_extcon
~~~~~~~~~~~~~~~~
Required properties :
 - compatible : Should contain "power-supply-extcon".
 - power-supply,extcon-dev: Extcon device name.

Example:
	psy_extcon {
		compatible = "power-supply-extcon";
		power-supply,extcon-dev = "udc-extcon";
	};
```

## Documentation/devicetree/bindings/regulator/max15569-regulator.txt
```
MAX15569 Voltage regulators

Required properties:
- compatible: Must be one of the following.
	"maxim,max15569",
	"maxim,max16989",
- reg: I2C slave address
- regulator-max-microvolt: largest voltage consumers may set


Optional properties:
- enable-gpio: Enable GPIO for regulator.

Any property defined as part of the core regulator binding, defined in
regulator.txt, can also be used.

Example:
	max16989@38 {
		compatible = "maxim,max16989";
		reg = <0x38>;
		regulator-name = "max16989-vdd-gpu";
		regulator-min-microvolt = <500000>;
		regulator-max-microvolt = <1500000>;
		enable-gpio = <&gpio TEGRA_GPIO(R, 2) 0>;
		regulator-enable-ramp-delay = <210>;
		consumers {
			c1 {
				regulator-consumer-supply = "vdd_gpu";
			};
		};
	};
```
