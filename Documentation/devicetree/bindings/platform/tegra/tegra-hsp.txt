## Documentation/devicetree/bindings/sound/tda7802.txt
```
ST TDA7802 audio processor

This device supports I2C only.

Required properties:

- compatible : "st,tda7802"
- reg : the I2C address of the device
- enable-supply : a regulator spec for the PLLen pin

Optional properties:

- st,gain-ch13 : gain for channels 1 and 3 (range: 1-4)
- st,gain-ch24 : gain for channels 2 and 3 (range: 1-4)
- st,diagnostic-mode-ch13 : diagnotic mode for channels 1 and 3
                            values: "Speaker" (default), "Booster"
- st,diagnostic-mode-ch24 : diagnotic mode for channels 2 and 4
                            values: "Speaker" (default), "Booster"

Example:

amp: tda7802@6c {
	compatible = "st,tda7802";
	reg = <0x6c>;
	enable-supply = <&amp_enable_reg>;
};
```

## Documentation/devicetree/bindings/sound/tegra-adsp.txt
```
Tegra ADSP bindings
-------------------

The Audio DSP (ADSP) handles audio related modules.

Required properties:
 - compatible:			should be set to "nvidia,tegra210-adsp" for t210
 - reg:				should contain ADSP registers' location and length
 - nvidia,adsp_mem:		should contain Memory address and sizes of ADSP OS, APP, ARAM
 - nvidia,adsp_unit_fpga:	should be added if ADSP is on Unit-FPGA
 - nvidia,adsp_unit_fpga_reset:	should be added if ADSP is on Unit-FPGA. The first element
				contains the ASSERT value and the second element should
				contain the DEASSERT value. The ASSERT is ignored if the
				value is equal to 0.
 - nvidia,adsp-evp-base:	should contain the base EVP address and the size of EVP in bytes

Optional properties:
 - nvidia,adsp_freq: should contain adsp boot up freq, multiple of 51.2 MHz
 - nvidia,ape_freq: should contain ape boot up freq, half of adsp_freq
 - nvidia,ape_emc_freq:	should contain appropriate emc freq w.r.t above
			adsp and ape freq

Example:
	adsp {
	     compatible = "nvidia,tegra210-adsp";
	     reg = <0x0 0x702ef000 0x0 0x1000>, /* AMC */
		   <0x0 0x702ec000 0x0 0x2000>, /* AMISC */
		   <0x0 0x702ee000 0x0 0x1000>, /* ABRIDGE */
		   <0x0 0x702dc800 0x0 0x0>, /* FPGA RESET REG */
		   <0x0 0x01000000 0x0 0x6f2c0000>, /* DRAM MAP1 */
		   <0x0 0x70300000 0x0 0x8fd00000>; /* DRAM MAP2 */
	     nvidia,adsp_mem = <0x80300000 0x01000000>, /* ADSP OS */
			       <0x80B00000 0x00800000>; /* ADSP APP */
	     nvidia,adsp_unit_fpga_reset = <0x0 0x00000040>;
	     nvidia,adsp_mem = <0x80300000 0x1000>;
	     nvidia,adsp_freq = <819000>; /* in KHz */
	     nvidia,ape_freq = <409500>; /* in KHz */
	     nvidia,ape_emc_freq = <102000>; /* in KHz */
	     nvidia,adsp-evp-base = <0x702ef700 0x00000040>;
	};
```

## Documentation/devicetree/bindings/sound/tegra-t18x-adsp.txt
```
Tegra ADSP bindings
-------------------

These are additional bindings compared to exiting ADSP bindings.

Required properties:
 - compatible:			should be set to "nvidia,tegra18x-adsp" for native or
				should be set to "nvidia,tegra18x-adsp-hv" for HV for t18x

Optional properties:
- nvidia,adsp_os_secload: shall be added when boot-loader has securely loaded
	adsp firmware image into carve out memory.

Example:
	adsp {
             compatible = "nvidia,tegra18x-adsp";
	     ...
	     nvidia,adsp_os_secload;
	};
	or
	adsp {
             compatible = "nvidia,tegra18x-adsp-hv";
	     ...
	     nvidia,adsp_os_secload;
	};
```

## Documentation/devicetree/bindings/spi/nvidia,spi-slave-tegra124.txt
```
NVIDIA Tegra124 SPI Slave controller.

Required properties:
- compatible : should be "nvidia,tegra124-spi-slave".
- reg: Should contain SPI registers location and length.
- interrupts: Should contain SPI interrupts.
- nvidia,dma-request-selector : The Tegra DMA controller's phandle and
  request selector for this SPI controller.
- nvidia,clk-pin: Name of the tegra pin selected for controller clock input.
	It is require to disable external clock while programing/resetting
	the controller.

Recommended properties:
- spi-max-frequency: Maximum SPI clocking speed of device in Hz. For slave,
	It must be at least 1.5 times bus rate.

Optional properties:
- nvidia,clock-always-on: Enable clock of spi always.
- nvidia,maximum-dma-buffer-size: Maximum dma buffer size per transfer.
	If this is not available then 16K will be default. The value should
	be unit of byte.
- nvidia,slave-ready-gpio: OUT GPIO from slave to report slave status. This
	GPIO, when asserted, implies slave controller is ready for transaction.
	When this GPIO is de-asserted, the master cannot initiate transaction
	with this slave.

Example:
spi@7000d600 {
	compatible = "nvidia,tegra124-spi-slave";
	reg = <0x7000d600 0x200>;
	interrupts = <0 82 0x04>;
	nvidia,dma-request-selector = <&apbdma 16>;
	spi-max-frequency = <25000000>;
	nvidia,clock-always-on;
	#address-cells = <1>;
	#size-cells = <0>;
	status = "disabled";
	nvidia,slave-ready-gpio = <&gpio TEGRA_GPIO(I, 3) GPIO_ACTIVE_LOW>; /*PI3*/
	nvidia,clk-pin = "gpio_x5_aud_px5";
};
```

## Documentation/devicetree/bindings/spi/nvidia,spi-tegra114.txt
```
NVIDIA Tegra114 SPI controller.

Required properties:
- compatible : should be "nvidia,tegra114-spi".
- reg: Should contain SPI registers location and length.
- interrupts: Should contain SPI interrupts.
- nvidia,dma-request-selector : The Tegra DMA controller's phandle and
  request selector for this SPI controller.

Recommended properties:
- spi-max-frequency: Definition as per
                     Documentation/devicetree/bindings/spi/spi-bus.txt
Optional properties:
- nvidia,clock-always-on: Enable clock of spi always.
- nvidia,polling-mode: Use polling method instead of interrupts
- nvidia,boost-reg-access: In T210 and earlier chips SPI register access
	is dependant on SPI clock frequency. Setting this option would
	allow SPI clock frequency to be boosted. Benefitial when running
	SPI at low frequencies with cpu based transfers. Default false.
- nvidia,disable-runtime-pm: disable runtime power management for SPI.
	SPI uses very low power and runtime pm can be overhead for smaller
	transfers. This option allows disabling runtime pm.
- nvidia,maximum-dma-buffer-size: Maximum dma buffer size per transfer.
	If this is not available then 16K will be default. The value should
	be unit of byte.

spi-client device controller properties:
  Below properties should be defined under 'controller-data' child node
- nvidia,enable-hw-based-cs: (Boolean) Use the HW based CS if enabled.
- nvidia,tx-clk-tap-delay: Delays the clock going out to the external device
  with this tap value.
- nvidia,rx-clk-tap-delay: Delays the clock coming in from the external device
  with this tap value.
- nvidia,cs-setup-clk-count: CS setup timing parameter.
- nvidia,cs-hold-clk-count: CS hold timing parameter.
- nvidia,cs-inactive-cycles: Cycles to be inactive between two packets.
  CS Inactive between packets is disabled if value of this is zero.
- nvidia,clk-delay-between-packets: Clock delay  between packets by keeping
		CS active. For this, it is required to pass the Chip select
		as GPIO.
- nvidia,chipselect-gpio: Chipselect GPIO number as per gpio binding.

Example:
spi@7000d600 {
	compatible = "nvidia,tegra114-spi";
	reg = <0x7000d600 0x200>;
	interrupts = <0 82 0x04>;
	nvidia,dma-request-selector = <&apbdma 16>;
	spi-max-frequency = <25000000>;
	nvidia,clock-always-on;
	#address-cells = <1>;
	#size-cells = <0>;
	status = "disabled";

	<spi-client>@<bus_num> {
		...
		...
		controller-data {
			nvidia,enable-hw-based-cs;
			nvidia,cs-setup-clk-count = <10>;
			nvidia,cs-hold-clk-count = <10>;
			nvidia,rx-clk-tap-delay = <0>;
			nvidia,tx-clk-tap-delay = <16>;
		};
		...
	};
};
```

## Documentation/devicetree/bindings/spi/spidev.txt
```
spidev driver

Required properties:
- compatible : should be "spidev"

Optional properties:
- slave-ready-gpio : Ready/Busy gpio
  Does not use ready/busy pin if this property is not set
- slave-ready-timeout : timeout for slave to be ready (in seconds)
  Default is 5 seconds if Ready/Busy GPIO is specified and this property
  is absent

Example:
spi@0 {
	compatible = "spidev";
	slave-ready-gpio = <&gpio TEGRA_GPIO(C, 2) GPIO_ACTIVE_LOW>;
	slave-ready-timeout = <2>;
};
```
