## Documentation/devicetree/bindings/regulator/max16989-regulator.txt
```
Maxim MAX16989 Automotive Low-voltage 2-channel Step-Down controller.
Device supportss two voltage output and there is 2 sets of registers
for voltage output vout1 and vout2. These outputs are independent and
their input/control pins are also different. Theire is 2 i2c address
for the device, one for vout1 and other for vout2.

The properties defined here is single voltage output. Two nodes are
needed for 22 voltage outputs.

Required properties:
- compatible:	must be "maxim,max16989"
- reg:		The i2c slave address of the regulator.

Any standard regulator properties (Documentation/devicetree/bindings/regulator/
regulator.txt) can be used to configure the voltage output of this device.

Optional properties:
- regulator-voltage-steps: Voltage steps. Must be 10000uV or 12500uV.
	Absence of this property will set voltage steps to 12500mV.
- maxim,enable-clk-spread-spectrum: Boolean, Enable clock 3% spread spectrum.
- maxim,enable-gpio: GPIO number connected to EN pin to enable/disable the
	voltage output.
- maxim,enable-external-fpwm: Boolean, enable extern control FPWM. The
	FPWM will be controlled by SYNC IO control signal.
- maxim,fpwm-sync-gpio: GPIO number connected to SYNC IO pin from Host to
	control the FPWM/SKIP mode. If valid GPIO is provided then external
	control of FPWM will be selected even if property "maxim,enable-
	external-fpwm" is not available.
- maxim,enable-sync-output: Boolean, Enable sync pin as output.
- maxim,tracking-device-i2c-address: I2C address of the MAX20024 which is
	used for LDO4 voltage tracking. If this property is available and
	voltage step is 12500uV then tracking will be enabled.
-maxim,slew-rate: Slew rate configuration for soft start and rising dvs
	in mV/us. Tables are
	Soft startup(mV/us)	Rising DVS (mV/us)	value
		22			22		0
		11			22		1
		5.5			22		2
		11			11		3
		5.5			11		4
		5.5			5.5		5

Maximum voltage is selected from regulator-max-microvolt property. If this
is not provided then it will be assumed that the maximum voltage is the
device supported maximum voltage.

All GPIOs numbers are provided as per the DT binding document
(Documentation/devicetree/bindings/gpio/gpio.txt).

Example:

	max16989@1b {
		compatible = "maxim,max16989";
		reg = <0x1b>;

		regulator-min-microvolt = <935000>;
		regulator-max-microvolt = <1200000>;
		maxim,enable-gpio = <&gpio 20 0>;
	};
```

## Documentation/devicetree/bindings/regulator/max8973-regulator.txt
```
* Maxim MAX8973 Voltage Regulator

Required properties:

- compatible:	must be one of following:
			"maxim,max8973"
			"maxim,max77621".
- reg:		the i2c slave address of the regulator. It should be 0x1b.

Any standard regulator properties can be used to configure the single max8973
DCDC.

Optional properties:
- interrupts: Interrupt number can be provided as detailed on
	Documentation/devicetree/bindings/interrupt-controller/interrupts.txt
- interrupt-flags: Provide interrupt flags as per
	include/dt-bindings/interrupt-controller/irq.h.
-maxim,externally-enable: boolean, externally control the regulator output
		enable/disable.
-maxim,enable-gpio: GPIO for enable control. If the valid GPIO is provided
		then externally enable control will be considered.
-maxim,dvs-gpio: GPIO which is connected to DVS pin of device.
-maxim,dvs-default-state: Default state of GPIO during initialisation.
		1 for HIGH and 0 for LOW.
- maxim,sleep-on-dvs: Boolean, enable sleep control through DVS pin. When
		this property is available then property dvs-default-state
		will tell dvs pin state for active state of the rail.
- maxim,junction-temp-warning: Junction temp thrshold for which warnign
		generated. This is milli-celcius like for 120degC, it is
		120000.
-maxim,enable-remote-sense: boolean, enable reote sense.
-maxim,enable-falling-slew-rate: boolean, enable falling slew rate.
-maxim,enable-active-discharge: boolean: enable active discharge.
-maxim,enable-frequency-shift: boolean, enable 9% frequency shift.
-maxim,enable-bias-control: boolean, enable bias control. By enabling this
		startup delay can be reduce to 20us from 220us.

Example:

	max8973@1b {
		compatible = "maxim,max8973";
		reg = <0x1b>;

		regulator-min-microvolt = <935000>;
		regulator-max-microvolt = <1200000>;
		regulator-boot-on;
		regulator-always-on;
	};
```

## Documentation/devicetree/bindings/regulator/pinmux-fixed-regulator.txt
```
Pinmux Fixed Voltage regulators

Required properties:
- compatible: Must be "regulator-pinmux-fixed".
- pinctrl-names: Nmae of the pincontrol node, must be "enable" and "disable".
- pinctrl-0: The handle of pinmux setting for enabling regulator.
- pinctrl-1: The handle for pinmux setting for disabling regulator.

Optional properties:
- startup-delay-us: startup time in microseconds
- vin-supply: Input supply name.

Any property defined as part of the core regulator binding, defined in
regulator.txt, can also be used.
However a pinmux fixed voltage regulator is expected to have the
regulator-min-microvolt and regulator-max-microvolt to be the same.

Example:
	abc: regulator@0 {
		compatible = "regulator-pinmux-fixed";
		regulator-name = "fixed-supply";
		regulator-min-microvolt = <1800000>;
		regulator-max-microvolt = <1800000>;
		startup-delay-us = <70000>;
		regulator-boot-on;
		vin-supply = <&parent_reg>;
		pinctrl-names = "enable", "disable";
		pinctrl-0 = <&regulator_enable>;
		pinctrl-1 = <&regulator_disable>;
	};


pinmux {
	regulator_enable: enable {
		sdmmc3 {
			::::
		};
		::::
	};

	regulator_disable: disable {
		sdmmc3 {
			::::
		};
		::::
	};
};
```

## Documentation/devicetree/bindings/regulator/pmic-otp-regulator.txt
```
PMIC OTP regulators

Required properties:
- compatible: Must be "regulator-pmic-otp"

Optional properties:
None

Any property defined as part of the core regulator
binding, defined in regulator.txt, can also be used.

Example:

	spmic_ldo3: pmic-otp@0 {
		compatible = "regulator-pmic-otp"
		regulator-name = "spmic-ldo3";
		regulator-min-microvolt = <1800000>;
		regulator-max-microvolt = <1800000>;
		regulator-boot-on;
	};
```

## Documentation/devicetree/bindings/regulator/pwm-regulator.txt
```
pwm regulator bindings

Required properties:
- compatible: Should be "pwm-regulator"
- pwms: OF device-tree PWM specification (see PWM binding pwm.txt)
- voltage-table: voltage and duty table, include 2 members in each set of
  brackets, first one is voltage(unit: uv), the next is duty(unit: percent)

Any property defined as part of the core regulator binding defined in
regulator.txt can also be used.

Example:
	pwm_regulator {
		compatible = "pwm-regulator;
		pwms = <&pwm1 0 8448 0>;

		voltage-table = <1114000 0>,
				<1095000 10>,
				<1076000 20>,
				<1056000 30>,
				<1036000 40>,
				<1016000 50>;

		regulator-min-microvolt = <1016000>;
		regulator-max-microvolt = <1114000>;
		regulator-name = "vdd_logic";
	};



NVIDIA PWM controlled regulators

Required properties:
- compatible		  : Must be "regulator-pwm".
- pwms			  : Must be pwm-list specified by pwm binding pwm.txt
- regulator-min-microvolt : Must be smallest voltage at pwm duty cycle 0%
- regulator-max-microvolt : Must be largest voltage at pwm duty cycle 100%
			    (must be above min; if equal, then use a fixed
			    regulator)

Optional properties:
- regulator-n-voltages	: number of voltages, if specified implies evenly
			  distributed duty cycle levels; must be at least 2
- voltage-time-sel	: time in microseconds of voltage transition between
                          voltage levels (specified if regulator settling time
                          is independent of voltage change; for regulators with
                          fixed slew-rate use regulator-ramp-delay property)

Control GPIOs specified according to gpio binding in gpio.txt
- enable-gpio		: GPIO to use to enable/disable the regulator
- idle-gpio		: GPIO to use to enter/exit regulator idle mode
- standby-gpio		: GPIO to use to enter/exit regulator standby mode

Any property defined as part of the pwm user binding in pwm.txt.
Any property defined as part of the core regulator binding in regulator.txt.

Example:

	pwm: pwm-controller {
		#pwm-cells = <2>;
	};

	abc_pwm_reg: pwm-regulator {
		compatible = "regulator-pwm";
		pwms = <&pwm 0 3000>;
		regulator-min-microvolt = <1000000>;
		regulator-max-microvolt = <2500000>;

		regulator-name = "vdd-abc-pwm-reg";
		regulator-enable-ramp-delay = <700>;
		regulator-boot-on;

		regulator-n-voltages = <64>;
		voltage-time-sel = <50>;
		enable-gpio = <&gpio0 21 0x0>;
		standby-gpio = <&gpio0 22 0x0>;
	};
```

## Documentation/devicetree/bindings/regulator/tps61280-regulator.txt
```
* TI TPS61280 Voltage Regulator

Required properties:
- compatible:	must be "ti,tps61280".
- reg:		the i2c slave address of the regulator.

Any standard regulator properties (Documentation/binding/regulator/regulator.txt)
can be used to configure the TI TPS61280 Voltage output.

Optional properties:
VSEL Pin control: 
================ 
	Vsel pin is used for multiple functionality like as
		- DVS voltage selection
		- Sleep voltage control
		- Mode selection.
	Based on DT property of node, the desired function is selected.
DVS Voltage selection: As device has two VOUT register, the voltage output
	is selected by VSEL pin. The required properties to configure the
	DVS through VSEL pin is:
	ti,enable-vsel-controlled-dvs: boolean, Enable VSEL for DVS.
	ti,vsel-pin-gpio: GPIO number on which Host has connected to this
			device.
	ti,vsel-pin-default-state: u32, Default state of the VSEL pin
			during boot.

Sleep voltage control: As there is two voltage output registers, it can set
	for normal state vout and sleep state vout. On this case, the host
	can control the normal/sleep state vout via VSEL pin. Required
	properties to configure the sleep through VSEL pin is:
	ti,enable-vsel-controlled-sleep: boolean, Enable VSEL pin for
			Sleep control.
	ti,vsel-pin-default-state: Vsel default state for active mode.

Mode selection: VSEL pin is also used for selecting different mode i.e.
	force PWM vs auto PWM mode. The required properties to configure
	the mode through VSEL pin are:
	ti,enable-vsel-controlled-mode: boolean, enable mode control through
			VSEL pin.
	ti,vsel-pin-gpio: GPIO number on which host connected to this device
			for VSEL pin control.

	If property "ti,enable-vsel-controlled-mode" is not available then
	property "ti,vsel-pin-gpio" is not used and mode control is done via
	register access ia I2C.
	If property "ti,enable-vsel-controlled-mode" is available then
	mode control is done via the gpio "ti,vsel-pin-gpio".

Enable pin control:
================== 
	EN pin of device control the enable/disable of the regulator output.
	This pin can be controlled by host. The required properties for
	configuring regulator control via EN pin are:
	ti,enable-en-pin-control: Boolean, enable EN pin control.
	ti,en-pin-gpio: Enable pin GPIO to which host is connected.

	If property "ti,enable-en-pin-control" is not there then there is no
	meaning of property "ti,en-pin-gpio" and regulator is controlled by
	register access through I2C.
	If property "ti,enable-en-pin-control" is available then regulator
	enable/disable is done via toggling gpio "ti,en-pin-gpio".

	EN pin:
		HIGH: Regulator enable.
		LOW: Regulator disable.


nBYP pin (Bypass) control:
========================= 
	Bypass mode is controlled through the register configuration as well
	as via the nBYP pin. If bypass mode is controlled through nBYP pin
	then following properties are required:
	ti,enable-bypass-pin-control: Boolean, enable bypass pin control.
	ti,bypass-pin-gpio: Bypass pin GPIO to which host is connected.

	If property "ti,enable-bypass-pin-control" is not there then property
	"ti,bypass-pin-gpio" is not used and bypass configuration is done
	through register access via I2C.
	If property "ti,enable-bypass-pin-control" is there then bypass
	configuration is done via toggling gpio "ti,bypass-pin-gpio"

	Bypass OFF:
		nBYP LOW: pin is LOW
		device active in forced pass-through mode.
	Bypass ON:
		nByp high: Pin is HIGH
		device active in auto mode (dc/dc boost, pass through)

Example:

	tps61280@75 {
		compatible = "ti,tps61280";
		reg = <0x75>;
		regulator-name = "vdd-modem";
		regulator-min-microvolt = <3500000>;
		regulator-max-microvolt = <4000000>;
		regulator-init-microvolt = <3600000>;
		regulator-boot-on;
		regulator-always-on;
		regulator-bypass-on;

		ti,enable-en-pin-control;
		ti,en-pin-gpio = <&gpio TEGRA_GPIO(E, 0), 0>;

		ti,enable-bypass-pin-control;
		ti,bypass-pin-gpio = <&gpio TEGRA_GPIO(E, 5), 0>;

		ti,enable-vsel-controlled-mode;
		ti,vsel-pin-gpio = <&gpio TEGRA_GPIO(E, 1), 0>;
	};
```

## Documentation/devicetree/bindings/regulator/tps65132.txt
```
TPS65132 regulators

Required properties:
- compatible: "ti,tps65132"
- reg: I2C slave address

Optional Subnode:
Device supports two regulators OUTP and OUTN. A sub node within the
   device node descrbe the properties of these regulators. The sub-node
   names must be as follows:
	-For regulator outp, the sub node name should be "outp".
	-For regulator outn, the sub node name should be "outn".

-ti,enable-gpio: Regulators are controlled by the input pins. If
   it is connected to GPIO through host system then provide the
   gpio number as per gpio.txt.
-ti,disable-active-discharge: Boolean, presence of this property
   will disable active discharge on the regulator output.
-ti,active-discharge-gpio: Some configurations use delay mechanisms
  on the enable pin, to keep the regulator enabled for some time after
  the enable signal goes low. This GPIO is used to actively discharge
  the delay mechanism. Requires specification of ti,active-discharge-time
-ti,active-discharge-time: how long the active discharge gpio should be
  asserted for during active discharge, in microseconds.

Each regulator is defined using the standard binding for regulators.

Example:

	tps65132@3e {
		compatible = "ti,tps65132";
		reg = <0x3e>;

		vin-supply = <&some_reg>;

		outp {
			regulator-name = "outp";
			regulator-boot-on;
			regulator-always-on;
			ti,enable-gpio = <&gpio 23 0>;
		};

		outn {
			regulator-name = "outn";
			regulator-boot-on;
			regulator-always-on;
			ti,enable-gpio = <&gpio 40 0>;
		};
	};
```

## Documentation/devicetree/bindings/regulator/userspace-consumer.txt
```
Userspace consumer regulators

Required properties:
- compatible		: Must be "reg-userspace-consumer".

Optional properties:
- regulator-name: Name of the consumer line.
- regulator-boot-on: Enable regulator on booting.
- regulator-supplies: Supply names for this regualtor. This can be
	multiple strings.

With all supply names, there should be <name>-supply to pass the regulator
handles as defined in regulator.txt.

Example:

	userspace-consumer {
		compatible = "reg-userspace-consumer";

		regulator-name = "gps-consumer";
		regulator-boot-on;
		regulator-supplies = "vdd", "vcc", "vdd-3v3";
		vdd-supply = <&reg1>;
		vcc-supply = <&reg2>;
		vdd-3v3-supply = <&reg3>;
	};
```

## Documentation/devicetree/bindings/sound/nvidia,tegra18x-adast.txt
```
Tegra ADMA AST (ADAST) bindings
-------------------------------

The ADMA AST (ADAST) maps local ADMA addresses to physical
addresses. It can also control properties for those regions.

Required properties:

- None

Optional properties:

- nvidia,adast: should specify ADAST regions with a tuple of u64 values:
  <region_number, region_control, slave_base, mask, master_base>.

  ADMA can specify zero or more AST regions. As 2 out of 8 regions (0 & 1) of
  AST are used by boot-loader, only 6 regions can be specified here.

Examples:

1) nvidia,adast =  <0x0 0x3 0x0 0x00008008 0x0 0x40000000 0x0 0x20000000 0x0 0x40000000>;
2) nvidia,adast =  <0x0 0x3 0x0 0x00008008 0x0 0x40000000 0x0 0x20000000 0x0 0x40000000>,
		   <0x0 0x4 0x0 0x00008008 0x0 0x60000000 0x0 0x10000000 0x0 0x60000000>;
```
