## sound/soc/tegra-alt/Kconfig.t18x
```kconfig
config SND_SOC_TEGRA_ALT_186
        def_bool y
        depends on SND_SOC_TEGRA_ALT
        depends on ARCH_TEGRA_APE
	depends on ARCH_TEGRA_18x_SOC

config SND_SOC_TEGRA186_DSPK_ALT
	tristate "Tegra186 DSPK driver"
	depends on SND_SOC_TEGRA_ALT && SND_SOC_TEGRA_ALT_186
	help
	  Say Y or M if you want to add support for Tegra186 DSPK module.

config SND_SOC_TEGRA186_ASRC_ALT
	tristate "Tegra186 ASRC driver"
	depends on SND_SOC_TEGRA_ALT && SND_SOC_TEGRA_ALT_186
	help
	  Say Y or M if you want to add support for Tegra186 ASRC module.

config SND_SOC_TEGRA186_ARAD_ALT
	tristate "Tegra186 ARAD driver"
	depends on SND_SOC_TEGRA_ALT && SND_SOC_TEGRA_ALT_186
	help
	  Say Y or M if you want to add support for Tegra186 ARAD module.

config SND_SOC_TEGRA_ALT_FORCE_CARD_REG
	tristate "Enable sound card even if audio codec is missing on board"
	depends on SND_SOC_TEGRA_ALT
	help
	  Say Y or M if you want to register the sound card even if audio codec
	  is not connected/present on board.

config SND_SOC_TEGRA_ASOC_MACHINE_T18X_ALT
	tristate "Tegra ASoC machine driver"
	depends on SND_SOC_TEGRA_ALT
	help
	  Say Y or M,
	  if you want to add support for
	  Tegra ASoC
	  machine driver.

config SND_SOC_TEGRA186_XBAR_ALT
	tristate "Tegra186 XBAR driver"
	depends on SND_SOC_TEGRA_ALT && SND_SOC_TEGRA_ALT_186
	help
	  Say Y or M if you want to add support for Tegra186 XBAR module.

config SND_SOC_TEGRA186_AFC_ALT
	tristate "Tegra186 AFC driver"
	depends on SND_SOC_TEGRA_ALT && SND_SOC_TEGRA_ALT_186
	help
	  Say Y or M if you want to add support for Tegra186 AFC module.

config SND_SOC_TEGRA_T186REF_ALT
	tristate "SoC Audio support for T186Ref"
	depends on SND_SOC_TEGRA_ALT
	depends on ARCH_TEGRA_18x_SOC
	select SND_SOC_TEGRA186_XBAR_ALT
	select SND_SOC_TEGRA210_PCM_ALT
	select SND_SOC_TEGRA210_ADMA_ALT
	select SND_SOC_TEGRA210_ADMAIF_ALT
	select SND_SOC_TEGRA210_I2S_ALT
	select SND_SOC_TEGRA210_DMIC_ALT
	select SND_SOC_TEGRA210_AMX_ALT
	select SND_SOC_TEGRA210_ADX_ALT
	select SND_SOC_TEGRA210_MIXER_ALT
	select SND_SOC_TEGRA210_SFC_ALT
	select SND_SOC_TEGRA186_AFC_ALT
	select SND_SOC_TEGRA210_MVC_ALT
	select SND_SOC_TEGRA210_OPE_ALT
	select SND_SOC_TEGRA210_SPDIF_ALT
	select SND_SOC_TEGRA186_ASRC_ALT
	select SND_SOC_TEGRA186_ARAD_ALT
	select SND_SOC_TEGRA186_DSPK_ALT
	select SND_SOC_TEGRA_ASOC_HWDEP_ALT
	select SND_SOC_SPDIF
	select SND_SOC_AD193X
	select SND_SOC_TEGRA_ASOC_MACHINE_T18X_ALT
	help
	  Say Y or M here.

config SND_SOC_TEGRA_T186REF_MOBILE_ALT
        tristate "SoC Audio support for T186Ref Mobile"
        depends on SND_SOC_TEGRA_ALT
        depends on ARCH_TEGRA_18x_SOC
        select SND_SOC_TEGRA186_XBAR_ALT
        select SND_SOC_TEGRA210_PCM_ALT
        select SND_SOC_TEGRA210_ADMA_ALT
        select SND_SOC_TEGRA210_ADMAIF_ALT
        select SND_SOC_TEGRA210_I2S_ALT
        select SND_SOC_TEGRA210_DMIC_ALT
        select SND_SOC_TEGRA210_AMX_ALT
        select SND_SOC_TEGRA210_ADX_ALT
        select SND_SOC_TEGRA210_MIXER_ALT
        select SND_SOC_TEGRA210_SFC_ALT
        select SND_SOC_TEGRA186_AFC_ALT
        select SND_SOC_TEGRA210_MVC_ALT
        select SND_SOC_TEGRA210_OPE_ALT
        select SND_SOC_TEGRA210_SPDIF_ALT
        select SND_SOC_TEGRA210_ADSP_ALT
        select SND_SOC_TEGRA186_ASRC_ALT
        select SND_SOC_TEGRA186_ARAD_ALT
        select SND_SOC_TEGRA186_DSPK_ALT
        select SND_SOC_TEGRA_ASOC_HWDEP_ALT
        select SND_SOC_SPDIF
        select SND_SOC_RT5659
        select SND_SOC_COMPRESS
        select SND_SOC_TEGRA_ASOC_MACHINE_T18X_ALT
        help
          Say Y or M here.

config SND_SOC_TEGRA_T186REF_AUTO_ALT
	tristate "SoC Audio support for T186Ref Automotive"
	depends on SND_SOC_TEGRA_T186REF_ALT
	help
	  Say Y or M here.

config SND_SOC_TEGRA186_ARAD_WAR
	def_bool y
	depends on SND_SOC_TEGRA186_ARAD_ALT
	depends on TEGRA186_AHC

config SND_SOC_TEGRA186_ASRC_WAR
	def_bool n
	depends on SND_SOC_TEGRA186_ASRC_ALT
	depends on SND_SOC_TEGRA186_ARAD_WAR
```

## sound/soc/tegra-virt-alt/Kconfig
```kconfig
config SND_SOC_TEGRA_VIRT_ALT
        tristate "IVC client for Tegra virt audio"
        depends on TEGRA_HV_MANAGER
        help
	  Say Y or M here if you want to add support for tegra virtual ivc communication
	  for audio client. This ivc communication module is common for all virtualized
	  tegra platforms. This is used by both pcm and control interfaces. This module
	  uses hypervisor IVC APIs for communication with audio server.

config SND_SOC_TEGRA_VIRT_T210REF_PCM
	tristate "Tegra210 virt PCM driver"
	depends on TEGRA_HV_MANAGER
	depends on SND_SOC_TEGRA_ALT
	select SND_SOC_TEGRA_VIRT_ALT
	help
	  Say Y or M if you want to add support for Tegra210 para-virtualized PCM audio.
	  The pcm driver exposes a number of playback and capture pcm interfaces. It uses
	  the native pcm driver for dma interface and ivc communication module for ivc.
	  The number of interfaces exposed is configurable via device tree.
```

## sound/soc/tegra-virtual/Kconfig
```kconfig
config SND_SOC_TEGRA_124_OR_LATER
  def_bool y
	depends on ARCH_TEGRA
	depends on ARCH_TEGRA_12x_SOC
	help
		Say Y or M here if the module depends upon tegra124 or later SoC.
		Virtual driver needs this as the driver support is available only
		for T124 or later SoC. For this option to work, all the dependencies
		should be selected in defconfig file.

config SND_SOC_TEGRA124_VIRT_APBIF_SLAVE
	tristate "Tegra124 APBIF slave"
	depends on SND_SOC_TEGRA_124_OR_LATER
	depends on MACH_P1859
	help
		Say Y or M if you want to add support for Tegra124 APBIF slave module.
		APBIF_SLAVE module exposes only apbif dai links to apbdma. This module
		can be build independent of APBIF_MASTER module. This module provides
		a pcm interface to slave card in audio virtualization use case.

config SND_SOC_TEGRA_VIRT_VCM30T124_SLAVE
	tristate "SoC Audio Slave for VCM30_T124"
	depends on TEGRA20_APB_DMA
	depends on MACH_P1859
	depends on SND_SOC_TEGRA_ALT
	select SND_SOC_TEGRA124_VIRT_APBIF_SLAVE
	select SND_SOC_SPDIF
	help
		Say Y or M here if you want to add slave interface for SoC audio on the
		TEGRA. This option automatically selects all the required dependancies.
		pcm driver is selected from tegra-alt. Selecting APBIF_SLAVE option
		enables apbif dai link interface.
```

## sound/soc/tegra/Kconfig
```kconfig
config TEGRA_ALSA
    tristate "Tegra ALSA SoC support"
    select TEGRA_PCM
    select TEGRA_I2S
    select TEGRA_IEC
    select SND_SOC_WM8903
    select TEGRA_ALSA_SPDIF
    help
       Say Y if you for ALSA SoC support

config TEGRA_PCM
    tristate "Tegra ALSA pcm callbacks"

config TEGRA_I2S
    tristate "Tegra I2S"

config TEGRA_IEC
    tristate "Tegra IEC"

config TEGRA_ALSA_SPDIF
	depends on TEGRA_PCM
	default n
	tristate "Tegra ALSA spidf callbacks"
```
