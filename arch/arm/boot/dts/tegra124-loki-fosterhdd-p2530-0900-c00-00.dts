#include "tegra124-loki-foster-p2530-0900-c00-00.dts"
#include "tegra124-platforms/tegra124-loki-fosterhdd-pinmux.dtsi"
/ {
	model = "NVIDIA Tegra124 Foster HDD";
	compatible = "nvidia,foster_hdd", "nvidia,tegra124";
	nvidia,dtsfilename = __FILE__;

	firmware {
		android {
			compatible = "android,firmware";
			hardware = "foster_hdd";
		};
	};

	sata@70020000 {
		status = "okay";
		nvidia,enable-sata-port;
		avdd_sata-supply = <&palmas_ldo1>;
		vdd_sata-supply = <&palmas_ldo1>;
		avdd_sata_pll-supply = <&palmas_ldo1>;
		vddio_pex_sata-supply = <&en_battery>;
		hvdd_sata-supply = <&palmas_ldousb>;
	};
};
