/*
 * arch/arm/boot/dts/tegra124-platforms/tegra124-tn8-sysedp-p1761-1270-a02.dtsi
 *
 * Copyright (c) 2014, NVIDIA CORPORATION.  All rights reserved.
 *
 * This program is free software; you can redistribute it and/or modify
 * it under the terms of the GNU General Public License as published by
 * the Free Software Foundation; either version 2 of the License, or
 * (at your option) any later version.
 *
 * This program is distributed in the hope that it will be useful, but WITHOUT
 * ANY WARRANTY; without even the implied warranty of MERCHANTABILITY or
 * FITNESS FOR A PARTICULAR PURPOSE.  See the GNU General Public License for
 * more details.
 *
 * You should have received a copy of the GNU General Public License along
 * with this program; if not, write to the Free Software Foundation, Inc.,
 * 51 Franklin Street, Fifth Floor, Boston, MA  02110-1301, USA.
 */

/ {
	sysedp_batmon_calc {
		compatible = "nvidia,tegra124-sysedp_batmon_calc";
		ocv_lut = <
			100 4322580
			80  4084489
			60  3913651
			40  3795200
			20  3700276
			0   3500000
		>;
		ibat_lut = <
			600    9000
			(-600) 9000
			(-700) 0
		>;
		rbat_data = <
			72791   70672	72791	75700	85728	116919	165041  165041
			73475   71419	73475	75596	86514	117962	166483  166483
			74120   72271	74120	76054	85003	111170	147732  147732
			75918   74353	75918	77798	84506	104306	124140  124140
			80401   79414	80401	82015	88251	109222	130859  130859
			92639   92901	92639	95380	102391	126756	152289  152289
		>;
		temp_axis = <600 450 300 230 150 50 0 (-100)>;
		capacity_axis = <100 80 60 40 20 0>;
		power_supply = "battery";
		r_const = <40000>;
		vsys_min = <3000000>;
		status = "disabled";
	};
};
