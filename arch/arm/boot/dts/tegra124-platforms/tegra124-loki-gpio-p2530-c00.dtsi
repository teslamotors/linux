#include <dt-bindings/gpio/tegra-gpio.h>

/ {
	gpio: gpio@6000d000 {
		gpio-init-names = "default";
		gpio-init-0 = <&gpio_default>;

		gpio_default: default {
			gpio-input = <TEGRA_GPIO(X, 3)
					TEGRA_GPIO(W, 3)
					TEGRA_GPIO(V, 0)
					TEGRA_GPIO(V, 1)
					TEGRA_GPIO(O, 5)
					TEGRA_GPIO(CC, 2)
					TEGRA_GPIO(G, 0)
					TEGRA_GPIO(G, 1)
					TEGRA_GPIO(G, 2)
					TEGRA_GPIO(G, 3)
					TEGRA_GPIO(J, 0)
					TEGRA_GPIO(J, 2)
					TEGRA_GPIO(K, 2)
					TEGRA_GPIO(I, 5)
					TEGRA_GPIO(I, 6)
					TEGRA_GPIO(I, 1)
					TEGRA_GPIO(C, 7)
					TEGRA_GPIO(I, 0)
					TEGRA_GPIO(Q, 0)
					TEGRA_GPIO(Q, 5)
					TEGRA_GPIO(S, 4)
					TEGRA_GPIO(S, 6)
					TEGRA_GPIO(S, 7)
					TEGRA_GPIO(R, 2)
					TEGRA_GPIO(R, 4)
					TEGRA_GPIO(R, 6)
					TEGRA_GPIO(R, 7)
					TEGRA_GPIO(S, 0)
					TEGRA_GPIO(U, 0)
					TEGRA_GPIO(U, 2)
					TEGRA_GPIO(U, 5)
					TEGRA_GPIO(N, 7)
					TEGRA_GPIO(K, 6)>;
			gpio-output-low = <TEGRA_GPIO(O, 6)
					TEGRA_GPIO(BB, 3)
					TEGRA_GPIO(BB, 6)
					TEGRA_GPIO(H, 0)
					TEGRA_GPIO(H, 5)
					TEGRA_GPIO(H, 7)
					TEGRA_GPIO(K, 1)
					TEGRA_GPIO(K, 4)
					TEGRA_GPIO(I, 2)
					TEGRA_GPIO(I, 4)
					TEGRA_GPIO(CC, 5)
					TEGRA_GPIO(V, 3)
					TEGRA_GPIO(R, 0)
					TEGRA_GPIO(R, 1)
					TEGRA_GPIO(O, 1)
					TEGRA_GPIO(S, 2)
					TEGRA_GPIO(S, 3)
					TEGRA_GPIO(S, 5)
					TEGRA_GPIO(EE, 1)
					TEGRA_GPIO(FF, 0)>;
			gpio-output-high = <TEGRA_GPIO(R, 5)
					TEGRA_GPIO(Q, 7)>;
		};
	};
};
