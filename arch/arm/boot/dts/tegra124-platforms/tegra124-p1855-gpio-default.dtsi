/*
 * arch/arm/boot/dts/tegra124-p1855-gpio-default.dtsi
 *
 * Copyright (c) 2013-2014, NVIDIA CORPORATION.  All rights reserved.
 *
 * This program is free software; you can redistribute it and/or modify
 * it under the terms of the GNU General Public License as published by
 * the Free Software Foundation; version 2 of the License.
 *
 * This program is distributed in the hope that it will be useful, but WITHOUT
 * ANY WARRANTY; without even the implied warranty of MERCHANTABILITY or
 * FITNESS FOR A PARTICULAR PURPOSE.  See the GNU General Public License for
 * more details.
 *
 * You should have received a copy of the GNU General Public License along
 * with this program; if not, write to the Free Software Foundation, Inc.,
 * 51 Franklin Street, Fifth Floor, Boston, MA  02110-1301, USA.
 *
 */
#include <dt-bindings/gpio/tegra-gpio.h>
/ {
	gpio: gpio@6000d000 {
		gpio-init-names = "default";
		gpio-init-0 = <&gpio_default>;

		gpio_default: default {
			gpio-input = <  TEGRA_GPIO(W, 2)
					TEGRA_GPIO(V, 0)
					TEGRA_GPIO(V, 1)
					TEGRA_GPIO(K, 0)
					TEGRA_GPIO(K, 1)
					TEGRA_GPIO(J, 2)
					TEGRA_GPIO(K, 4)
					TEGRA_GPIO(K, 2)
					TEGRA_GPIO(I, 3)
					TEGRA_GPIO(I, 6)
					TEGRA_GPIO(I, 2)
					TEGRA_GPIO(I, 5)
					TEGRA_GPIO(DD, 3)
					TEGRA_GPIO(FF, 2)
					TEGRA_GPIO(Q, 0)
					TEGRA_GPIO(Q, 1)
					TEGRA_GPIO(Q, 2)
					TEGRA_GPIO(Q, 3)
					TEGRA_GPIO(Q, 6)
					TEGRA_GPIO(Q, 7)
					TEGRA_GPIO(S, 3)
					TEGRA_GPIO(S, 4)
					TEGRA_GPIO(S, 5)
					TEGRA_GPIO(R, 4)
					TEGRA_GPIO(EE, 1)
					TEGRA_GPIO(N, 7)>;
			gpio-output-low = <TEGRA_GPIO(K, 3)
					TEGRA_GPIO(W, 5)
					TEGRA_GPIO(R, 3)
					TEGRA_GPIO(R, 2)
					TEGRA_GPIO(R, 5)
					TEGRA_GPIO(R, 6)>;
			gpio-output-high = <TEGRA_GPIO(R, 0)
                                       TEGRA_GPIO(N, 5)
                                       TEGRA_GPIO(FF, 1)>;


		};
	};
};
