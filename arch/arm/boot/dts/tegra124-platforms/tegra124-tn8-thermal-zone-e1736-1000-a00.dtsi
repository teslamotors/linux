#include <dt-bindings/thermal/thermal.h>

/ {
	tbat_temp: generic-adc-thermal@1 {
		compatible = "generic-adc-thermal";
		status = "disabled";
		#thermal-sensor-cells = <0>;	
		io-channels = <&palams_gpadc 1>;
		io-channel-names = "sensor-channel";
		adc-temp-lookup-table = "linear-table-min-max-avg";
		lower-temperature = <(-40000)>;
		upper-temperature = <125000>;
		step-temperature = <1000>;
		adc-temperature-map = <2315 2361 2401 2299 2345 2386
					2283 2329 2369 2266 2312 2352
					2248 2294 2335 2230 2276 2316
					2211 2257 2297 2191 2237 2278
					2171 2217 2258 2150 2196 2237
					2129 2175 2215 2107 2153 2193
					2085 2130 2170 2062 2107 2147
					2038 2083 2123 2014 2059 2099
					1990 2034 2074 1964 2008 2048
					1939 1982 2022 1913 1956 1995
					1886 1929 1968 1860 1902 1941
					1832 1874 1913 1805 1846 1884
					1777 1818 1856 1749 1789 1827
					1720 1760 1797 1692 1731 1767
					1663 1701 1737 1634 1672 1707
					1604 1642 1677 1575 1612 1646
					1546 1582 1616 1516 1552 1585
					1487 1522 1554 1457 1491 1524
					1428 1461 1493 1399 1431 1462
					1369 1401 1432 1340 1371 1401
					1311 1342 1371 1283 1312 1341
					1254 1283 1311 1226 1254 1281
					1198 1225 1252 1170 1197 1222
					1143 1169 1193 1116 1141 1165
					1089 1113 1137 1062 1086 1109
					1036 1059 1081 1011 1033 1054
					986 1007 1028 961 982 1002
					936 956 976 912 932 951
					889 908 926 866 884 901
					843 861 877 821 838 854
					799 815 831 778 793 809
					757 772 787 737 751 765
					717 731 744 697 711 724
					678 691 704 659 672 685
					641 654 666 623 635 648
					605 618 630 588 600 613
					571 584 596 555 567 579
					540 551 563 524 536 548
					509 521 532 495 506 517
					481 492 503 467 478 489
					454 464 475 441 451 462
					428 439 449 416 426 437
					404 414 424 392 402 413
					381 391 401 370 380 390
					360 369 379 349 359 369
					340 349 358 330 339 348
					321 330 339 311 320 329
					303 311 320 294 303 311
					286 294 303 278 286 295
					270 278 286 262 270 279
					255 263 271 248 256 264
					241 249 256 234 242 249
					228 235 243 222 229 236
					215 223 230 210 217 224
					204 211 218 198 205 212
					193 199 206 188 194 201
					183 189 195 178 184 190
					173 179 185 168 174 180
					164 170 176 159 165 171
					155 161 167 151 157 162
					147 152 158 143 149 154
					139 145 150 136 141 146
					132 137 143 129 134 139
					125 130 135 122 127 132
					119 124 129 116 121 125
					113 118 122 110 115 119
					107 112 116 105 109 113
					102 106 111 100 104 108
					97 101 105 95 99 103
					92 96 100 90 94 98
					88 92 96 86 89 93
					84 87 91 82 85 89
					80 83 87 78 81 85
					76 79 83 74 77 81
					72 75 79 70 74 77
					69 72 75 67 70 74
					66 69 72 64 67 70
					63 65 69 61 64 67
					60 63 65 58 61 64
					57 60 63 56 58 61
					54 57 60 53 56 58
					52 55 57 51 53 56
					50 52 55 49 51 54>;
	};

	thermal-zones {
		Battery {
			polling-delay = <0>; /* milliseconds */
			polling-delay-passive = <0>; /* milliseconds */
			thermal-sensors = <&tbat_temp>;
			status = "disabled";
		};
	};
};
