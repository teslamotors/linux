/*
 * Copyright (c) 2014, NVIDIA CORPORATION.  All rights reserved.
 *
 * This program is free software; you can redistribute it and/or modify it
 * under the terms and conditions of the GNU General Public License,
 * version 2, as published by the Free Software Foundation.
 *
 * This program is distributed in the hope it will be useful, but WITHOUT
 * ANY WARRANTY; without even the implied warranty of MERCHANTABILITY or
 * FITNESS FOR A PARTICULAR PURPOSE.  See the GNU General Public License for
 * more details.
 */

#include "tegra124-loki-thermal-fan-est.dtsi"

/ {
	thermal-fan-est {
		active_trip_temps = <0 63000 74000 85000 120000
				140000 150000 160000 170000 180000>;
		active_hysteresis = <0 15000 11000 6000 4000
				0 0 0 0 0>;
	};
};
