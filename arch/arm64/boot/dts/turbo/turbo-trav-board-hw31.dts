/*
 * TURBO TRAV HW3.1 board device tree source
 *
 * Copyright (C) 2019 Tesla Inc.
 *
 * This program is free software; you can redistribute it and/or modify
 * it under the terms of the GNU General Public License as published by
 * the Free Software Foundation; version 2 of the License.
 *
 * This program is distributed in the hope that it will be useful,
 * but WITHOUT ANY WARRANTY; without even the implied warranty of
 * MERCHANTABILITY or FITNESS FOR A PARTICULAR PURPOSE. See the
 * GNU General Public License for more details.
 */

/dts-v1/;
#include "turbo-trav-board-rev-b0.dts"

/ {
    /* TURBO-AUD-REL-EN gpio and FAN-TACH gpio have been removed in hw3.1 */
	sound {
    /delete-property/relay-gpio;
    };
    /delete-node/tachometer;
};
