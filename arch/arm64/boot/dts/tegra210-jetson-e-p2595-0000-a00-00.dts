/*
 * arch/arm64/boot/dts/tegra210-jetson-e-p2530-0000-a00-00.dts
 *
 * Copyright (c) 2014-2015, NVIDIA CORPORATION.  All rights reserved.
 *
 * This program is free software; you can redistribute it and/or modify
 * it under the terms of the GNU General Public License as published by
 * the Free Software Foundation; version 2 of the License.
 *
 * This program is distributed in the hope that it will be useful, but WITHOUT
 * ANY WARRANTY; without even the implied warranty of MERCHANTABILITY or
 * FITNESS FOR A PARTICULAR PURPOSE.  See the GNU General Public License for
 * more details.
 *
 */

#include "tegra210-jetson-e-base-p2595-0000-a00.dts"
#include "tegra210-platforms/tegra210-modem-common.dtsi"
#include "tegra210-platforms/tegra210-jetson-e-shim-p2595-0000-a00.dtsi"

/ {
	model = "jetson_e";
	compatible = "nvidia,jetson-e", "nvidia,tegra210";
	nvidia,dtsfilename = __FILE__;

	#address-cells = <2>;
	#size-cells = <2>;

	chosen {
		bootargs = "earlycon=uart8250,mmio32,0x70006000";
		stdout-path = &uarta;
	};

	firmware {
		android {
			compatible = "android,firmware";
			hardware = "jetson_e";
		};
	};
};
