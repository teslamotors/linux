/*
 * T210- VCM3.1
 *
 * arch/arm64/boot/dts/tegra210-vcm31-p2382-0000-a00-00-p2393.dts
 *
 * Copyright (c) 2015, NVIDIA CORPORATION.  All rights reserved.
 *
 * This program is free software; you can redistribute it and/or modify
 * it under the terms of the GNU General Public License as published by
 * the Free Software Foundation; version 2 of the License.
 *
 * This program is distributed in the hope that it will be useful, but WITHOUT
 * ANY WARRANTY; without even the implied warranty of MERCHANTABILITY or
 * FITNESS FOR A PARTICULAR PURPOSE.  See the GNU General Public License for
 * more details.
 *
 * You should have received a copy of the GNU General Public License along
 * with this program; if not, see <http://www.gnu.org/licenses/>.
 */

/dts-v1/;
/memreserve/ 0x80000000 0x00020000;

#include "tegra210-vcm31-p2382-common.dtsi"
#include "tegra210-platforms/tegra210-vcm31-disp-p2382-a00-p2393.dtsi"

/ {
	nvidia,dtsfilename = __FILE__;
};
