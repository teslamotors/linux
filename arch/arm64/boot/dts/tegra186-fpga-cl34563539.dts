/*
 * arch/arm64/boot/dts/tegra186-fpga-cl34563539.dts
 *
 * Copyright (c) 2014, NVIDIA CORPORATION.  All rights reserved.
 *
 * This program is free software; you can redistribute it and/or modify
 * it under the terms of the GNU General Public License as published by
 * the Free Software Foundation; version 2 of the License.
 *
 * This program is distributed in the hope that it will be useful, but WITHOUT
 * ANY WARRANTY; without even the implied warranty of MERCHANTABILITY or
 * FITNESS FOR A PARTICULAR PURPOSE.  See the GNU General Public License for
 * more details.
 *
 * You should have received a copy of the GNU General Public License along
 * with this program; if not, write to the Free Software Foundation, Inc.,
 * 51 Franklin Street, Fifth Floor, Boston, MA  02110-1301, USA.
 *
 */

/*
 * DISCLAIMER: THIS FILE IS AUTO GENERATED. DO NOT MANUALLY EDIT THIS FILE!!!
 */


#include "tegra186-platforms/tegra186-sim-private.dts"
#include "tegra186-platforms/tegra186-fpga-pinmux.dtsi"
#include "tegra186-platforms/tegra186-fpga-fixed-regulator.dtsi"
#include "tegra186-platforms/tegra186-fpga-cl34563539-private.dtsi"

/ {
	/* chosen */
};

