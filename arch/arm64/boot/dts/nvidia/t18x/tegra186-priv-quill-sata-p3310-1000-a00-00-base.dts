/*

 * tegra186-priv-quill-sata-p3310-1000-a00-00-base.dts Quill A00 Board
 *
 * Copyright (c) 2016, NVIDIA CORPORATION.  All rights reserved.
 *
 * This program is free software; you can redistribute it and/or modify
 * it under the terms of the GNU General Public License as published by
 * the Free Software Foundation; version 2 of the License.
 *
 * This program is distributed in the hope that it will be useful, but WITHOUT
 * ANY WARRANTY; without even the implied warranty of MERCHANTABILITY or
 * FITNESS FOR A PARTICULAR PURPOSE.  See the GNU General Public License for
 * more details.
 */

#include "tegra186-priv-quill-p3310-1000-a00-00-base.dts"

/ {
  model = "quill-sata";
  compatible = "nvidia,quill-sata", "nvidia,tegra186";

  nvidia,dtsfilename = __FILE__;
  nvidia,boardids = "3310:0000:A0";
  nvidia,proc-boardid = "3310:0000:A0";

  chosen {
		board-has-eeprom;
    bootargs ="console=ttyS0,115200";
    stdout-path = &uarta;
  };

  firmware {
    android {
      compatible = "android,firmware";
      hardware = "quill-sata";
    };
  };
};
