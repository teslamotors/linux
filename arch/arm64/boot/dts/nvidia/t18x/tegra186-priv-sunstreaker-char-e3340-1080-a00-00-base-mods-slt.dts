/*

 * tegra186-sunstreaker-char-e3340-1080-a00-00-base-mods-slt.dts
	Sunstreaker Char A00 Board
 *
 * Copyright (c) 2015-2016, NVIDIA CORPORATION.  All rights reserved.
 *
 * This program is free software; you can redistribute it and/or modify
 * it under the terms of the GNU General Public License as published by
 * the Free Software Foundation; version 2 of the License.
 *
 * This program is distributed in the hope that it will be useful, but WITHOUT
 * ANY WARRANTY; without even the implied warranty of MERCHANTABILITY or
 * FITNESS FOR A PARTICULAR PURPOSE.  See the GNU General Public License for
 * more details.
 */

#include "tegra186-priv-sunstreaker-char-e3340-1080-a00-00-base.dts"
#include "tegra186-platforms/mods-display.dtsi"
/ {
	nvidia,dtsfilename = __FILE__;

	host1x {
		status = "okay";
	};

};

