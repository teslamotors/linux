/*
 * tegra186-priv-vcm31-p2379-0000-c01-00-base-a-air-cooled.dts:
 *  P2379-C01 TA air-cooled base dts file
 *
 * Copyright (c) 2016, NVIDIA CORPORATION.  All rights reserved.
 *
 * This program is free software; you can redistribute it and/or modify
 * it under the terms of the GNU General Public License as published by
 * the Free Software Foundation; version 2 of the License.
 *
 * This program is distributed in the hope that it will be useful, but WITHOUT
 * ANY WARRANTY; without even the implied warranty of MERCHANTABILITY or
 * FITNESS FOR A PARTICULAR PURPOSE.  See the GNU General Public License for
 * more details.
 */

#include "tegra186-priv-vcm31-p2379-0000-c01-00-base-a.dts"

/ {
	nvidia,dtsfilename = __FILE__;
	cooling-type = "air";

	thermal-fan-est {
		active_trip_temps = <0 80000 90000 95000 100000
				110000 150000 160000 170000 180000>;
		active_hysteresis = <0 15000 10000 5000 5000
				10000 0 0 0 0>;
	};

	pwm_fan_shared_data: pfsd {
		state_cap = <4>; /* Cap pwm max to 256 = active_pwm[4] */
	};

	pwm-fan {
		/* duty =    <0 20 55  80  100 100 100 100 100 100>; */
		active_pwm = <0 51 141 205 256 256 256 256 256 256>;
	};
};
