/*
 * tegra186-vcm31-p2382-010-a01-00-base.dts: P2382(sunstreaker) base dts
 *
 * Copyright (c) 2015, NVIDIA CORPORATION.  All rights reserved.
 *
 * This program is free software; you can redistribute it and/or modify
 * it under the terms of the GNU General Public License as published by
 * the Free Software Foundation; version 2 of the License.
 *
 * This program is distributed in the hope that it will be useful, but WITHOUT
 * ANY WARRANTY; without even the implied warranty of MERCHANTABILITY or
 * FITNESS FOR A PARTICULAR PURPOSE.  See the GNU General Public License for
 * more details.
 */

#include "tegra186-priv-vcm31-p2382-010-a01-00-base.dts"
#include "tegra186-vcm31-p2382-common.dtsi"

/ {
	nvidia,dtsfilename = __FILE__;
};
