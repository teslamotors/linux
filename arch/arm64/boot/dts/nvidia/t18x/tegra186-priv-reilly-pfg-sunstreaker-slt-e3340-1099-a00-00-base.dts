/*
 * tegra186-priv-reilly-pfg-sunstreaker-slt-e3340-1099-a00-00-base.dts:
 *		Reilly PFG Sunstreaker SLT.
 *
 * Copyright (c) 2016 NVIDIA CORPORATION.  All rights reserved.
 *
 * This program is free software; you can redistribute it and/or modify
 * it under the terms of the GNU General Public License as published by
 * the Free Software Foundation; version 2 of the License.
 *
 * This program is distributed in the hope that it will be useful, but WITHOUT
 * ANY WARRANTY; without even the implied warranty of MERCHANTABILITY or
 * FITNESS FOR A PARTICULAR PURPOSE.  See the GNU General Public License for
 * more details.
 */

#include "tegra186-priv-sunstreaker-slt-e3340-1099-a00-00-base.dts"
#include "tegra186-prod/tegra186-priv-reilly-pfg-sunstreaker-slt-e3340-1099-a00-prod.dtsi"

/ {
	nvidia,dtsfilename = __FILE__;

	cpus {
		/delete-node/ denver_core_power_states;
		/delete-node/ denver_cluster_power_states;
		/delete-node/ denver_crossover_thresholds;

		cpu@0 {
			status = "disabled";
			/delete-property/ cpu-idle-states;
		};
		cpu@1 {
			status = "disabled";
			/delete-property/ cpu-idle-states;
		};
	};

};
