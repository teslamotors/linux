/*
 * tegra186-priv-vcm31-e3340-flashing-base.dts: sunstreaker-char flashing dts
 *
 * Copyright (c) 2016, NVIDIA CORPORATION.  All rights reserved.
 *
 * This program is free software; you can redistribute it and/or modify
 * it under the terms of the GNU General Public License as published by
 * the Free Software Foundation; version 2 of the License.
 *
 * This program is distributed in the hope that it will be useful, but WITHOUT
 * ANY WARRANTY; without even the implied warranty of MERCHANTABILITY or
 * FITNESS FOR A PARTICULAR PURPOSE.  See the GNU General Public License for
 * more details.
 */

#include "tegra186-priv-sunstreaker-char-e3340-1080-a00-00-base.dts"

/ {
	nvidia,dtsfilename = __FILE__;
};
