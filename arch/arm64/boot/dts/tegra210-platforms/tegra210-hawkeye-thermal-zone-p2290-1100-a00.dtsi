#include <dt-bindings/thermal/thermal.h>

/ {
	tbat_temp: generic-adc-thermal@1 {
		compatible = "generic-adc-thermal";
		#thermal-sensor-cells = <0>;
		io-channels = <&ads1015 5 &ads1015 7>;
		io-channel-names = "sensor-channel", "ref-channel";
		adc-temp-lookup-table = "linear-table-ref-channel";
		lower-temperature = <(-40000)>;
		upper-temperature = <125000>;
		step-temperature = <1000>;
		adc-temperature-map = <56978 56824 56631 56477 56284
				56091 55898 55706 55474 55282
				55050 54780 54549 54279 54009
				53740 53431 53161 52853 52506
				52197 51851 51504 51157 50771
				50386 50000 49576 49191 48766
				48304 47880 47417 46955 46492
				45991 45528 45027 44526 43986
				43485 42945 42406 41866 41288
				40748 40170 39630 39052 38473
				37895 37317 36700 36122 35544
				34965 34349 33770 33192 32575
				31997 31419 30840 30262 29684
				29106 28527 27988 27448 26870
				26330 25829 25289 24749 24248
				23747 23207 22745 22244 21743
				21280 20817 20355 19892 19429
				19005 18581 18157 17733 17309
				16924 16538 16153 15767 15420
				15035 14688 14341 13994 13685
				13339 13030 12722 12413 12105
				11835 11565 11257 11025 10756
				10486 10254 9985 9753 9522
				9291 9059 8867 8635 8443
				8250 8057 7864 7672 7479
				7325 7132 6978 6823 6669
				6515 6361 6207 6052 5937
				5783 5667 5513 5397 5281
				5166 5050 4934 4819 4703
				4588 4510 4395 4279 4202
				4125 4009 3932 3855 3739
				3662 3585 3508 3431 3354
				3315 3238 3161 3084 3045
				2968>;
	};

	thermal-zones {
		Battery {
			polling-delay = <0>; /* milliseconds */
			polling-delay-passive = <0>; /* milliseconds */
			thermal-sensors = <&tbat_temp>;
			status = "okay";
		};
	};
};
