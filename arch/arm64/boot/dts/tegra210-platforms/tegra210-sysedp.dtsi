/*
 * arch/arm/boot/dts/tegra210-platforms/tegra210-sysedp.dtsi
 *
 * Copyright (c) 2014-2015, NVIDIA CORPORATION. All rights reserved.
 *
 * This program is free software; you can redistribute it and/or modify it
 * under the terms and conditions of the GNU General Public License,
 * version 2, as published by the Free Software Foundation.
 *
 * This program is distributed in the hope it will be useful, but WITHOUT
 * ANY WARRANTY; without even the implied warranty of MERCHANTABILITY or
 * FITNESS FOR A PARTICULAR PURPOSE.  See the GNU General Public License for
 * more details.
 *
 * You should have received a copy of the GNU General Public License
 * along with this program.  If not, see <http://www.gnu.org/licenses/>.
 */

/ {
	sysedp-dynamic-capping {
		/* 671D */
		compatible = "nvidia,tegra124-sysedp-dynamic-capping";
		nvidia,gpu_cap_as_mw;
		nvidia,gpu_supp_freq;
		nvidia,corecap = <
			8000     3000  3000 1600000   3000   3000 1600000    1654   77   77
			9000     3000  3000 1600000   3000   3000 1600000    1654   77   77
			10000    3000  4000 1600000   3000   4000 1600000    2150  154  154
			11000    5000  4000 1600000   3000   5000 1600000    2645  154  230
			12000    5000  4000 1600000   3000   6000 1600000    3042  154  307
			13000    6000  5000 1600000   3000   7000 1600000    3637  230  384
			14000    7000  5000 1600000   3000   8000 1600000    4133  230  461
			15000    7000  6000 1600000   4000   8000 1600000    4519  307  461
			16000    7000  7000 1600000   4000   9000 1600000    5014  384  538
			17000    8000  5000 1600000   4000  10000 1600000    4627  230  614
			18000    9000  6000 1600000   4000  11000 1600000    5581  307  691
			19000    9000  6000 1600000   4000  12000 1600000    5581  307  768
			20000    9000  7000 1600000   4000  13000 1600000    6077  384  768
			21000    9000  7000 1600000   4000  14000 1600000    6077  384  845
			22000    9000  8000 1600000   4000  15000 1600000    6573  461  845
			23000    9000  8000 1600000   4000  17000 1600000    6573  461  922
			24000    9000 11000 1600000   5000  17000 1600000    8060  691  922
			25000    9000 11000 1600000   5000  17000 1600000    8060  691  922
			26000    9000 12000 1600000   5000  18000 1600000    8591  768  922
			27000   10000 13000 1600000   5000  19000 1600000    8924  768  922
			28000   12000 13000 1600000   6000  20000 1600000    9634  768  998
			29000   13000 13000 1600000   6000  21000 1600000    9634  768  998
			30000   12000 16000 1600000   6000  21000 1600000    9634  845  998
			31000   14000 16000 1600000   7000  22000 1600000   10559  845  998
			32000   14000 17000 1600000   8000  22000 1600000   10969  922  998
			33000   14000 20000 1600000   8000  22000 1600000   10969  998  998
			34000   15000 20000 1600000   8000  22000 1600000   10969  998  998
			35000   16000 20000 1600000   11000 22000 1600000   12261  998  998
			36000   16000 20000 1600000   13000 22000 1600000   12261  998  998
			37000   16000 20000 1600000   14000 22000 1600000   13746  998  998
		>;
		nvidia,core_gain = <120>;
		nvidia,init_req_watts = <20000>;
	};
};
