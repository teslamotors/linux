/*
 * Copyright (c) 2014-2015 NVIDIA CORPORATION. All rights reserved.
 *
 * This software is licensed under the terms of the GNU General Public
 * License version 2, as published by the Free Software Foundation, and
 * may be copied, distributed, and modified under those terms.
 *
 * This program is distributed in the hope that it will be useful,
 * but WITHOUT ANY WARRANTY; without even the implied warranty of
 * MERCHANTABILITY or FITNESS FOR A PARTICULAR PURPOSE.  See the
 * GNU General Public License for more details.
 *
 */

#include <dt-bindings/clk/tegra210-clk.h>

/ {
	clock {
		t210-clk-init-table {
				compatible = "nvidia,tegra-clk-init-table";
				clkinit-0 = <
				/* clock id                	parent id                   rate	ctrl flags */
				TEGRA210_CLK_ID_HDA		TEGRA210_CLK_ID_PLL_P	    108000000	0
				TEGRA210_CLK_ID_HDA2CODEC_2X 	TEGRA210_CLK_ID_PLL_P	    48000000	0
				TEGRA210_CLK_ID_PWM		TEGRA210_CLK_ID_PLL_P	    48000000	0
				TEGRA210_CLK_ID_I2S0		TEGRA210_CLK_ID_PLL_A_OUT0  12288000	0
				TEGRA210_CLK_ID_I2S1		TEGRA210_CLK_ID_PLL_A_OUT0  0		0
				TEGRA210_CLK_ID_I2S2		TEGRA210_CLK_ID_PLL_A_OUT0  12288000	0
				TEGRA210_CLK_ID_I2S3		TEGRA210_CLK_ID_PLL_A_OUT0  12288000	0
				TEGRA210_CLK_ID_I2S4		TEGRA210_CLK_ID_PLL_A_OUT0  0		0
				TEGRA210_CLK_ID_SPDIF_OUT	TEGRA210_CLK_ID_PLL_A_OUT0  6144000	0
				TEGRA210_CLK_ID_SPDIF_IN	TEGRA210_CLK_ID_PLL_P	    48000000	0
				TEGRA210_CLK_ID_AHUB		TEGRA210_CLK_ID_PLL_A_OUT0  12288000	0
				TEGRA210_CLK_ID_AUDIO1		TEGRA210_CLK_ID_I2S1_SYNC   0		0
				TEGRA210_CLK_ID_AUDIO2		TEGRA210_CLK_ID_I2S2_SYNC   12288000	0
				TEGRA210_CLK_ID_AUDIO3		TEGRA210_CLK_ID_I2S3_SYNC   12288000	0
				TEGRA210_CLK_ID_VI_SENSOR	TEGRA210_CLK_ID_PLL_P	    150000000	0
				TEGRA210_CLK_ID_VI_SENSOR2	TEGRA210_CLK_ID_PLL_P	    150000000	0
				TEGRA210_CLK_ID_CILAB		TEGRA210_CLK_ID_PLL_P	    150000000	0
				TEGRA210_CLK_ID_CILCD		TEGRA210_CLK_ID_PLL_P	    150000000	0
				TEGRA210_CLK_ID_CILE		TEGRA210_CLK_ID_PLL_P	    150000000	0
				TEGRA210_CLK_ID_EXTERN3		TEGRA210_CLK_ID_PLL_P	    41000000	0
				TEGRA210_CLK_ID_CLK_OUT_3	TEGRA210_CLK_ID_EXTERN3	    0		0
				TEGRA210_CLK_ID_I2C1		TEGRA210_CLK_ID_PLL_P	    3200000	0
				TEGRA210_CLK_ID_I2C2		TEGRA210_CLK_ID_PLL_P	    3200000	0
				TEGRA210_CLK_ID_I2C3		TEGRA210_CLK_ID_PLL_P	    3200000	0
				TEGRA210_CLK_ID_I2C4		TEGRA210_CLK_ID_PLL_P	    3200000	0
				TEGRA210_CLK_ID_I2C5		TEGRA210_CLK_ID_PLL_P	    3200000	0
				TEGRA210_CLK_ID_VII2C		TEGRA210_CLK_ID_PLL_P	    204000000	0
				TEGRA210_CLK_ID_I2CSLOW		TEGRA210_CLK_ID_CLK_M	    1000000	0
				TEGRA210_CLK_ID_SBC1		TEGRA210_CLK_ID_PLL_P	    25000000	0
				TEGRA210_CLK_ID_SBC2		TEGRA210_CLK_ID_PLL_P	    25000000	0
				TEGRA210_CLK_ID_SBC3		TEGRA210_CLK_ID_PLL_P	    25000000	0
				TEGRA210_CLK_ID_SBC4		TEGRA210_CLK_ID_PLL_P	    25000000	0
				TEGRA210_CLK_ID_QSPI		TEGRA210_CLK_ID_PLL_P	    133000000	0
				TEGRA210_CLK_ID_UARTA		TEGRA210_CLK_ID_PLL_P	    408000000	1
				TEGRA210_CLK_ID_UARTB		TEGRA210_CLK_ID_PLL_P	    408000000	0
				TEGRA210_CLK_ID_UARTC		TEGRA210_CLK_ID_PLL_P	    408000000	0
				TEGRA210_CLK_ID_UARTD		TEGRA210_CLK_ID_PLL_P	    408000000	0
				TEGRA210_CLK_ID_EXTERN2		TEGRA210_CLK_ID_PLL_P	    41000000	0
				TEGRA210_CLK_ID_CLK_OUT_2	TEGRA210_CLK_ID_EXTERN2	    40800000	0
				TEGRA210_CLK_ID_EXTERN1		TEGRA210_CLK_ID_CLK_M	    19200000	1
				TEGRA210_CLK_ID_CLK_OUT_1	TEGRA210_CLK_ID_EXTERN1	    19200000	1
				TEGRA210_CLK_ID_UART_MIPI_CAL	TEGRA210_CLK_ID_PLL_P	    68000000	0
				0 >;
		};
	};
};
