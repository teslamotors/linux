/ {
	memory-controller@7001b000 {
		compatible = "nvidia,tegra21-emc";
		reg = <0x0 0x7001b000 0x0 0x800>;
		#address-cells = <1>;
		#size-cells = <0>;
		emc-table@204000 {
			compatible = "nvidia,tegra21-emc-table";
			nvidia,revision = <0x5>;
			nvidia,dvfs-version = "00_204000_05_V9.6.3_V0.9";
			clock-frequency = <204000>;
			nvidia,emc-min-mv = <850>;
			nvidia,gk20a-min-mv = <1100>;
			nvidia,source = "pllp_out0";
			nvidia,src-sel-reg = <0x40180002>;
			nvidia,needs-training = <00000000>;
			nvidia,training_pattern = <0x000002>;
			nvidia,trained = <00000000>;
			nvidia,burst-regs-num = <221>;
			nvidia,burst-regs-per-ch-num = <8>;
			nvidia,trim-regs-num = <138>;
			nvidia,trim-regs-per-ch-num = <10>;
			nvidia,burst-mc-regs-num = <33>;
			nvidia,la-scale-regs-num = <24>;
			nvidia,vref-regs-num = <4>;
			nvidia,training-mod-regs-num = <20>;
			nvidia,dram-timing-regs-num = <5>;
			nvidia,emc-registers = <
				0x0000000d
				0x0000001b
				0x0000000d
				0x00000000
				0x00000000
				0x00000009
				0x00000004
				0x00000008
				0x00000008
				0x00000004
				0x0000000a
				0x00000000
				0x00000001
				0x00000003
				0x00000004
				0x00000004
				0x00000003
				0x00000003
				0x00000000
				0x00000006
				0x00000004
				0x00000003
				0x00000002
				0x00000004
				0x00000004
				0x00000007
				0x00000006
				0x00000004
				0x00000000
				0x00000000
				0x00000003
				0x00000000
				0x0000000b
				0x00000001
				0x00000000
				0x00000001
				0x00000014
				0x00000011
				0x00000013
				0x0000000f
				0x00000011
				0x00000304
				0x00000000
				0x000000c1
				0x00000003
				0x00000003
				0x00000003
				0x00000000
				0x00000001
				0x0000000d
				0x00000000
				0x00000000
				0x00000007
				0x0000001d
				0x0000001d
				0x00000004
				0x00000004
				0x00000004
				0x0000000b
				0x00000005
				0x00000003
				0x00000003
				0x40000000
				0x00000351
				0x00000020
				0x1360a016
				0x00000002
				0x005800a0
				0x00008000
				0x000000be
				0x0fff0000
				0x0fff0fff
				0x01970197
				0x01980198
				0x01970197
				0x01980198
				0x00000000
				0x00000000
				0x00000000
				0x00120012
				0x00100012
				0x00120012
				0x00130012
				0x000e000e
				0x000e000e
				0x00120012
				0x00100012
				0x00120012
				0x00130012
				0x000e000e
				0x000e000e
				0x00000000
				0x00000000
				0x00000000
				0x00000000
				0x00000000
				0x00000000
				0x00000000
				0x00000000
				0x00000000
				0x00000000
				0x00000000
				0x00000000
				0x00000000
				0x00000000
				0x00000000
				0x00000000
				0x00000000
				0x00000000
				0x00000000
				0x00000000
				0x00000000
				0x00000000
				0x00000000
				0x00000000
				0x00000000
				0x00000000
				0x00000000
				0x00000000
				0x00000000
				0x00000000
				0x00000000
				0x00000000
				0x00000000
				0x00000000
				0x00000000
				0x00000000
				0x00000000
				0x00000000
				0x00000000
				0x00000000
				0x00000000
				0x00000000
				0x00000000
				0x00000000
				0x00000000
				0x8020221f
				0x0220f40f
				0x00000022
				0x00064000
				0x00000017
				0x00cc0011
				0x00cc000a
				0xc1e00304
				0x1f13412f
				0x00010014
				0x00000804
				0x00000550
				0xf3200000
				0x0fff0cf3
				0x80000713
				0x0000000c
				0x00000000
				0x00000000
				0x00000000
				0x00000000
				0x00000000
				0x00200000
				0x00000000
				0x00000000
				0x00003000
				0x0a000000
				0x02201000
				0x00000008
				0x00060808
				0x00015000
				0x00101010
				0x00001600
				0x00000000
				0x00000000
				0x00000000
				0x00000030
				0x00000040
				0x08000800
				0x08000800
				0x08000800
				0x08000800
				0x06970000
				0x00080617
				0x00000020
				0x00000000
				0x00000000
				0x00000000
				0x00000000
				0x07ff00e7
				0x01ed07df
				0xefffefff
				0xc0c0c0c0
				0xc0c0c0c0
				0xd4d4d4d4
				0x0a0a0a0a
				0x0a0a0a0a
				0x0a0a0a0a
				0x01186033
				0x00000000
				0x00000000
				0x00000011
				0x0000000c
				0x00000013
				0x00000000
				0x00000014
				0x00000001
				0x00009080
				0x07070404
				0x00040066
				0x0513801f
				0x1f101100
				0x00000014
				0x00107240
				0x01124000
				0x01125b6a
				0x0f081000
				0x00105800
				0x1110fc00
				0x0f081300
				0x00105800
				0x1114fc00
				0x07000300
				0x00107240
				0x55553c5a
				0x40000000
			>;
			nvidia,emc-burst-regs-per-ch = <
				0xc80c1010
				0xc80c1010
				0xc80c1010
				0xc80c1010
				0x80000000
				0x80000000
				0x40000000
				0x40000000
			>;
			nvidia,emc-shadow-regs-ca-train = <
				0x0000000d
				0x0000001b
				0x0000000d
				0x00000000
				0x00000000
				0x00000009
				0x00000004
				0x00000008
				0x00000008
				0x00000004
				0x0000000a
				0x00000000
				0x00000001
				0x00000003
				0x00000004
				0x00000004
				0x00000003
				0x00000003
				0x00000000
				0x00000006
				0x00000004
				0x00000003
				0x00000002
				0x00000004
				0x00000004
				0x00000007
				0x00000006
				0x00000004
				0x00000000
				0x00000000
				0x00000003
				0x00000000
				0x0000000b
				0x00000001
				0x00000000
				0x00000001
				0x00000014
				0x00000011
				0x00000013
				0x0000000f
				0x00000011
				0x00000304
				0x00000000
				0x000000c1
				0x00000003
				0x00000003
				0x00000003
				0x00000000
				0x00000001
				0x0000000d
				0x00000000
				0x00000000
				0x00000007
				0x0000001d
				0x0000001d
				0x00000004
				0x00000004
				0x00000004
				0x0000000b
				0x00000005
				0x00000003
				0x00000003
				0x40000000
				0x00000351
				0x00000020
				0x1360a016
				0x00000002
				0x005800a0
				0x00008000
				0x000000be
				0x0fff0000
				0x0fff0fff
				0x01970197
				0x01980198
				0x01970197
				0x01980198
				0x00000000
				0x00000000
				0x00000000
				0x00120012
				0x00100012
				0x00120012
				0x00130012
				0x000e000e
				0x000e000e
				0x00120012
				0x00100012
				0x00120012
				0x00130012
				0x000e000e
				0x000e000e
				0x00000000
				0x00000000
				0x00000000
				0x00000000
				0x00000000
				0x00000000
				0x00000000
				0x00000000
				0x00000000
				0x00000000
				0x00000000
				0x00000000
				0x00000000
				0x00000000
				0x00000000
				0x00000000
				0x00000000
				0x00000000
				0x00000000
				0x00000000
				0x00000000
				0x00000000
				0x00000000
				0x00000000
				0x00000000
				0x00000000
				0x00000000
				0x00000000
				0x00000000
				0x00000000
				0x00000000
				0x00000000
				0x00000000
				0x00000000
				0x00000000
				0x00000000
				0x00000000
				0x00000000
				0x00000000
				0x00000000
				0x00000000
				0x00000000
				0x00000000
				0x00000000
				0x00000000
				0x8020221f
				0x0220f40f
				0x00000022
				0x00064000
				0x00000017
				0x00cc0011
				0x00cc000a
				0xc1e00304
				0x1f13412f
				0x00010014
				0x00000804
				0x00000550
				0xf3200000
				0x0fff0cf3
				0x80000713
				0x0000000c
				0x00000000
				0x00000000
				0x00000000
				0x00000000
				0x00000000
				0x00200000
				0x00000000
				0x00000000
				0x00003000
				0x0a000000
				0x02201000
				0x00000008
				0x00060808
				0x00015000
				0x00101010
				0x00001600
				0x00000000
				0x00000000
				0x00000000
				0x00000030
				0x00000040
				0x08000800
				0x08000800
				0x08000800
				0x08000800
				0x06970000
				0x00080617
				0x00000020
				0x00000000
				0x00000000
				0x00000000
				0x00000000
				0x07ff00e7
				0x01ed07df
				0xefffefff
				0xc0c0c0c0
				0xc0c0c0c0
				0xd4d4d4d4
				0x0a0a0a0a
				0x0a0a0a0a
				0x0a0a0a0a
				0x01186033
				0x00000000
				0x00000000
				0x00000011
				0x0000000c
				0x00000013
				0x00000000
				0x00000014
				0x00000001
				0x00009080
				0x07070404
				0x00040066
				0x0513801f
				0x1f101100
				0x00000014
				0x00107240
				0x01124000
				0x01125b6a
				0x0f081000
				0x00105800
				0x1110fc00
				0x0f081300
				0x00105800
				0x1114fc00
				0x07000300
				0x00107240
				0x55553c5a
				0x40000000
			>;
			nvidia,emc-shadow-regs-quse-train = <
				0x0000000d
				0x0000001b
				0x0000000d
				0x00000000
				0x00000000
				0x00000009
				0x00000004
				0x00000008
				0x00000008
				0x00000004
				0x0000000a
				0x00000000
				0x00000001
				0x00000003
				0x00000004
				0x00000004
				0x00000003
				0x00000003
				0x00000000
				0x00000006
				0x00000004
				0x00000003
				0x00000002
				0x00000004
				0x00000004
				0x00000007
				0x00000006
				0x00000004
				0x00000000
				0x00000000
				0x00000003
				0x00000000
				0x0000000b
				0x00000001
				0x00000000
				0x00000001
				0x00000014
				0x00000011
				0x00000013
				0x0000000f
				0x00000011
				0x00000304
				0x00000000
				0x000000c1
				0x00000003
				0x00000003
				0x00000003
				0x00000000
				0x00000001
				0x0000000d
				0x00000000
				0x00000000
				0x00000007
				0x0000001d
				0x0000001d
				0x00000004
				0x00000004
				0x00000004
				0x0000000b
				0x00000005
				0x00000003
				0x00000003
				0x40000000
				0x00000351
				0x00000020
				0x1360a016
				0x00000002
				0x005800a0
				0x00008000
				0x000000be
				0x0fff0000
				0x0fff0fff
				0x01970197
				0x01980198
				0x01970197
				0x01980198
				0x00000000
				0x00000000
				0x00000000
				0x00120012
				0x00100012
				0x00120012
				0x00130012
				0x000e000e
				0x000e000e
				0x00120012
				0x00100012
				0x00120012
				0x00130012
				0x000e000e
				0x000e000e
				0x00000000
				0x00000000
				0x00000000
				0x00000000
				0x00000000
				0x00000000
				0x00000000
				0x00000000
				0x00000000
				0x00000000
				0x00000000
				0x00000000
				0x00000000
				0x00000000
				0x00000000
				0x00000000
				0x00000000
				0x00000000
				0x00000000
				0x00000000
				0x00000000
				0x00000000
				0x00000000
				0x00000000
				0x00000000
				0x00000000
				0x00000000
				0x00000000
				0x00000000
				0x00000000
				0x00000000
				0x00000000
				0x00000000
				0x00000000
				0x00000000
				0x00000000
				0x00000000
				0x00000000
				0x00000000
				0x00000000
				0x00000000
				0x00000000
				0x00000000
				0x00000000
				0x00000000
				0x8020221f
				0x0220f40f
				0x00000022
				0x00064000
				0x00000017
				0x00cc0011
				0x00cc000a
				0xc1e00304
				0x1f13412f
				0x00010014
				0x00000804
				0x00000550
				0xf3200000
				0x0fff0cf3
				0x80000713
				0x0000000c
				0x00000000
				0x00000000
				0x00000000
				0x00000000
				0x00000000
				0x00200000
				0x00000000
				0x00000000
				0x00003000
				0x0a000000
				0x02201000
				0x00000008
				0x00060808
				0x00015000
				0x00101010
				0x00001600
				0x00000000
				0x00000000
				0x00000000
				0x00000030
				0x00000040
				0x08000800
				0x08000800
				0x08000800
				0x08000800
				0x06970000
				0x00080617
				0x00000020
				0x00000000
				0x00000000
				0x00000000
				0x00000000
				0x07ff00e7
				0x01ed07df
				0xefffefff
				0xc0c0c0c0
				0xc0c0c0c0
				0xd4d4d4d4
				0x0a0a0a0a
				0x0a0a0a0a
				0x0a0a0a0a
				0x01186033
				0x00000000
				0x00000000
				0x00000011
				0x0000000c
				0x00000013
				0x00000000
				0x00000014
				0x00000001
				0x00009080
				0x07070404
				0x00040066
				0x0513801f
				0x1f101100
				0x00000014
				0x00107240
				0x01124000
				0x01125b6a
				0x0f081000
				0x00105800
				0x1110fc00
				0x0f081300
				0x00105800
				0x1114fc00
				0x07000300
				0x00107240
				0x55553c5a
				0x40000000
			>;
			nvidia,emc-shadow-regs-rdwr-train = <
				0x0000000d
				0x0000001b
				0x0000000d
				0x00000000
				0x00000000
				0x00000009
				0x00000004
				0x00000008
				0x00000008
				0x00000004
				0x0000000a
				0x00000000
				0x00000001
				0x00000003
				0x00000004
				0x00000004
				0x00000003
				0x00000003
				0x00000000
				0x00000006
				0x00000004
				0x00000003
				0x00000002
				0x00000004
				0x00000004
				0x00000007
				0x00000006
				0x00000004
				0x00000000
				0x00000000
				0x00000003
				0x00000000
				0x0000000b
				0x00000001
				0x00000000
				0x00000001
				0x00000014
				0x00000011
				0x00000013
				0x0000000f
				0x00000011
				0x00000304
				0x00000000
				0x000000c1
				0x00000003
				0x00000003
				0x00000003
				0x00000000
				0x00000001
				0x0000000d
				0x00000000
				0x00000000
				0x00000007
				0x0000001d
				0x0000001d
				0x00000004
				0x00000004
				0x00000004
				0x0000000b
				0x00000005
				0x00000003
				0x00000003
				0x40000000
				0x00000351
				0x00000020
				0x1360a016
				0x00000002
				0x005800a0
				0x00008000
				0x000000be
				0x0fff0000
				0x0fff0fff
				0x01970197
				0x01980198
				0x01970197
				0x01980198
				0x00000000
				0x00000000
				0x00000000
				0x00120012
				0x00100012
				0x00120012
				0x00130012
				0x000e000e
				0x000e000e
				0x00120012
				0x00100012
				0x00120012
				0x00130012
				0x000e000e
				0x000e000e
				0x00000000
				0x00000000
				0x00000000
				0x00000000
				0x00000000
				0x00000000
				0x00000000
				0x00000000
				0x00000000
				0x00000000
				0x00000000
				0x00000000
				0x00000000
				0x00000000
				0x00000000
				0x00000000
				0x00000000
				0x00000000
				0x00000000
				0x00000000
				0x00000000
				0x00000000
				0x00000000
				0x00000000
				0x00000000
				0x00000000
				0x00000000
				0x00000000
				0x00000000
				0x00000000
				0x00000000
				0x00000000
				0x00000000
				0x00000000
				0x00000000
				0x00000000
				0x00000000
				0x00000000
				0x00000000
				0x00000000
				0x00000000
				0x00000000
				0x00000000
				0x00000000
				0x00000000
				0x8020221f
				0x0220f40f
				0x00000022
				0x00064000
				0x00000017
				0x00cc0011
				0x00cc000a
				0xc1e00304
				0x1f13412f
				0x00010014
				0x00000804
				0x00000550
				0xf3200000
				0x0fff0cf3
				0x80000713
				0x0000000c
				0x00000000
				0x00000000
				0x00000000
				0x00000000
				0x00000000
				0x00200000
				0x00000000
				0x00000000
				0x00003000
				0x0a000000
				0x02201000
				0x00000008
				0x00060808
				0x00015000
				0x00101010
				0x00001600
				0x00000000
				0x00000000
				0x00000000
				0x00000030
				0x00000040
				0x08000800
				0x08000800
				0x08000800
				0x08000800
				0x06970000
				0x00080617
				0x00000020
				0x00000000
				0x00000000
				0x00000000
				0x00000000
				0x07ff00e7
				0x01ed07df
				0xefffefff
				0xc0c0c0c0
				0xc0c0c0c0
				0xd4d4d4d4
				0x0a0a0a0a
				0x0a0a0a0a
				0x0a0a0a0a
				0x01186033
				0x00000000
				0x00000000
				0x00000011
				0x0000000c
				0x00000013
				0x00000000
				0x00000014
				0x00000001
				0x00009080
				0x07070404
				0x00040066
				0x0513801f
				0x1f101100
				0x00000014
				0x00107240
				0x01124000
				0x01125b6a
				0x0f081000
				0x00105800
				0x1110fc00
				0x0f081300
				0x00105800
				0x1114fc00
				0x07000300
				0x00107240
				0x55553c5a
				0x40000000
			>;
			nvidia,emc-trim-regs = <
				0x00a000a0
				0x00a000a0
				0x00a000a0
				0x00a000a0
				0x00a000a0
				0x00a000a0
				0x00a000a0
				0x00a000a0
				0x00000000
				0x00000000
				0x00000000
				0x00000000
				0x00000000
				0x00000000
				0x00000000
				0x00000000
				0x00000000
				0x00000000
				0x00000000
				0x00000000
				0x00000000
				0x00000000
				0x00000000
				0x00000000
				0x00000000
				0x00000000
				0x00000000
				0x00000000
				0x00000000
				0x00000000
				0x00000000
				0x00000000
				0x00000000
				0x00000000
				0x00000000
				0x00000000
				0x00000000
				0x00000000
				0x00000000
				0x00000000
				0x00000000
				0x00000000
				0x00000000
				0x00000000
				0x00000000
				0x00000000
				0x00000000
				0x00000000
				0x00000000
				0x00000000
				0x00000000
				0x00000000
				0x00000000
				0x00000000
				0x00000000
				0x00000000
				0x35353535
				0x35353535
				0x3d3d3d3d
				0x3d3d3d3d
				0x01ad01ac
				0x01ad01ac
				0x01ac01ad
				0x01ac01ac
				0x00000000
				0x00000000
				0x01ad01ac
				0x01ad01ac
				0x01ac01ad
				0x01ac01ac
				0x00000000
				0x00000000
				0x00000000
				0x00000000
				0x00000000
				0x00000000
				0x00000000
				0x00000000
				0x00000000
				0x00000000
				0x00000000
				0x00000000
				0x00000000
				0x00000000
				0x00000000
				0x00000000
				0x00000000
				0x00000000
				0x00000000
				0x00000000
				0x00000000
				0x00000000
				0x00000000
				0x00000000
				0x00000000
				0x00000000
				0x00000000
				0x00000000
				0x00000000
				0x00000000
				0x00000000
				0x00000000
				0x00000000
				0x00000000
				0x00000000
				0x00000000
				0x00000000
				0x00000000
				0x00000000
				0x00000000
				0x00000000
				0x00000000
				0x00000000
				0x00000000
				0x00000000
				0x00000000
				0x00000000
				0x00000000
				0x00000000
				0x00000000
				0x00000000
				0x00000000
				0x00000000
				0x00000000
				0x00000000
				0x00000000
				0x00000000
				0x00000000
				0x00000000
				0x00000000
				0x00000000
				0x00000000
				0x00000000
				0x00000000
				0x00000000
				0x00000000
				0x00000000
				0x00000000
			>;
			nvidia,emc-trim-regs-per-ch = <
				0x00000000
				0x00000000
				0x00000000
				0x00000000
				0x00000000
				0x00000000
				0x00000000
				0x00000000
				0x00000000
				0x00000000
			>;
			nvidia,emc-vref-regs = <
				0x00000000
				0x00000000
				0x00000000
				0x00000000
			>;
			nvidia,emc-dram-timing-regs = <
				0x00000012
				0x00000104
				0x00000082
				0x0000000e
				0x00000006
			>;
			nvidia,emc-training-mod-regs = <
				0x00000000
				0x00000000
				0x00000000
				0x00000000
				0x00000000
				0x00000000
				0x00000000
				0x00000000
				0x00000000
				0x00000000
				0x00000000
				0x00000000
				0x00000000
				0x00000000
				0x00000000
				0x00000000
				0x00000000
				0x00000000
				0x00000000
				0x00000000
			>;
			nvidia,emc-save-restore-mod-regs = <
				0x00000000
				0x00000000
				0x00000000
				0x00000000
				0x00000000
				0x00000000
				0x00000000
				0x00000000
				0x00000000
				0x00000000
				0x00000000
				0x00000000
				0x01000003
				0x80000040
				0x000a1020
				0x00001028
				0x00000001
				0x00000001
				0x00000006
				0x00000003
			>;
			nvidia,emc-burst-mc-regs = <
			0x01000003
			0x80000040
			0x000a1020
			0x00001028
			0x00000001
			0x00000001
			0x00000006
			0x00000003
			0x00000005
			0x00000001
			0x00000002
			0x00000007
			0x00000003
			0x00000001
			0x00000005
			0x00000001
			0x00000005
			0x00000006
			0x02020001
			0x00050203
			0x71640a07
			0x70000f0f
			0x00000001
			0x001f0000
			0x0080001a
			0x0080001a
			0x0080001a
			0x0080001a
			0x0080001a
			0x0080001a
			0x0080001a
			0x0080001a
			0x0080001a
			>;
			nvidia,emc-la-scale-regs = <
			0x0000003f
			0x0080001a
			0x00000571
			0x00ff0059
			0x00ff006d
			0x00ff004f
			0x00ff00af
			0x00ff0006
			0x00ff00af
			0x00ff0006
			0x00400049
			0x00ff0080
			0x00ff0004
			0x00080057
			0x000000ff
			0x00ff0004
			0x00ff0063
			0x00ff0063
			0x00ff0036
			0x00ff00ff
			0x00ff0071
			0x000000ff
			0x00000040
			0x00ff00ff
			>;
			nvidia,min-mrs-wait = <0x00000011>;
			nvidia,emc-mrw = <0x08010083>;
			nvidia,emc-mrw2 = <0x08020004>;
			nvidia,emc-mrw3 = <0x08030001>;
			nvidia,emc-mrw4 = <0x880b0000>;
			nvidia,emc-mrw9 = <0x00000000>;
			nvidia,emc-mrs = <0x00000000>;
			nvidia,emc-emrs = <0x00000000>;
			nvidia,emc-emrs2 = <0x00000000>;
			nvidia,emc-auto-cal-config = <0xa01a50d8>;
			nvidia,emc-auto-cal-config2 = <0x05500000>;
			nvidia,emc-auto-cal-config3 = <0x00770000>;
			nvidia,emc-auto-cal-config4 = <0x00770000>;
			nvidia,emc-auto-cal-config5 = <0x00770000>;
			nvidia,emc-auto-cal-config6 = <0x00770000>;
			nvidia,emc-auto-cal-config7 = <0x00770000>;
			nvidia,emc-auto-cal-config8 = <0x00770000>;
			nvidia,emc-cfg-2 = <0x00100885>;
			nvidia,emc-sel-dpd-ctrl = <0x00040018>;
			nvidia,emc-fdpd-ctrl-cmd-no-ramp = <0x00000001>;
			nvidia,dll-clk-src = <0x40180002>;
			nvidia,clk-out-enb-x-0-clk-enb-emc-dll = <0x00000001>;
			nvidia,emc-clock-latency-change = <0x00000d5c>;
		};
		emc-table@800000 {
			compatible = "nvidia,tegra21-emc-table";
			nvidia,revision = <0x5>;
			nvidia,dvfs-version = "00_800000_01_V9.6.3_V0.9";
			clock-frequency = <800000>;
			nvidia,emc-min-mv = <950>;
			nvidia,gk20a-min-mv = <1100>;
			nvidia,source = "pllm_ud";
			nvidia,src-sel-reg = <0x80180000>;
			nvidia,needs-training = <00000000>;
			nvidia,training_pattern = <0x000002>;
			nvidia,trained = <00000000>;
			nvidia,burst-regs-num = <221>;
			nvidia,burst-regs-per-ch-num = <8>;
			nvidia,trim-regs-num = <138>;
			nvidia,trim-regs-per-ch-num = <10>;
			nvidia,burst-mc-regs-num = <33>;
			nvidia,la-scale-regs-num = <24>;
			nvidia,vref-regs-num = <4>;
			nvidia,training-mod-regs-num = <20>;
			nvidia,dram-timing-regs-num = <5>;
			nvidia,emc-registers = <
				0x00000030
				0x00000068
				0x00000030
				0x00000000
				0x00000000
				0x00000022
				0x0000000f
				0x0000000f
				0x0000000d
				0x00000006
				0x00000013
				0x00000000
				0x00000001
				0x00000003
				0x0000000f
				0x0000000f
				0x00000008
				0x00000004
				0x00000000
				0x00000006
				0x00000006
				0x00000005
				0x00000004
				0x00000006
				0x00000004
				0x00000007
				0x0000000e
				0x00000006
				0x00000000
				0x00000000
				0x00000006
				0x00000000
				0x00000012
				0x0000000c
				0x00000008
				0x00000004
				0x0000001e
				0x0000001e
				0x00000020
				0x0000001c
				0x0000001e
				0x00000bf0
				0x00000000
				0x000002fc
				0x00000006
				0x00000006
				0x0000000e
				0x00000000
				0x00000001
				0x00000018
				0x00000000
				0x00000000
				0x00000015
				0x00000070
				0x00000070
				0x00000006
				0x0000000c
				0x00000006
				0x00000028
				0x00000011
				0x00000003
				0x00000003
				0x40000000
				0x00000d00
				0x00000020
				0x1360a016
				0x00000002
				0xc00702bb
				0x00008000
				0x000000be
				0x00000000
				0x00000000
				0x00190019
				0x00190019
				0x00190019
				0x00190019
				0x00000000
				0x00000000
				0x00000000
				0x00050005
				0x00050005
				0x00050005
				0x00050005
				0x00040004
				0x00040004
				0x00050005
				0x00050005
				0x00050005
				0x00050005
				0x00040004
				0x00040004
				0x00000000
				0x00000000
				0x00000000
				0x00000000
				0x00000000
				0x00000000
				0x00000000
				0x00000000
				0x00000000
				0x00000000
				0x00000000
				0x00000000
				0x00000000
				0x00000000
				0x00000000
				0x00000000
				0x00000000
				0x00000000
				0x00000000
				0x00000000
				0x00000000
				0x00000000
				0x00000000
				0x00000000
				0x00000000
				0x00000000
				0x00000000
				0x00000000
				0x00000000
				0x00000000
				0x00000000
				0x00000000
				0x00000000
				0x00000000
				0x00000000
				0x00000000
				0x00000000
				0x00000000
				0x00000000
				0x00000000
				0x00000000
				0x00000000
				0x00000000
				0x00000000
				0x00000000
				0x8020221f
				0x0220f40f
				0x00000012
				0x00064000
				0x0000004c
				0x03200017
				0x0320000a
				0xc1e0030a
				0x1f13412f
				0x00010014
				0x0000080d
				0x00000550
				0xf3200000
				0x00000000
				0x800018c8
				0x00000016
				0x00000000
				0x00000000
				0x00000000
				0x00000000
				0x00000000
				0x00004022
				0x00000000
				0x00000010
				0x00003000
				0x0a000000
				0x02000101
				0x0000000f
				0x00060808
				0x00015000
				0x00102020
				0x1fff1600
				0x00000000
				0x00000000
				0x00000000
				0x00000034
				0x00000040
				0x08000800
				0x08000800
				0x08000800
				0x08000800
				0x06970000
				0x00080617
				0x00000020
				0x00000000
				0x00000000
				0x00000000
				0x00000000
				0x07ff00e7
				0x01ed07df
				0xe7ffe2ff
				0xc0c0c0c0
				0xc0c0c0c0
				0xd4d4d4d4
				0x0a0a0a0a
				0x0a0a0a0a
				0x0a0a0a0a
				0x011860c8
				0x00000000
				0x00000000
				0x0000001e
				0x00000016
				0x00000020
				0x00000000
				0x0000001e
				0x00000004
				0x00009080
				0x07070404
				0x00040190
				0x0513801f
				0x1f101100
				0x00000014
				0x00107240
				0x01124000
				0x01125b6a
				0x0f081000
				0x00105800
				0x1110fc00
				0x0f081300
				0x00105800
				0x1114fc00
				0x07000300
				0x00107240
				0x55553c5a
				0x40000000
			>;
			nvidia,emc-burst-regs-per-ch = <
				0xc80c1010
				0xc80c1010
				0xc80c1010
				0xc80c1010
				0x80000000
				0x80000000
				0x40000000
				0x40000000
			>;
			nvidia,emc-shadow-regs-ca-train = <
				0x00000030
				0x00000068
				0x00000030
				0x00000000
				0x00000000
				0x00000022
				0x0000000f
				0x0000000f
				0x0000000d
				0x00000006
				0x00000013
				0x00000000
				0x00000001
				0x00000003
				0x0000000f
				0x0000000f
				0x00000008
				0x00000004
				0x00000000
				0x00000006
				0x00000006
				0x00000005
				0x00000004
				0x00000006
				0x00000004
				0x00000007
				0x0000000e
				0x00000006
				0x00000000
				0x00000000
				0x00000006
				0x00000000
				0x00000012
				0x0000000c
				0x00000008
				0x00000004
				0x0000001e
				0x0000001e
				0x00000020
				0x0000001c
				0x0000001e
				0x00000bf0
				0x00000000
				0x000002fc
				0x00000006
				0x00000006
				0x0000000e
				0x00000000
				0x00000001
				0x00000018
				0x00000000
				0x00000000
				0x00000015
				0x00000070
				0x00000070
				0x00000006
				0x0000000c
				0x00000006
				0x00000028
				0x00000011
				0x00000003
				0x00000003
				0x40000000
				0x00000d00
				0x00000020
				0x1360a016
				0x00000002
				0xc00702bb
				0x00008000
				0x000000be
				0x00000000
				0x00000000
				0x00190019
				0x00190019
				0x00190019
				0x00190019
				0x00000000
				0x00000000
				0x00000000
				0x00050005
				0x00050005
				0x00050005
				0x00050005
				0x00040004
				0x00040004
				0x00050005
				0x00050005
				0x00050005
				0x00050005
				0x00040004
				0x00040004
				0x00000000
				0x00000000
				0x00000000
				0x00000000
				0x00000000
				0x00000000
				0x00000000
				0x00000000
				0x00000000
				0x00000000
				0x00000000
				0x00000000
				0x00000000
				0x00000000
				0x00000000
				0x00000000
				0x00000000
				0x00000000
				0x00000000
				0x00000000
				0x00000000
				0x00000000
				0x00000000
				0x00000000
				0x00000000
				0x00000000
				0x00000000
				0x00000000
				0x00000000
				0x00000000
				0x00000000
				0x00000000
				0x00000000
				0x00000000
				0x00000000
				0x00000000
				0x00000000
				0x00000000
				0x00000000
				0x00000000
				0x00000000
				0x00000000
				0x00000000
				0x00000000
				0x00000000
				0x8020221f
				0x0220f40f
				0x00000012
				0x00064000
				0x0000004c
				0x03200017
				0x0320000a
				0xc1e0030a
				0x1f13412f
				0x00010014
				0x0000080d
				0x00000550
				0xf3200000
				0x00000000
				0x800018c8
				0x00000016
				0x00000000
				0x00000000
				0x00000000
				0x00000000
				0x00000000
				0x00004022
				0x00000000
				0x00000010
				0x00003000
				0x0a000000
				0x02000101
				0x0000000f
				0x00060808
				0x00015000
				0x00102020
				0x1fff1600
				0x00000000
				0x00000000
				0x00000000
				0x00000034
				0x00000040
				0x08000800
				0x08000800
				0x08000800
				0x08000800
				0x06970000
				0x00080617
				0x00000020
				0x00000000
				0x00000000
				0x00000000
				0x00000000
				0x07ff00e7
				0x01ed07df
				0xe7ffe2ff
				0xc0c0c0c0
				0xc0c0c0c0
				0xd4d4d4d4
				0x0a0a0a0a
				0x0a0a0a0a
				0x0a0a0a0a
				0x011860c8
				0x00000000
				0x00000000
				0x0000001e
				0x00000016
				0x00000020
				0x00000000
				0x0000001e
				0x00000004
				0x00009080
				0x07070404
				0x00040190
				0x0513801f
				0x1f101100
				0x00000014
				0x00107240
				0x01124000
				0x01125b6a
				0x0f081000
				0x00105800
				0x1110fc00
				0x0f081300
				0x00105800
				0x1114fc00
				0x07000300
				0x00107240
				0x55553c5a
				0x40000000
			>;
			nvidia,emc-shadow-regs-quse-train = <
				0x00000030
				0x00000068
				0x00000030
				0x00000000
				0x00000000
				0x00000022
				0x0000000f
				0x0000000f
				0x0000000d
				0x00000006
				0x00000013
				0x00000000
				0x00000001
				0x00000003
				0x0000000f
				0x0000000f
				0x00000008
				0x00000004
				0x00000000
				0x00000006
				0x00000006
				0x00000005
				0x00000004
				0x00000006
				0x00000004
				0x00000007
				0x0000000e
				0x00000006
				0x00000000
				0x00000000
				0x00000006
				0x00000000
				0x00000012
				0x0000000c
				0x00000008
				0x00000004
				0x0000001e
				0x0000001e
				0x00000020
				0x0000001c
				0x0000001e
				0x00000bf0
				0x00000000
				0x000002fc
				0x00000006
				0x00000006
				0x0000000e
				0x00000000
				0x00000001
				0x00000018
				0x00000000
				0x00000000
				0x00000015
				0x00000070
				0x00000070
				0x00000006
				0x0000000c
				0x00000006
				0x00000028
				0x00000011
				0x00000003
				0x00000003
				0x40000000
				0x00000d00
				0x00000020
				0x1360a016
				0x00000002
				0xc00702bb
				0x00008000
				0x000000be
				0x00000000
				0x00000000
				0x00190019
				0x00190019
				0x00190019
				0x00190019
				0x00000000
				0x00000000
				0x00000000
				0x00050005
				0x00050005
				0x00050005
				0x00050005
				0x00040004
				0x00040004
				0x00050005
				0x00050005
				0x00050005
				0x00050005
				0x00040004
				0x00040004
				0x00000000
				0x00000000
				0x00000000
				0x00000000
				0x00000000
				0x00000000
				0x00000000
				0x00000000
				0x00000000
				0x00000000
				0x00000000
				0x00000000
				0x00000000
				0x00000000
				0x00000000
				0x00000000
				0x00000000
				0x00000000
				0x00000000
				0x00000000
				0x00000000
				0x00000000
				0x00000000
				0x00000000
				0x00000000
				0x00000000
				0x00000000
				0x00000000
				0x00000000
				0x00000000
				0x00000000
				0x00000000
				0x00000000
				0x00000000
				0x00000000
				0x00000000
				0x00000000
				0x00000000
				0x00000000
				0x00000000
				0x00000000
				0x00000000
				0x00000000
				0x00000000
				0x00000000
				0x8020221f
				0x0220f40f
				0x00000012
				0x00064000
				0x0000004c
				0x03200017
				0x0320000a
				0xc1e0030a
				0x1f13412f
				0x00010014
				0x0000080d
				0x00000550
				0xf3200000
				0x00000000
				0x800018c8
				0x00000016
				0x00000000
				0x00000000
				0x00000000
				0x00000000
				0x00000000
				0x00004022
				0x00000000
				0x00000010
				0x00003000
				0x0a000000
				0x02000101
				0x0000000f
				0x00060808
				0x00015000
				0x00102020
				0x1fff1600
				0x00000000
				0x00000000
				0x00000000
				0x00000034
				0x00000040
				0x08000800
				0x08000800
				0x08000800
				0x08000800
				0x06970000
				0x00080617
				0x00000020
				0x00000000
				0x00000000
				0x00000000
				0x00000000
				0x07ff00e7
				0x01ed07df
				0xe7ffe2ff
				0xc0c0c0c0
				0xc0c0c0c0
				0xd4d4d4d4
				0x0a0a0a0a
				0x0a0a0a0a
				0x0a0a0a0a
				0x011860c8
				0x00000000
				0x00000000
				0x0000001e
				0x00000016
				0x00000020
				0x00000000
				0x0000001e
				0x00000004
				0x00009080
				0x07070404
				0x00040190
				0x0513801f
				0x1f101100
				0x00000014
				0x00107240
				0x01124000
				0x01125b6a
				0x0f081000
				0x00105800
				0x1110fc00
				0x0f081300
				0x00105800
				0x1114fc00
				0x07000300
				0x00107240
				0x55553c5a
				0x40000000
			>;
			nvidia,emc-shadow-regs-rdwr-train = <
				0x00000030
				0x00000068
				0x00000030
				0x00000000
				0x00000000
				0x00000022
				0x0000000f
				0x0000000f
				0x0000000d
				0x00000006
				0x00000013
				0x00000000
				0x00000001
				0x00000003
				0x0000000f
				0x0000000f
				0x00000008
				0x00000004
				0x00000000
				0x00000006
				0x00000006
				0x00000005
				0x00000004
				0x00000006
				0x00000004
				0x00000007
				0x0000000e
				0x00000006
				0x00000000
				0x00000000
				0x00000006
				0x00000000
				0x00000012
				0x0000000c
				0x00000008
				0x00000004
				0x0000001e
				0x0000001e
				0x00000020
				0x0000001c
				0x0000001e
				0x00000bf0
				0x00000000
				0x000002fc
				0x00000006
				0x00000006
				0x0000000e
				0x00000000
				0x00000001
				0x00000018
				0x00000000
				0x00000000
				0x00000015
				0x00000070
				0x00000070
				0x00000006
				0x0000000c
				0x00000006
				0x00000028
				0x00000011
				0x00000003
				0x00000003
				0x40000000
				0x00000d00
				0x00000020
				0x1360a016
				0x00000002
				0xc00702bb
				0x00008000
				0x000000be
				0x00000000
				0x00000000
				0x00190019
				0x00190019
				0x00190019
				0x00190019
				0x00000000
				0x00000000
				0x00000000
				0x00050005
				0x00050005
				0x00050005
				0x00050005
				0x00040004
				0x00040004
				0x00050005
				0x00050005
				0x00050005
				0x00050005
				0x00040004
				0x00040004
				0x00000000
				0x00000000
				0x00000000
				0x00000000
				0x00000000
				0x00000000
				0x00000000
				0x00000000
				0x00000000
				0x00000000
				0x00000000
				0x00000000
				0x00000000
				0x00000000
				0x00000000
				0x00000000
				0x00000000
				0x00000000
				0x00000000
				0x00000000
				0x00000000
				0x00000000
				0x00000000
				0x00000000
				0x00000000
				0x00000000
				0x00000000
				0x00000000
				0x00000000
				0x00000000
				0x00000000
				0x00000000
				0x00000000
				0x00000000
				0x00000000
				0x00000000
				0x00000000
				0x00000000
				0x00000000
				0x00000000
				0x00000000
				0x00000000
				0x00000000
				0x00000000
				0x00000000
				0x8020221f
				0x0220f40f
				0x00000012
				0x00064000
				0x0000004c
				0x03200017
				0x0320000a
				0xc1e0030a
				0x1f13412f
				0x00010014
				0x0000080d
				0x00000550
				0xf3200000
				0x00000000
				0x800018c8
				0x00000016
				0x00000000
				0x00000000
				0x00000000
				0x00000000
				0x00000000
				0x00004022
				0x00000000
				0x00000010
				0x00003000
				0x0a000000
				0x02000101
				0x0000000f
				0x00060808
				0x00015000
				0x00102020
				0x1fff1600
				0x00000000
				0x00000000
				0x00000000
				0x00000034
				0x00000040
				0x08000800
				0x08000800
				0x08000800
				0x08000800
				0x06970000
				0x00080617
				0x00000020
				0x00000000
				0x00000000
				0x00000000
				0x00000000
				0x07ff00e7
				0x01ed07df
				0xe7ffe2ff
				0xc0c0c0c0
				0xc0c0c0c0
				0xd4d4d4d4
				0x0a0a0a0a
				0x0a0a0a0a
				0x0a0a0a0a
				0x011860c8
				0x00000000
				0x00000000
				0x0000001e
				0x00000016
				0x00000020
				0x00000000
				0x0000001e
				0x00000004
				0x00009080
				0x07070404
				0x00040190
				0x0513801f
				0x1f101100
				0x00000014
				0x00107240
				0x01124000
				0x01125b6a
				0x0f081000
				0x00105800
				0x1110fc00
				0x0f081300
				0x00105800
				0x1114fc00
				0x07000300
				0x00107240
				0x55553c5a
				0x40000000
			>;
			nvidia,emc-trim-regs = <
				0x00200020
				0x00200020
				0x00200020
				0x00200020
				0x00200020
				0x00200020
				0x00200020
				0x00200020
				0x00000000
				0x00000000
				0x00000000
				0x00000000
				0x00000000
				0x00000000
				0x00000000
				0x00000000
				0x00000000
				0x00000000
				0x00000000
				0x00000000
				0x00000000
				0x00000000
				0x00000000
				0x00000000
				0x00000000
				0x00000000
				0x00000000
				0x00000000
				0x00000000
				0x00000000
				0x00000000
				0x00000000
				0x00000000
				0x00000000
				0x00000000
				0x00000000
				0x00000000
				0x00000000
				0x00000000
				0x00000000
				0x00000000
				0x00000000
				0x00000000
				0x00000000
				0x00000000
				0x00000000
				0x00000000
				0x00000000
				0x00000000
				0x00000000
				0x00000000
				0x00000000
				0x00000000
				0x00000000
				0x00000000
				0x00000000
				0x35353535
				0x35353535
				0x33333333
				0x33333333
				0x00180018
				0x00180018
				0x00180018
				0x00180018
				0x00000000
				0x00000000
				0x00180018
				0x00180018
				0x00180018
				0x00180018
				0x00000000
				0x00000000
				0x00000000
				0x00000000
				0x00000000
				0x00000000
				0x00000000
				0x00000000
				0x00000000
				0x00000000
				0x00000000
				0x00000000
				0x00000000
				0x00000000
				0x00000000
				0x00000000
				0x00000000
				0x00000000
				0x00000000
				0x00000000
				0x00000000
				0x00000000
				0x00000000
				0x00000000
				0x00000000
				0x00000000
				0x00000000
				0x00000000
				0x00000000
				0x00000000
				0x00000000
				0x00000000
				0x00000000
				0x00000000
				0x00000000
				0x00000000
				0x00000000
				0x00000000
				0x00000000
				0x00000000
				0x00000000
				0x00000000
				0x00000000
				0x00000000
				0x00000000
				0x00000000
				0x00000000
				0x00000000
				0x00000000
				0x00000000
				0x00000000
				0x00000000
				0x00000000
				0x00000000
				0x00000000
				0x00000000
				0x00000000
				0x00000000
				0x00000000
				0x00000000
				0x00000000
				0x00000000
				0x00000000
				0x00000000
				0x00000000
				0x00000000
				0x00000000
				0x00000000
			>;
			nvidia,emc-trim-regs-per-ch = <
				0x00000000
				0x00000000
				0x00000000
				0x00000000
				0x00000000
				0x00000000
				0x00000000
				0x00000000
				0x00000000
				0x00000000
			>;
			nvidia,emc-vref-regs = <
				0x00000000
				0x00000000
				0x00000000
				0x00000000
			>;
			nvidia,emc-dram-timing-regs = <
				0x00000012
				0x00000104
				0x00000082
				0x00000007
				0x0000000c
			>;
			nvidia,emc-training-mod-regs = <
				0x00000000
				0x00000000
				0x00000000
				0x00000000
				0x00000000
				0x00000000
				0x00000000
				0x00000000
				0x00000000
				0x00000000
				0x00000000
				0x00000000
				0x00000000
				0x00000000
				0x00000000
				0x00000000
				0x00000000
				0x00000000
				0x00000000
				0x00000000
			>;
			nvidia,emc-save-restore-mod-regs = <
				0x00000000
				0x00000000
				0x00000000
				0x00000000
				0x00000000
				0x00000000
				0x00000000
				0x00000000
				0x00000000
				0x00000000
				0x00000000
				0x00000000
				0x0000000c
				0x80000040
				0x000a1020
				0x00001028
				0x00000006
				0x00000007
				0x00000018
				0x0000000f
			>;
			nvidia,emc-burst-mc-regs = <
			0x0000000c
			0x80000040
			0x000a1020
			0x00001028
			0x00000006
			0x00000007
			0x00000018
			0x0000000f
			0x00000013
			0x00000003
			0x00000003
			0x0000000c
			0x00000003
			0x00000001
			0x00000009
			0x00000001
			0x00000008
			0x00000017
			0x04040001
			0x000c080c
			0x712c2419
			0x70000f0f
			0x00000001
			0x001f0000
			0x0080001a
			0x0080001a
			0x0080001a
			0x0080001a
			0x0080001a
			0x0080001a
			0x0080001a
			0x0080001a
			0x0080001a
			>;
			nvidia,emc-la-scale-regs = <
			0x000000f6
			0x0080001a
			0x00001555
			0x0080003d
			0x00800038
			0x00800041
			0x00800090
			0x00800005
			0x00800090
			0x00800005
			0x00340049
			0x00800080
			0x00800004
			0x00080016
			0x00000080
			0x00800004
			0x00800019
			0x00800019
			0x00800018
			0x00800095
			0x0080001d
			0x00000080
			0x0000002c
			0x00800080
			>;
			nvidia,min-mrs-wait = <0x00000017>;
			nvidia,emc-mrw = <0x08010043>;
			nvidia,emc-mrw2 = <0x0802001a>;
			nvidia,emc-mrw3 = <0x08030001>;
			nvidia,emc-mrw4 = <0x880b0000>;
			nvidia,emc-mrw9 = <0x00000000>;
			nvidia,emc-mrs = <0x00000000>;
			nvidia,emc-emrs = <0x00000000>;
			nvidia,emc-emrs2 = <0x00000000>;
			nvidia,emc-auto-cal-config = <0xa01a50d8>;
			nvidia,emc-auto-cal-config2 = <0x05500000>;
			nvidia,emc-auto-cal-config3 = <0x00770000>;
			nvidia,emc-auto-cal-config4 = <0x00770000>;
			nvidia,emc-auto-cal-config5 = <0x00770000>;
			nvidia,emc-auto-cal-config6 = <0x00770000>;
			nvidia,emc-auto-cal-config7 = <0x00770000>;
			nvidia,emc-auto-cal-config8 = <0x00770000>;
			nvidia,emc-cfg-2 = <0x0010089d>;
			nvidia,emc-sel-dpd-ctrl = <0x00040018>;
			nvidia,emc-fdpd-ctrl-cmd-no-ramp = <0x00000001>;
			nvidia,dll-clk-src = <0x80180000>;
			nvidia,clk-out-enb-x-0-clk-enb-emc-dll = <0x00000000>;
			nvidia,emc-clock-latency-change = <0x000004b0>;
		};
	};
};
