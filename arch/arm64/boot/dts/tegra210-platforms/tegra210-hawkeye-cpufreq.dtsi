/*
 * Copyright (c) 2015 NVIDIA CORPORATION. All rights reserved.
 *
 * This software is licensed under the terms of the GNU General Public
 * License version 2, as published by the Free Software Foundation, and
 * may be copied, distributed, and modified under those terms.
 *
 * This program is distributed in the hope that it will be useful,
 * but WITHOUT ANY WARRANTY; without even the implied warranty of
 * MERCHANTABILITY or FITNESS FOR A PARTICULAR PURPOSE.  See the
 * GNU General Public License for more details.
 *
 */

/ {
        cpufreq {
		compatible = "nvidia,tegra210-cpufreq";
		emc-scaling-data {
			emc-cpu-limit-table = <
				/* CPU    EMC */
				275000	50000
				500000	100000
				725000	200000
				975000	400000
				1300000	1600000
			>;
		};
	};
};
