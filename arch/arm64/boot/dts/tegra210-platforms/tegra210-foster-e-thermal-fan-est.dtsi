/*
 * Copyright (c) 2014, NVIDIA CORPORATION.  All rights reserved.
 *
 * This program is free software; you can redistribute it and/or modify it
 * under the terms and conditions of the GNU General Public License,
 * version 2, as published by the Free Software Foundation.
 *
 * This program is distributed in the hope it will be useful, but WITHOUT
 * ANY WARRANTY; without even the implied warranty of MERCHANTABILITY or
 * FITNESS FOR A PARTICULAR PURPOSE.  See the GNU General Public License for
 * more details.
 */

#include "tegra210-loki-e-thermal-fan-est.dtsi"

/ {
	thermal-fan-est {
		active_trip_temps = <0 45000 56000 64000 70000
				140000 150000 160000 170000 180000>;
		active_hysteresis = <0 13000 10000 7000 5000
				0 0 0 0 0>;
	};
};
