/*
 * arch/arm/boot/dts/tegra210-platforms/tegra210-sysedp-670d.dtsi
 *
 * Copyright (c) 2014-2015, NVIDIA CORPORATION. All rights reserved.
 *
 * This program is free software; you can redistribute it and/or modify it
 * under the terms and conditions of the GNU General Public License,
 * version 2, as published by the Free Software Foundation.
 *
 * This program is distributed in the hope it will be useful, but WITHOUT
 * ANY WARRANTY; without even the implied warranty of MERCHANTABILITY or
 * FITNESS FOR A PARTICULAR PURPOSE.  See the GNU General Public License for
 * more details.
 *
 * You should have received a copy of the GNU General Public License
 * along with this program.  If not, see <http://www.gnu.org/licenses/>.
 */

/ {
	sysedp-dynamic-capping {
		/* 670D */
		compatible = "nvidia,tegra124-sysedp-dynamic-capping";
		nvidia,gpu_cap_as_mw;
		nvidia,gpu_supp_freq;
		nvidia,corecap = <
			6000     1000  2000 1600000   1000   2000 1600000       0    77   77
			7000     1000  3000 1600000   1000   3000 1600000     744   154  154
			8000     3000  3000 1600000   3000   3000 1600000    2481   154  154
			9000     3000  3000 1600000   3000   3000 1600000    2481   154  154
			10000    3000  4000 1600000   3000   4000 1600000    3224   231  231
			11000    5000  4000 1600000   3000   5000 1600000    3968   231  308
			12000    5000  4000 1600000   3000   6000 1600000    4563   231  384
			13000    6000  5000 1600000   3000   7000 1600000    5455   308  461
			14000    7000  5000 1600000   3000   8000 1600000    6199   308  538
			15000    7000  6000 1600000   4000   8000 1600000    6778   384  538
			16000    7000  7000 1600000   4000   9000 1600000    7521   461  615
			17000    8000  5000 1600000   4000  10000 1600000    6941   308  692
			18000    9000  6000 1600000   4000  11000 1600000    8373   384  692
			19000    9000  6000 1600000   4000  12000 1600000    8373   384  768
			20000    9000  7000 1600000   4000  13000 1600000    9116   461  768
			21000    9000  7000 1600000   4000  14000 1600000    9116   461  845
			22000    9000  8000 1600000   4000  15000 1600000    9860   538  845
			23000    9000  8000 1600000   4000  17000 1600000    9860   538  922
			24000    9000 11000 1600000   5000  17000 1600000   12091   692  922
			25000    9000 11000 1600000   5000  17000 1600000   12091   692  922
			26000    9000 12000 1600000   5000  18000 1600000   12886   768  922
			27000   10000 13000 1600000   5000  19000 1600000   13387   768  922
			28000   12000 14000 1600000   6000  20000 1600000   14451   845  999
			29000   12000 14000 1600000   6000  21000 1600000   14451   845  999
			30000   12000 16000 1600000   6000  21000 1600000   14451   845  999
			31000   13000 16000 1600000   7000  22000 1600000   14989   845  999
			32000   13000 20000 1600000   8000  22000 1600000   15605   999  999
			33000   13000 20000 1600000   8000  22000 1600000   15605   999  999
			34000   13000 20000 1600000   8000  22000 1600000   15605   999  999
			35000   13000 21000 1600000   11000 22000 1600000   16793   999  999
			36000   13000 22000 1600000   13000 22000 1600000   16793   999  999
		>;
		nvidia,core_gain = <120>;
		nvidia,init_req_watts = <20000>;
	};
};
