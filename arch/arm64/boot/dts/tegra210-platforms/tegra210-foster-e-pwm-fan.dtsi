/*
 * Copyright (c) 2014, NVIDIA CORPORATION.  All rights reserved.
 *
 * This program is free software; you can redistribute it and/or modify it
 * under the terms and conditions of the GNU General Public License,
 * version 2, as published by the Free Software Foundation.
 *
 * This program is distributed in the hope it will be useful, but WITHOUT
 * ANY WARRANTY; without even the implied warranty of MERCHANTABILITY or
 * FITNESS FOR A PARTICULAR PURPOSE.  See the GNU General Public License for
 * more details.
 */

#include "tegra210-loki-e-pwm-fan.dtsi"

/ {
	pwm-fan {
		compatible = "foster-pwm-fan";

		shared_data = <&pwm_fan_shared_data>;
		active_pwm = <0 80 120 150 200 240 245 250 252 255>;
	};
};
