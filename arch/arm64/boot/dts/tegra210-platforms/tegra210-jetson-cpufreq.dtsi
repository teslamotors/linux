/*
 * Copyright (c) 2015 NVIDIA CORPORATION. All rights reserved.
 *
 * This software is licensed under the terms of the GNU General Public
 * License version 2, as published by the Free Software Foundation, and
 * may be copied, distributed, and modified under those terms.
 *
 * This program is distributed in the hope that it will be useful,
 * but WITHOUT ANY WARRANTY; without even the implied warranty of
 * MERCHANTABILITY or FITNESS FOR A PARTICULAR PURPOSE.  See the
 * GNU General Public License for more details.
 *
 */

/ {
        cpufreq {
		compatible = "nvidia,tegra210-cpufreq";
		emc-scaling-data {
			emc-cpu-limit-table = <
				/* CPU    EMC */
				102000	68000
				204800	102000
				307200	204000
				403000	408000
				714000	665600
				1122000	800000
				1224000	1056000
				1428000	1331200
				1632000	1600000
			>;
		};
	};
};
