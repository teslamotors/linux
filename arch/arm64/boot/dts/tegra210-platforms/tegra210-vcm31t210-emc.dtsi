/*
 * Copyright (c) 2015, NVIDIA CORPORATION.  All rights reserved.
 *
 * This program is free software; you can redistribute it and/or modify
 * it under the terms of the GNU General Public License as published by
 * the Free Software Foundation; either version 2 of the License, or
 * (at your option) any later version.
 *
 * This program is distributed in the hope that it will be useful, but WITHOUT
 * ANY WARRANTY; without even the implied warranty of MERCHANTABILITY or
 * FITNESS FOR A PARTICULAR PURPOSE.  See the GNU General Public License for
 * more details.
 *
 * You should have received a copy of the GNU General Public License along
 * with this program; if not, write to the Free Software Foundation, Inc.,
 * 51 Franklin Street, Fifth Floor, Boston, MA  02110-1301, USA.
 */

/ {
	memory-controller@7001b000 {
		compatible = "nvidia,tegra21-emc";
		reg = <0x0 0x7001b000 0x0 0x800>;
		#address-cells = <1>;
		#size-cells = <0>;
		emc-table@204000 {
			compatible = "nvidia,tegra21-emc-table";
			nvidia,revision = <0x6>;
			nvidia,dvfs-version = "01_204000_NoCfgVersion_V9.7.2_V1.2";
			clock-frequency = <204000>;
			nvidia,emc-min-mv = <837>;
			nvidia,gk20a-min-mv = <1100>;
			nvidia,source = "pllp_out0";
			nvidia,src-sel-reg = <0x40188002>;
			nvidia,needs-training = <00000000>;
			nvidia,training_pattern = <0x000003>;
			nvidia,trained = <00000000>;
			nvidia,periodic_training = <00000000>;
			nvidia,trained_dram_clktree_c0d0u0 = <00000000>;
			nvidia,trained_dram_clktree_c0d0u1 = <00000000>;
			nvidia,trained_dram_clktree_c0d1u0 = <00000000>;
			nvidia,trained_dram_clktree_c0d1u1 = <00000000>;
			nvidia,trained_dram_clktree_c1d0u0 = <00000000>;
			nvidia,trained_dram_clktree_c1d0u1 = <00000000>;
			nvidia,trained_dram_clktree_c1d1u0 = <00000000>;
			nvidia,trained_dram_clktree_c1d1u1 = <00000000>;
			nvidia,current_dram_clktree_c0d0u0 = <00000000>;
			nvidia,current_dram_clktree_c0d0u1 = <00000000>;
			nvidia,current_dram_clktree_c0d1u0 = <00000000>;
			nvidia,current_dram_clktree_c0d1u1 = <00000000>;
			nvidia,current_dram_clktree_c1d0u0 = <00000000>;
			nvidia,current_dram_clktree_c1d0u1 = <00000000>;
			nvidia,current_dram_clktree_c1d1u0 = <00000000>;
			nvidia,current_dram_clktree_c1d1u1 = <00000000>;
			nvidia,run_clocks = <0x00000d>;
			nvidia,tree_margin = <0x000001>;
			nvidia,burst-regs-num = <221>;
			nvidia,burst-regs-per-ch-num = <8>;
			nvidia,trim-regs-num = <138>;
			nvidia,trim-regs-per-ch-num = <10>;
			nvidia,burst-mc-regs-num = <33>;
			nvidia,la-scale-regs-num = <24>;
			nvidia,vref-regs-num = <4>;
			nvidia,training-mod-regs-num = <20>;
			nvidia,dram-timing-regs-num = <5>;
			nvidia,emc-registers = <
				0x0000000d
				0x00000025
				0x00000013
				0x00000000
				0x00000000
				0x00000009
				0x00000004
				0x0000000b
				0x0000000d
				0x00000008
				0x0000000b
				0x00000000
				0x00000004
				0x00000020
				0x00000006
				0x00000006
				0x00000006
				0x00000003
				0x00000000
				0x00000006
				0x00000004
				0x00000002
				0x00000000
				0x00000004
				0x00000008
				0x0000000d
				0x00000005
				0x00000006
				0x00000000
				0x00000000
				0x00000002
				0x08037171
				0x0000000d
				0x00000002
				0x0000000b
				0x00010000
				0x00000012
				0x00000014
				0x00000016
				0x00000012
				0x00000014
				0x00000304
				0x00000000
				0x000000c1
				0x00000008
				0x00000008
				0x00000003
				0x00000003
				0x00000003
				0x00000012
				0x00000005
				0x00000002
				0x0000000d
				0x00000027
				0x00000027
				0x00000005
				0x00000005
				0x00000004
				0x00000009
				0x00000005
				0x00000003
				0x00000009
				0x48037171
				0x0000031c
				0x00000000
				0x9160a00d
				0x00003bbf
				0x002c00a0
				0x00008000
				0x000000be
				0x0fff0fff
				0x0fff0fff
				0x00000000
				0x00000000
				0x00000000
				0x00000000
				0x080b0000
				0x0017000b
				0x000b0018
				0x0031003f
				0x00330036
				0x00360036
				0x0031003f
				0x000b0001
				0x00000009
				0x0031003f
				0x00330036
				0x00360036
				0x0031003f
				0x000b0001
				0x00000009
				0x000b000b
				0x00170017
				0x00180018
				0x000b000b
				0x0000000b
				0x00000000
				0x00000000
				0x00000000
				0x00000000
				0x00000000
				0x00000000
				0x00000000
				0x00000000
				0x00000000
				0x00000000
				0x00000000
				0x00000000
				0x00000000
				0x00000000
				0x00000000
				0x00000000
				0x00000000
				0x00000000
				0x00000000
				0x00000000
				0x00000000
				0x00000000
				0x00000000
				0x00000000
				0x00000000
				0x00000000
				0x00000000
				0x00000000
				0x00000000
				0x00000000
				0x00000000
				0x00000000
				0x00000000
				0x00000000
				0x00000000
				0x00000000
				0x00000000
				0x00000000
				0x00000000
				0x00000000
				0x8020221f
				0x0220f40f
				0x00000012
				0x00064000
				0x000900cc
				0x00cc0015
				0x0033000a
				0xc1e00303
				0x1f13412f
				0x00010014
				0x00000804
				0x00000550
				0xf3200000
				0x0fff0fff
				0x80000713
				0x0000000a
				0x00000000
				0x00000000
				0x00000012
				0x00000012
				0x00020000
				0x10050037
				0x00000000
				0x00000010
				0x00003000
				0x0a000000
				0x02000111
				0x00000008
				0x00030808
				0x00015000
				0x00101010
				0x00001600
				0x00000000
				0x00000000
				0x00000000
				0x00000033
				0x00000040
				0x00000800
				0x00001000
				0x00001000
				0x00000800
				0x00000000
				0x00000000
				0x00000020
				0x00000000
				0x00000000
				0x00000000
				0x00000000
				0x00000000
				0x00000000
				0xefffefff
				0xc0c0c0c0
				0xc0c0c0c0
				0xdcdcdcdc
				0x0a0a0a0a
				0x0a0a0a0a
				0x0a0a0a0a
				0x01186033
				0x00000000
				0x00000000
				0x00000014
				0x0000000a
				0x00000016
				0x08161414
				0x00000012
				0x00010000
				0x00009080
				0x07070404
				0x00040065
				0x0513801f
				0x1f101100
				0x00000014
				0x00107240
				0x01124000
				0x01125b6a
				0x0f081000
				0x00105800
				0x1110fc00
				0x0f081300
				0x00105800
				0x1114fc00
				0x07000300
				0x00107240
				0x55553c5a
				0x48161414
			>;
			nvidia,emc-burst-regs-per-ch = <
				0x880c6b6b
				0x880c6b6b
				0x480c6b6b
				0x480c6b6b
				0x8c0e6b6b
				0x8c0e6b6b
				0x4c0e6b6b
				0x4c0e6b6b
			>;
			nvidia,emc-shadow-regs-ca-train = <
				0x0000000d
				0x00000025
				0x00000013
				0x00000000
				0x00000000
				0x00000009
				0x00000004
				0x0000000b
				0x0000000d
				0x00000008
				0x0000000b
				0x00000000
				0x00000004
				0x00000020
				0x00000006
				0x00000006
				0x00000006
				0x00000003
				0x00000000
				0x00000006
				0x00000004
				0x00000002
				0x00000000
				0x00000004
				0x00000008
				0x0000000d
				0x00000005
				0x00000006
				0x00000000
				0x00000000
				0x00000002
				0x08037171
				0x0000000d
				0x00000002
				0x0000000b
				0x00010000
				0x00000012
				0x00000014
				0x00000016
				0x00000012
				0x00000014
				0x00000304
				0x00000000
				0x000000c1
				0x00000008
				0x00000008
				0x00000003
				0x00000003
				0x00000003
				0x00000012
				0x00000005
				0x00000002
				0x0000000d
				0x00000027
				0x00000027
				0x00000005
				0x00000005
				0x00000004
				0x00000009
				0x00000005
				0x00000003
				0x00000009
				0x48037171
				0x0000031c
				0x00000000
				0x9960a00d
				0x00003bbf
				0x002c00a0
				0x00008000
				0x00000055
				0x0fff0fff
				0x0fff0fff
				0x00000000
				0x00000000
				0x00000000
				0x00000000
				0x080b0000
				0x0017000b
				0x000b0018
				0x0031003f
				0x00330036
				0x00360036
				0x0031003f
				0x000b0001
				0x00000009
				0x0031003f
				0x00330036
				0x00360036
				0x0031003f
				0x000b0001
				0x00000009
				0x000b000b
				0x00170017
				0x00180018
				0x000b000b
				0x0000000b
				0x00000000
				0x00000000
				0x00000000
				0x00000000
				0x00000000
				0x00000000
				0x00000000
				0x00000000
				0x00000000
				0x00000000
				0x00000000
				0x00000000
				0x00000000
				0x00000000
				0x00000000
				0x00000000
				0x00000000
				0x00000000
				0x00000000
				0x00000000
				0x00000000
				0x00000000
				0x00000000
				0x00000000
				0x00000000
				0x00000000
				0x00000000
				0x00000000
				0x00000000
				0x00000000
				0x00000000
				0x00000000
				0x00000000
				0x00000000
				0x00000000
				0x00000000
				0x00000000
				0x00000000
				0x00000000
				0x00000000
				0x8020221f
				0x0220f40f
				0x00000012
				0x00064000
				0x000900cc
				0x00cc0015
				0x0033000a
				0xc1e00303
				0x1f13412f
				0x00010014
				0x00000804
				0x00000550
				0xf3200000
				0x0fff0fff
				0x80000713
				0x0000000a
				0x00000000
				0x00000000
				0x00000012
				0x00000012
				0x00020000
				0x10008033
				0x00000000
				0x00000000
				0x00003000
				0x0a000000
				0x02000111
				0x00000008
				0x00030808
				0x00015000
				0x00101010
				0x00001600
				0x00000000
				0x00000000
				0x00000000
				0x00000033
				0x00000040
				0x00000800
				0x00001000
				0x00001000
				0x00000800
				0x00000000
				0x00000000
				0x00000020
				0x00000000
				0x00000000
				0x00000000
				0x00000000
				0x00000000
				0x00000000
				0xefffefff
				0xc0c0c0c0
				0xc0c0c0c0
				0xdcdcdcdc
				0x0a0a0a0a
				0x0a0a0a0a
				0x0a0a0a0a
				0x01186033
				0x00000001
				0x0000001f
				0x00000018
				0x00000008
				0x0000001a
				0x08161414
				0x00000010
				0x00010000
				0x00019080
				0x07070404
				0x00040065
				0x0513801f
				0x1f101100
				0x00000014
				0x00107240
				0x01124000
				0x01125b6a
				0x0f081000
				0x00105800
				0x1110fc00
				0x0f081300
				0x00105800
				0x1114fc00
				0x07000300
				0x00107240
				0x55553c5a
				0x48161414
			>;
			nvidia,emc-shadow-regs-quse-train = <
				0x0000000d
				0x00000025
				0x00000013
				0x00000000
				0x00000000
				0x00000009
				0x00000004
				0x0000000a
				0x0000000d
				0x00000008
				0x0000000b
				0x00000000
				0x00000004
				0x00000020
				0x00000006
				0x00000006
				0x00000006
				0x0000000c
				0x00000000
				0x00000006
				0x00000004
				0x00000002
				0x00000000
				0x00000004
				0x00000008
				0x0000000d
				0x00000003
				0x00000002
				0x10000000
				0x00000000
				0x00000003
				0x08037171
				0x0000000b
				0x00000001
				0x80000000
				0x00040000
				0x00000012
				0x00000014
				0x00000016
				0x00000012
				0x00000014
				0x00000304
				0x00000000
				0x000000c1
				0x00000008
				0x00000008
				0x00000003
				0x00000003
				0x00000003
				0x00000012
				0x00000005
				0x00000002
				0x0000000d
				0x00000027
				0x00000027
				0x00000005
				0x00000005
				0x00000004
				0x00000009
				0x00000005
				0x00000003
				0x00000009
				0x48037171
				0x0000031c
				0x00000000
				0x9160400d
				0x00003bbf
				0x002c00a0
				0x00008000
				0x000000be
				0x0fff0fff
				0x0fff0fff
				0x00000000
				0x00000000
				0x00000000
				0x00000000
				0x080b0000
				0x0017000b
				0x000b0018
				0x0031003f
				0x00330036
				0x00360036
				0x0031003f
				0x000b0001
				0x00000009
				0x0031003f
				0x00330036
				0x00360036
				0x0031003f
				0x000b0001
				0x00000009
				0x000b000b
				0x00170017
				0x00180018
				0x000b000b
				0x0000000b
				0x00000000
				0x00000000
				0x00000000
				0x00000000
				0x00000000
				0x00000000
				0x00000000
				0x00000000
				0x00000000
				0x00000000
				0x00000000
				0x00000000
				0x00000000
				0x00000000
				0x00000000
				0x00000000
				0x00000000
				0x00000000
				0x00000000
				0x00000000
				0x00000000
				0x00000000
				0x00000000
				0x00000000
				0x00000000
				0x00000000
				0x00000000
				0x00000000
				0x00000000
				0x00000000
				0x00000000
				0x00000000
				0x00000000
				0x00000000
				0x00000000
				0x00000000
				0x00000000
				0x00000000
				0x00000000
				0x00000000
				0x8020221f
				0x0220f40f
				0x00000012
				0x00064000
				0x000900cc
				0x00cc0015
				0x0033000a
				0xc1e00303
				0x1f13412f
				0x00010014
				0x00000804
				0x00000550
				0xf3200000
				0x0fff0fff
				0x80000713
				0x0000000a
				0x00000000
				0x00000000
				0x00000012
				0x00000012
				0x30020000
				0x10058037
				0x00000000
				0x00000010
				0x00003000
				0x0a000000
				0x02000111
				0x00000008
				0x00030808
				0x00015000
				0x00101010
				0x00001600
				0x00000000
				0x00000000
				0x00000000
				0x00000033
				0x00000040
				0x00000800
				0x00001000
				0x00001000
				0x00000800
				0x00000000
				0x00000000
				0x00000020
				0x00000000
				0x00000000
				0x00000000
				0x00000000
				0x00000000
				0x00000000
				0xefffefff
				0xc0c0c0c0
				0xc0c0c0c0
				0xdcdcdcdc
				0x0a0a0a0a
				0x0a0a0a0a
				0x0a0a0a0a
				0x01186033
				0x00000001
				0x0000001f
				0x0000001e
				0x00000014
				0x00000020
				0x08161414
				0x0000001c
				0x00040000
				0x00009080
				0x07070404
				0x00040065
				0x0513801f
				0x1f101100
				0x00000014
				0x00107240
				0x01124000
				0x01125b6a
				0x0f081000
				0x00105800
				0x1110fc00
				0x0f081300
				0x00105800
				0x1114fc00
				0x07000300
				0x00107240
				0x55553c5a
				0x48161414
			>;
			nvidia,emc-shadow-regs-rdwr-train = <
				0x0000000d
				0x00000025
				0x00000013
				0x00000000
				0x00000000
				0x00000009
				0x00000004
				0x0000000e
				0x0000000d
				0x00000008
				0x0000000b
				0x00000000
				0x00000004
				0x00000020
				0x00000006
				0x00000006
				0x00000006
				0x00000013
				0x00000013
				0x00000006
				0x00000004
				0x00000002
				0x00000000
				0x00000004
				0x00000008
				0x0000000d
				0x00000005
				0x00000006
				0x30000000
				0x30000002
				0x00000002
				0x08037171
				0x0000000d
				0x00000002
				0x0000000b
				0x00040000
				0x00000012
				0x00000014
				0x00000016
				0x00000012
				0x00000014
				0x00000304
				0x00000000
				0x000000c1
				0x00000008
				0x00000008
				0x00000003
				0x00000003
				0x00000003
				0x00000012
				0x00000005
				0x00000002
				0x0000000d
				0x00000027
				0x00000027
				0x00000005
				0x00000005
				0x00000004
				0x00000009
				0x00000005
				0x00000003
				0x00000009
				0x48037171
				0x0000031c
				0x00000000
				0x9160a00d
				0x00003bbf
				0x002c00a0
				0x00008000
				0x000000be
				0x0fff0fff
				0x0fff0fff
				0x00000000
				0x00000000
				0x00000000
				0x00000000
				0x080b0000
				0x0017000b
				0x000b0018
				0x0031003f
				0x00330036
				0x00360036
				0x0031003f
				0x000b0001
				0x00000009
				0x0031003f
				0x00330036
				0x00360036
				0x0031003f
				0x000b0001
				0x00000009
				0x000b000b
				0x00170017
				0x00180018
				0x000b000b
				0x0000000b
				0x00000000
				0x00000000
				0x00000000
				0x00000000
				0x00000000
				0x00000000
				0x00000000
				0x00000000
				0x00000000
				0x00000000
				0x00000000
				0x00000000
				0x00000000
				0x00000000
				0x00000000
				0x00000000
				0x00000000
				0x00000000
				0x00000000
				0x00000000
				0x00000000
				0x00000000
				0x00000000
				0x00000000
				0x00000000
				0x00000000
				0x00000000
				0x00000000
				0x00000000
				0x00000000
				0x00000000
				0x00000000
				0x00000000
				0x00000000
				0x00000000
				0x00000000
				0x00000000
				0x00000000
				0x00000000
				0x00000000
				0x8020221f
				0x0220f40f
				0x00000012
				0x00064000
				0x000900cc
				0x00cc0015
				0x0033000a
				0xc1e00303
				0x1f13412f
				0x00010014
				0x00000804
				0x00000550
				0xf3200000
				0x0fff0fff
				0x80000713
				0x0000000a
				0x00000000
				0x00000000
				0x00000012
				0x00000012
				0x00020000
				0x10050037
				0x00000000
				0x00000010
				0x00003000
				0x0a000000
				0x02000111
				0x00000008
				0x00030808
				0x00015000
				0x00101010
				0x00001600
				0x00000000
				0x00000000
				0x00000000
				0x00000033
				0x00000040
				0x00000800
				0x00001000
				0x00001000
				0x00000800
				0x00000000
				0x00000000
				0x00000020
				0x00000000
				0x00000000
				0x00000000
				0x00000000
				0x00000000
				0x00000000
				0xefffefff
				0xc0c0c0c0
				0xc0c0c0c0
				0xdcdcdcdc
				0x0a0a0a0a
				0x0a0a0a0a
				0x0a0a0a0a
				0x01186033
				0x00000001
				0x00000000
				0x00000014
				0x0000000a
				0x00000016
				0x08161414
				0x00000012
				0x00040000
				0x0000b080
				0x07070404
				0x00040065
				0x0513801f
				0x1f101100
				0x00000014
				0x00107240
				0x01124000
				0x01125b6a
				0x0f081000
				0x00105800
				0x1110fc00
				0x0f081300
				0x00105800
				0x1114fc00
				0x07000300
				0x00107240
				0x55553c5a
				0x48161414
			>;
			nvidia,emc-trim-regs = <
				0x00280028
				0x00280028
				0x00280028
				0x00280028
				0x00280028
				0x00280028
				0x00280028
				0x00280028
				0x00000000
				0x00000000
				0x00000000
				0x00000000
				0x00000000
				0x00000000
				0x00000000
				0x00000000
				0x00000000
				0x00000000
				0x00000000
				0x00000000
				0x00000000
				0x00000000
				0x00000000
				0x00000000
				0x00000000
				0x00000000
				0x00000000
				0x00000000
				0x00000000
				0x00000000
				0x00000000
				0x00000000
				0x00000000
				0x00000000
				0x00000000
				0x00000000
				0x00000000
				0x00000000
				0x00000000
				0x00000000
				0x00000000
				0x00000000
				0x00000000
				0x00000000
				0x00000000
				0x00000000
				0x00000000
				0x00000000
				0x00000000
				0x00000000
				0x00000000
				0x00000000
				0x00000000
				0x00000000
				0x00000000
				0x00000000
				0x11111111
				0x11111111
				0x28282828
				0x28282828
				0x00000000
				0x00000000
				0x00000000
				0x00000000
				0x0017000b
				0x000b0018
				0x00000000
				0x00000000
				0x00000000
				0x00000000
				0x00000000
				0x00000000
				0x00000000
				0x00000000
				0x00000000
				0x00000000
				0x00000000
				0x00000000
				0x00000000
				0x00000000
				0x00000000
				0x00000000
				0x00000000
				0x00000000
				0x00000000
				0x00000000
				0x00000000
				0x00000000
				0x00000000
				0x00000000
				0x00000000
				0x00000000
				0x00000000
				0x00000000
				0x00000000
				0x00000000
				0x00000000
				0x00000000
				0x00000000
				0x00000000
				0x00000000
				0x00000000
				0x00000000
				0x00000000
				0x00000000
				0x00000000
				0x00000000
				0x00000000
				0x00000000
				0x00000000
				0x00000000
				0x00000000
				0x00000000
				0x00000000
				0x00000000
				0x00000000
				0x00000000
				0x00000000
				0x00000000
				0x00000000
				0x00000000
				0x00000000
				0x00000000
				0x00000000
				0x00000000
				0x00000000
				0x00000000
				0x00000000
				0x00000000
				0x00000000
				0x00000000
				0x00000000
				0x00000000
				0x00000000
				0x00000000
				0x00000000
				0x00000000
				0x00000000
			>;
			nvidia,emc-trim-regs-per-ch = <
				0x00000000
				0x00000000
				0x00249249
				0x00249249
				0x00249249
				0x00249249
				0x00000000
				0x00000000
				0x00000000
				0x00000000
			>;
			nvidia,emc-vref-regs = <
				0x00000000
				0x00000000
				0x00000000
				0x00000000
			>;
			nvidia,emc-dram-timing-regs = <
				0x00000012
				0x00000104
				0x000000b4
				0x00000018
				0x00000006
			>;
			nvidia,emc-training-mod-regs = <
				0x00000000
				0x00000000
				0x00000000
				0x00000000
				0x00000000
				0x00000000
				0x00000000
				0x00000000
				0x00000000
				0x00000000
				0x00000000
				0x00000000
				0x00000000
				0x00000000
				0x00000000
				0x00000000
				0x00000000
				0x00000000
				0x00000000
				0x00000000
			>;
			nvidia,emc-save-restore-mod-regs = <
				0x00000000
				0x00000000
				0x00000000
				0x00000000
				0x00000000
				0x00000000
				0x00000000
				0x00000000
				0x00000000
				0x00000000
				0x00000000
				0x00000000
				0x08000001
				0x8000004c
				0x000a1020
				0x80001028
				0x00000001
				0x00000000
				0x00000003
				0x00000001
			>;
			nvidia,emc-burst-mc-regs = <
			0x08000001
			0x8000004c
			0x000a1020
			0x80001028
			0x00000001
			0x00000000
			0x00000003
			0x00000001
			0x00000002
			0x00000001
			0x00000002
			0x00000005
			0x00000001
			0x00000001
			0x00000004
			0x00000008
			0x00000005
			0x00000004
			0x02020000
			0x00030201
			0x71c30504
			0x70000f0f
			0x00000000
			0x001f0000
			0x0080001a
			0x0080001a
			0x0080001a
			0x0080001a
			0x0080001a
			0x0080001a
			0x0080001a
			0x0080001a
			0x0080001a
			>;
			nvidia,emc-la-scale-regs = <
			0x0000001b
			0x0080001a
			0x0000024c
			0x00ff00b2
			0x00ff00da
			0x00ff009d
			0x00ff00ff
			0x00ff000c
			0x00ff00ff
			0x00ff000c
			0x007f0049
			0x00ff0080
			0x00ff0004
			0x000800ad
			0x000000ff
			0x00ff0004
			0x00ff00c6
			0x00ff00c6
			0x00ff006d
			0x00ff00ff
			0x00ff00e2
			0x000000ff
			0x00000080
			0x00ff00ff
			>;
			nvidia,min-mrs-wait = <0x00000015>;
			nvidia,emc-mrw = <0x08010004>;
			nvidia,emc-mrw2 = <0x08020000>;
			nvidia,emc-mrw3 = <0x080d0000>;
			nvidia,emc-mrw4 = <0xc0000000>;
			nvidia,emc-mrw9 = <0x0c0e6b6b>;
			nvidia,emc-mrs = <0x00000000>;
			nvidia,emc-emrs = <0x00000000>;
			nvidia,emc-emrs2 = <0x00000000>;
			nvidia,emc-auto-cal-config = <0xa01a51d8>;
			nvidia,emc-auto-cal-config2 = <0x05500000>;
			nvidia,emc-auto-cal-config3 = <0x00770000>;
			nvidia,emc-auto-cal-config4 = <0x00770000>;
			nvidia,emc-auto-cal-config5 = <0x00770000>;
			nvidia,emc-auto-cal-config6 = <0x00770000>;
			nvidia,emc-auto-cal-config7 = <0x00770000>;
			nvidia,emc-auto-cal-config8 = <0x00770000>;
			nvidia,emc-cfg-2 = <0x00110805>;
			nvidia,emc-sel-dpd-ctrl = <0x00040008>;
			nvidia,emc-fdpd-ctrl-cmd-no-ramp = <0x00000001>;
			nvidia,dll-clk-src = <0x40188002>;
			nvidia,clk-out-enb-x-0-clk-enb-emc-dll = <0x00000001>;
			nvidia,emc-clock-latency-change = <0x00000d5c>;
		};
		emc-table@1600000 {
			compatible = "nvidia,tegra21-emc-table";
			nvidia,revision = <0x6>;
			nvidia,dvfs-version = "01_1600000_NoCfgVersion_V9.7.2_V1.2";
			clock-frequency = <1600000>;
			nvidia,emc-min-mv = <900>;
			nvidia,gk20a-min-mv = <1100>;
			nvidia,source = "pllm_ud";
			nvidia,src-sel-reg = <0x80188000>;
			nvidia,needs-training = <0x0002f0>;
			nvidia,training_pattern = <0x000003>;
			nvidia,trained = <00000000>;
			nvidia,periodic_training = <0x000001>;
			nvidia,trained_dram_clktree_c0d0u0 = <00000000>;
			nvidia,trained_dram_clktree_c0d0u1 = <00000000>;
			nvidia,trained_dram_clktree_c0d1u0 = <00000000>;
			nvidia,trained_dram_clktree_c0d1u1 = <00000000>;
			nvidia,trained_dram_clktree_c1d0u0 = <00000000>;
			nvidia,trained_dram_clktree_c1d0u1 = <00000000>;
			nvidia,trained_dram_clktree_c1d1u0 = <00000000>;
			nvidia,trained_dram_clktree_c1d1u1 = <00000000>;
			nvidia,current_dram_clktree_c0d0u0 = <00000000>;
			nvidia,current_dram_clktree_c0d0u1 = <00000000>;
			nvidia,current_dram_clktree_c0d1u0 = <00000000>;
			nvidia,current_dram_clktree_c0d1u1 = <00000000>;
			nvidia,current_dram_clktree_c1d0u0 = <00000000>;
			nvidia,current_dram_clktree_c1d0u1 = <00000000>;
			nvidia,current_dram_clktree_c1d1u0 = <00000000>;
			nvidia,current_dram_clktree_c1d1u1 = <00000000>;
			nvidia,run_clocks = <0x000040>;
			nvidia,tree_margin = <0x000001>;
			nvidia,burst-regs-num = <221>;
			nvidia,burst-regs-per-ch-num = <8>;
			nvidia,trim-regs-num = <138>;
			nvidia,trim-regs-per-ch-num = <10>;
			nvidia,burst-mc-regs-num = <33>;
			nvidia,la-scale-regs-num = <24>;
			nvidia,vref-regs-num = <4>;
			nvidia,training-mod-regs-num = <20>;
			nvidia,dram-timing-regs-num = <5>;
			nvidia,emc-registers = <
				0x00000060
				0x00000120
				0x00000090
				0x00000000
				0x00000000
				0x00000044
				0x0000001d
				0x0000002a
				0x0000001f
				0x0000000c
				0x0000002d
				0x00000000
				0x00000004
				0x00000020
				0x0000001d
				0x0000001d
				0x00000010
				0x00000018
				0x00000016
				0x00000006
				0x0000000e
				0x0000000c
				0x0000000a
				0x0000000e
				0x00000008
				0x0000000d
				0x00000025
				0x00000008
				0x1000001d
				0x10000002
				0x00000015
				0x08037171
				0x0000001c
				0x00000022
				0x0000000d
				0x0006000d
				0x00000034
				0x0000003c
				0x0000003e
				0x0000003a
				0x0000003c
				0x00001820
				0x00000000
				0x00000608
				0x00000010
				0x00000010
				0x00000003
				0x00000003
				0x00000003
				0x00000037
				0x0000000e
				0x00000002
				0x0000002e
				0x0000012c
				0x0000012c
				0x0000000d
				0x00000018
				0x0000000c
				0x00000040
				0x00000022
				0x00000003
				0x00000014
				0x48037171
				0x00001860
				0x00000000
				0x9960a00d
				0x00003bbf
				0xc00001bb
				0x00008000
				0x00000055
				0x00000000
				0x00000000
				0x00000000
				0x00000000
				0x00000000
				0x00000000
				0x080b6666
				0x000e0006
				0x0006000e
				0x00090000
				0x000c0000
				0x00090000
				0x00090000
				0x00070000
				0x00000005
				0x00090000
				0x000c0000
				0x00090000
				0x00090000
				0x00070000
				0x00000005
				0x00060006
				0x000e000e
				0x000e000e
				0x00060006
				0x00000006
				0x00000000
				0x00000000
				0x00000000
				0x00000000
				0x00000000
				0x00000000
				0x00000000
				0x00000000
				0x00000000
				0x00000000
				0x00000000
				0x00000000
				0x00000000
				0x00000000
				0x00000000
				0x00000000
				0x00000000
				0x00000000
				0x00000000
				0x00000000
				0x00000000
				0x00000000
				0x00000000
				0x00000000
				0x00000000
				0x00000000
				0x00000000
				0x00000000
				0x00000000
				0x00000000
				0x00000000
				0x00000000
				0x00000000
				0x00000000
				0x00000000
				0x00000000
				0x00000000
				0x00000000
				0x00000000
				0x00000000
				0x8020221f
				0x0220f40f
				0x00000012
				0x00064000
				0x00310640
				0x0640002f
				0x01900010
				0xc1e0030a
				0x1f13612f
				0x00000014
				0x0000080d
				0x00000550
				0xf3200000
				0x00000000
				0x8000308c
				0x0000002c
				0x00000000
				0x00000000
				0x00000012
				0x00000012
				0x00020000
				0x00000033
				0x00000000
				0x00000011
				0x00003000
				0x02000000
				0x02000101
				0x00000007
				0x00030808
				0x00015000
				0x00102020
				0x1fff1fff
				0x00000000
				0x00000000
				0x00000000
				0x00000034
				0x00000040
				0x00000800
				0x00001000
				0x00001000
				0x00000800
				0x00000000
				0x00000000
				0x00000020
				0x00000000
				0x00000000
				0x00000000
				0x00000000
				0x00000000
				0x00000000
				0xefff2210
				0x00000000
				0x00000000
				0xdcdcdcdc
				0x0a0a0a0a
				0x0a0a0a0a
				0x0a0a0a0a
				0x01186190
				0x00000000
				0x00000000
				0x0000003c
				0x0000002c
				0x0000003e
				0x08161414
				0x00000034
				0x0006000d
				0x00009080
				0x07070404
				0x00040320
				0x0513801f
				0x1f101100
				0x00000014
				0x00103200
				0x01124000
				0x01125b6a
				0x0f081000
				0x00105800
				0x1110fc00
				0x0f085300
				0x00105800
				0x1114fc00
				0x07004300
				0x00103200
				0x55553c5a
				0x48161414
			>;
			nvidia,emc-burst-regs-per-ch = <
				0x880c4848
				0x880c4848
				0x480c4848
				0x480c4848
				0x8c0e4848
				0x8c0e4848
				0x4c0e4848
				0x4c0e4848
			>;
			nvidia,emc-shadow-regs-ca-train = <
				0x00000060
				0x00000120
				0x00000090
				0x00000000
				0x00000000
				0x00000044
				0x0000001d
				0x0000002a
				0x0000001f
				0x0000000c
				0x0000002d
				0x00000000
				0x00000004
				0x00000020
				0x0000001d
				0x0000001d
				0x00000010
				0x00000018
				0x00000016
				0x00000006
				0x0000000e
				0x0000000c
				0x0000000a
				0x0000000e
				0x00000008
				0x0000000d
				0x00000025
				0x00000008
				0x1000001d
				0x10000002
				0x00000015
				0x08037171
				0x0000001c
				0x00000022
				0x0000000d
				0x0006000d
				0x00000034
				0x0000003c
				0x0000003e
				0x0000003a
				0x0000003c
				0x00001820
				0x00000000
				0x00000608
				0x00000010
				0x00000010
				0x00000003
				0x00000003
				0x00000003
				0x00000037
				0x0000000e
				0x00000002
				0x0000002e
				0x0000012c
				0x0000012c
				0x0000000d
				0x00000018
				0x0000000c
				0x00000040
				0x00000022
				0x00000003
				0x00000014
				0x48037171
				0x00001860
				0x00000000
				0x9960a00d
				0x00003bbf
				0xc00001bb
				0x00008000
				0x00000055
				0x00000000
				0x00000000
				0x00000000
				0x00000000
				0x00000000
				0x00000000
				0x080b6666
				0x000e0006
				0x0006000e
				0x00090000
				0x000c0000
				0x00090000
				0x00090000
				0x00070000
				0x00000005
				0x00090000
				0x000c0000
				0x00090000
				0x00090000
				0x00070000
				0x00000005
				0x00060006
				0x000e000e
				0x000e000e
				0x00060006
				0x00000006
				0x00000000
				0x00000000
				0x00000000
				0x00000000
				0x00000000
				0x00000000
				0x00000000
				0x00000000
				0x00000000
				0x00000000
				0x00000000
				0x00000000
				0x00000000
				0x00000000
				0x00000000
				0x00000000
				0x00000000
				0x00000000
				0x00000000
				0x00000000
				0x00000000
				0x00000000
				0x00000000
				0x00000000
				0x00000000
				0x00000000
				0x00000000
				0x00000000
				0x00000000
				0x00000000
				0x00000000
				0x00000000
				0x00000000
				0x00000000
				0x00000000
				0x00000000
				0x00000000
				0x00000000
				0x00000000
				0x00000000
				0x8020221f
				0x0220f40f
				0x00000012
				0x00064000
				0x00310640
				0x0640002f
				0x01900010
				0xc1e0030a
				0x1f13612f
				0x00000014
				0x0000080d
				0x00000550
				0xf3200000
				0x00000000
				0x8000308c
				0x0000002c
				0x00000000
				0x00000000
				0x00000012
				0x00000012
				0x00020000
				0x00008033
				0x00000000
				0x00000000
				0x00003000
				0x02000000
				0x02000101
				0x00000007
				0x00030808
				0x00015000
				0x00102020
				0x1fff1fff
				0x00000000
				0x00000000
				0x00000000
				0x00000034
				0x00000040
				0x00000800
				0x00001000
				0x00001000
				0x00000800
				0x00000000
				0x00000000
				0x00000020
				0x00000000
				0x00000000
				0x00000000
				0x00000000
				0x00000000
				0x00000000
				0xefff2210
				0x00000000
				0x00000000
				0xdcdcdcdc
				0x0a0a0a0a
				0x0a0a0a0a
				0x0a0a0a0a
				0x01186190
				0x00000001
				0x0000001f
				0x00000042
				0x0000002c
				0x00000044
				0x08161414
				0x00000034
				0x0006000d
				0x00019080
				0x07070404
				0x00040320
				0x0513801f
				0x1f101100
				0x00000014
				0x00103200
				0x01124000
				0x01125b6a
				0x0f081000
				0x00105800
				0x1110fc00
				0x0f085300
				0x00105800
				0x1114fc00
				0x07004300
				0x00103200
				0x55553c5a
				0x48161414
			>;
			nvidia,emc-shadow-regs-quse-train = <
				0x00000060
				0x00000120
				0x00000090
				0x00000000
				0x00000000
				0x00000044
				0x0000001d
				0x00000029
				0x0000001f
				0x0000000c
				0x0000002d
				0x00000000
				0x00000004
				0x00000020
				0x0000001d
				0x0000001d
				0x00000010
				0x00000012
				0x00000016
				0x00000006
				0x0000000e
				0x0000000c
				0x0000000a
				0x0000000e
				0x00000008
				0x0000000d
				0x00000022
				0x00000002
				0x1000001d
				0x10000002
				0x00000015
				0x08037171
				0x0000001b
				0x00000001
				0x80000000
				0x0006000d
				0x00000034
				0x0000003c
				0x0000003e
				0x0000003a
				0x0000003c
				0x00001820
				0x00000000
				0x00000608
				0x00000010
				0x00000010
				0x00000003
				0x00000003
				0x00000003
				0x00000037
				0x0000000e
				0x00000002
				0x0000002e
				0x0000012c
				0x0000012c
				0x0000000d
				0x00000018
				0x0000000c
				0x00000040
				0x00000022
				0x00000003
				0x00000014
				0x48037171
				0x00001860
				0x00000000
				0x9960400d
				0x00003bbf
				0xc00001bb
				0x00008000
				0x00000055
				0x00000000
				0x00000000
				0x00000000
				0x00000000
				0x00000000
				0x00000000
				0x080b6666
				0x000e0006
				0x0006000e
				0x00090000
				0x000c0000
				0x00090000
				0x00090000
				0x00070000
				0x00000005
				0x00090000
				0x000c0000
				0x00090000
				0x00090000
				0x00070000
				0x00000005
				0x00060006
				0x000e000e
				0x000e000e
				0x00060006
				0x00000006
				0x00000000
				0x00000000
				0x00000000
				0x00000000
				0x00000000
				0x00000000
				0x00000000
				0x00000000
				0x00000000
				0x00000000
				0x00000000
				0x00000000
				0x00000000
				0x00000000
				0x00000000
				0x00000000
				0x00000000
				0x00000000
				0x00000000
				0x00000000
				0x00000000
				0x00000000
				0x00000000
				0x00000000
				0x00000000
				0x00000000
				0x00000000
				0x00000000
				0x00000000
				0x00000000
				0x00000000
				0x00000000
				0x00000000
				0x00000000
				0x00000000
				0x00000000
				0x00000000
				0x00000000
				0x00000000
				0x00000000
				0x8020221f
				0x0220f40f
				0x00000012
				0x00064000
				0x00310640
				0x0640002f
				0x01900010
				0xc1e0030a
				0x1f13612f
				0x00000014
				0x0000080d
				0x00000550
				0xf3200000
				0x00000000
				0x8000308c
				0x0000002c
				0x00000000
				0x00000000
				0x00000012
				0x00000012
				0x30020000
				0x00008033
				0x00000000
				0x00000011
				0x00003000
				0x02000000
				0x02000101
				0x00000007
				0x00030808
				0x00015000
				0x00102020
				0x1fff1fff
				0x00000000
				0x00000000
				0x00000000
				0x00000034
				0x00000040
				0x00000800
				0x00001000
				0x00001000
				0x00000800
				0x00000000
				0x00000000
				0x00000020
				0x00000000
				0x00000000
				0x00000000
				0x00000000
				0x00000000
				0x00000000
				0xefff2210
				0x00000000
				0x00000000
				0xdcdcdcdc
				0x0a0a0a0a
				0x0a0a0a0a
				0x0a0a0a0a
				0x01186190
				0x00000001
				0x0000001f
				0x00000046
				0x00000036
				0x00000048
				0x08161414
				0x0000003e
				0x0006000d
				0x00009080
				0x07070404
				0x00040320
				0x0513801f
				0x1f101100
				0x00000014
				0x00103200
				0x01124000
				0x01125b6a
				0x0f081000
				0x00105800
				0x1110fc00
				0x0f085300
				0x00105800
				0x1114fc00
				0x07004300
				0x00103200
				0x55553c5a
				0x48161414
			>;
			nvidia,emc-shadow-regs-rdwr-train = <
				0x00000060
				0x00000120
				0x00000090
				0x00000000
				0x00000000
				0x00000044
				0x0000001d
				0x0000002a
				0x0000001f
				0x0000000c
				0x0000002d
				0x00000000
				0x00000004
				0x00000020
				0x0000001d
				0x0000001d
				0x00000010
				0x00000018
				0x00000016
				0x00000006
				0x0000000e
				0x0000000c
				0x0000000a
				0x0000000e
				0x00000008
				0x0000000d
				0x00000025
				0x00000008
				0x1000001d
				0x10000002
				0x00000015
				0x08037171
				0x0000001c
				0x00000022
				0x0000000d
				0x0006000d
				0x00000034
				0x0000003c
				0x0000003e
				0x0000003a
				0x0000003c
				0x00001820
				0x00000000
				0x00000608
				0x00000010
				0x00000010
				0x00000003
				0x00000003
				0x00000003
				0x00000037
				0x0000000e
				0x00000002
				0x0000002e
				0x0000012c
				0x0000012c
				0x0000000d
				0x00000018
				0x0000000c
				0x00000040
				0x00000022
				0x00000003
				0x00000014
				0x48037171
				0x00001860
				0x00000000
				0x9960a00d
				0x00003bbf
				0xc00001bb
				0x00008000
				0x00000055
				0x00000000
				0x00000000
				0x00000000
				0x00000000
				0x00000000
				0x00000000
				0x080b6666
				0x000e0006
				0x0006000e
				0x00090000
				0x000c0000
				0x00090000
				0x00090000
				0x00070000
				0x00000005
				0x00090000
				0x000c0000
				0x00090000
				0x00090000
				0x00070000
				0x00000005
				0x00060006
				0x000e000e
				0x000e000e
				0x00060006
				0x00000006
				0x00000000
				0x00000000
				0x00000000
				0x00000000
				0x00000000
				0x00000000
				0x00000000
				0x00000000
				0x00000000
				0x00000000
				0x00000000
				0x00000000
				0x00000000
				0x00000000
				0x00000000
				0x00000000
				0x00000000
				0x00000000
				0x00000000
				0x00000000
				0x00000000
				0x00000000
				0x00000000
				0x00000000
				0x00000000
				0x00000000
				0x00000000
				0x00000000
				0x00000000
				0x00000000
				0x00000000
				0x00000000
				0x00000000
				0x00000000
				0x00000000
				0x00000000
				0x00000000
				0x00000000
				0x00000000
				0x00000000
				0x8020221f
				0x0220f40f
				0x00000012
				0x00064000
				0x00310640
				0x0640002f
				0x01900010
				0xc1e0030a
				0x1f13612f
				0x00000014
				0x0000080d
				0x00000550
				0xf3200000
				0x00000000
				0x8000308c
				0x0000002c
				0x00000000
				0x00000000
				0x00000012
				0x00000012
				0x00020000
				0x00000033
				0x00000000
				0x00000011
				0x00003000
				0x02000000
				0x02000101
				0x00000007
				0x00030808
				0x00015000
				0x00102020
				0x1fff1fff
				0x00000000
				0x00000000
				0x00000000
				0x00000034
				0x00000040
				0x00000800
				0x00001000
				0x00001000
				0x00000800
				0x00000000
				0x00000000
				0x00000020
				0x00000000
				0x00000000
				0x00000000
				0x00000000
				0x00000000
				0x00000000
				0xefff2210
				0x00000000
				0x00000000
				0xdcdcdcdc
				0x0a0a0a0a
				0x0a0a0a0a
				0x0a0a0a0a
				0x01186190
				0x00000001
				0x00000000
				0x0000003c
				0x0000002c
				0x0000003e
				0x08161414
				0x00000034
				0x0006000d
				0x0000b080
				0x07070404
				0x00040320
				0x0513801f
				0x1f101100
				0x00000014
				0x00103200
				0x01124000
				0x01125b6a
				0x0f081000
				0x00105800
				0x1110fc00
				0x0f085300
				0x00105800
				0x1114fc00
				0x07004300
				0x00103200
				0x55553c5a
				0x48161414
			>;
			nvidia,emc-trim-regs = <
				0x00200020
				0x00200020
				0x00200020
				0x00200020
				0x00200020
				0x00200020
				0x00200020
				0x00200020
				0x00000000
				0x00000000
				0x00000000
				0x00000000
				0x00000000
				0x00000000
				0x00000000
				0x00000000
				0x00000000
				0x00000000
				0x00000000
				0x00000000
				0x00000000
				0x00000000
				0x00000000
				0x00000000
				0x00000000
				0x00000000
				0x00000000
				0x00000000
				0x00000000
				0x00000000
				0x00000000
				0x00000000
				0x00000000
				0x00000000
				0x00000000
				0x00000000
				0x00000000
				0x00000000
				0x00000000
				0x00000000
				0x00000000
				0x00000000
				0x00000000
				0x00000000
				0x00000000
				0x00000000
				0x00000000
				0x00000000
				0x00000000
				0x00000000
				0x00000000
				0x00000000
				0x00000000
				0x00000000
				0x00000000
				0x00000000
				0x11111111
				0x11111111
				0x11111111
				0x11111111
				0x00290027
				0x002c0022
				0x002c0022
				0x00290027
				0x000e0006
				0x0006000e
				0x00290027
				0x002c0022
				0x002c0022
				0x00290027
				0x00000000
				0x00000000
				0x00000000
				0x00000000
				0x00000000
				0x00000000
				0x00000000
				0x00000000
				0x00000000
				0x00000000
				0x00000000
				0x00000000
				0x00000000
				0x00000000
				0x00000000
				0x00000000
				0x00000000
				0x00000000
				0x00000000
				0x00000000
				0x00000000
				0x00000000
				0x00000000
				0x00000000
				0x00000000
				0x00000000
				0x00000000
				0x00000000
				0x00000000
				0x00000000
				0x00000000
				0x00000000
				0x00000000
				0x00000000
				0x00000000
				0x00000000
				0x00000000
				0x00000000
				0x00000000
				0x00000000
				0x00000000
				0x00000000
				0x00000000
				0x00000000
				0x00000000
				0x00000000
				0x00000000
				0x00000000
				0x00000000
				0x00000000
				0x00000000
				0x00000000
				0x00000000
				0x00000000
				0x00000000
				0x00000000
				0x00000000
				0x00000000
				0x00000000
				0x00000000
				0x00000000
				0x00000000
				0x00000000
				0x00000000
				0x00000000
				0x00000000
				0x00000000
				0x00000000
			>;
			nvidia,emc-trim-regs-per-ch = <
				0x00000000
				0x00000000
				0x00000000
				0x00000000
				0x00000000
				0x00000000
				0x00000000
				0x00000000
				0x00000000
				0x00000000
			>;
			nvidia,emc-vref-regs = <
				0x00000000
				0x00000000
				0x00000000
				0x00000000
			>;
			nvidia,emc-dram-timing-regs = <
				0x00000012
				0x00000104
				0x000000b4
				0x00000007
				0x00000020
			>;
			nvidia,emc-training-mod-regs = <
				0x00000000
				0x00000000
				0x00000000
				0x00000000
				0x00000000
				0x00000000
				0x00000000
				0x00000000
				0x00000000
				0x00000000
				0x00000000
				0x00000000
				0x00000000
				0x00000000
				0x00000000
				0x00000000
				0x00000000
				0x00000000
				0x00000000
				0x00000000
			>;
			nvidia,emc-save-restore-mod-regs = <
				0x00000000
				0x00000000
				0x00000000
				0x00000000
				0x00000000
				0x00000000
				0x00000000
				0x00000000
				0x00000004
				0x00000004
				0x00000004
				0x00000004
				0x0000000c
				0x80000080
				0x000a1020
				0x80001028
				0x00000006
				0x00000007
				0x00000018
				0x0000000f
			>;
			nvidia,emc-burst-mc-regs = <
			0x0000000c
			0x80000080
			0x000a1020
			0x80001028
			0x00000006
			0x00000007
			0x00000018
			0x0000000f
			0x0000000f
			0x00000003
			0x00000003
			0x0000000d
			0x00000001
			0x00000001
			0x0000000c
			0x00000008
			0x00000009
			0x00000023
			0x04060000
			0x000d080c
			0x718c2419
			0x70000f0f
			0x00000000
			0x001f0000
			0x0080001a
			0x0080001a
			0x0080001a
			0x0080001a
			0x0080001a
			0x0080001a
			0x0080001a
			0x0080001a
			0x0080001a
			>;
			nvidia,emc-la-scale-regs = <
			0x000000d0
			0x0080001a
			0x00001203
			0x0080003d
			0x00800038
			0x00800041
			0x00800090
			0x00800005
			0x00800090
			0x00800005
			0x00340049
			0x00800080
			0x00800004
			0x00080016
			0x00000080
			0x00800004
			0x00800019
			0x00800019
			0x00800018
			0x00800095
			0x0080001d
			0x00000080
			0x0000002c
			0x00800080
			>;
			nvidia,min-mrs-wait = <0x0000002f>;
			nvidia,emc-mrw = <0x08010054>;
			nvidia,emc-mrw2 = <0x0802002d>;
			nvidia,emc-mrw3 = <0x080d0000>;
			nvidia,emc-mrw4 = <0xc0000000>;
			nvidia,emc-mrw9 = <0x0c0e4848>;
			nvidia,emc-mrs = <0x00000000>;
			nvidia,emc-emrs = <0x00000000>;
			nvidia,emc-emrs2 = <0x00000000>;
			nvidia,emc-auto-cal-config = <0xa01a51d8>;
			nvidia,emc-auto-cal-config2 = <0x05500000>;
			nvidia,emc-auto-cal-config3 = <0x00770000>;
			nvidia,emc-auto-cal-config4 = <0x00770000>;
			nvidia,emc-auto-cal-config5 = <0x00770000>;
			nvidia,emc-auto-cal-config6 = <0x00770000>;
			nvidia,emc-auto-cal-config7 = <0x00770000>;
			nvidia,emc-auto-cal-config8 = <0x00770000>;
			nvidia,emc-cfg-2 = <0x00110835>;
			nvidia,emc-sel-dpd-ctrl = <0x00040000>;
			nvidia,emc-fdpd-ctrl-cmd-no-ramp = <0x00000001>;
			nvidia,dll-clk-src = <0x80188000>;
			nvidia,clk-out-enb-x-0-clk-enb-emc-dll = <0x00000000>;
			nvidia,emc-clock-latency-change = <0x0000049c>;
		};
	};
};
