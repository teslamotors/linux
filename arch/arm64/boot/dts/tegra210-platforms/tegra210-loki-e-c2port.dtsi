/*
 * Copyright (c) 2014, NVIDIA CORPORATION.  All rights reserved.
 *
 * This program is free software; you can redistribute it and/or modify it
 * under the terms and conditions of the GNU General Public License,
 * version 2, as published by the Free Software Foundation.
 *
 * This program is distributed in the hope it will be useful, but WITHOUT
 * ANY WARRANTY; without even the implied warranty of MERCHANTABILITY or
 * FITNESS FOR A PARTICULAR PURPOSE.  See the GNU General Public License for
 * more details.
 */

/ {
	tegra_c2port {
		compatible = "tegra_c2port";
		name = "tegra_c2port";
		id = <0>;
		gpio_c2ck = <&gpio TEGRA_GPIO(H, 1) 0>;
		gpio_c2d = <&gpio TEGRA_GPIO(B, 4) 0>;
		};
};
