## arch/arm64/mach-tegra/Kconfig
```kconfig
source drivers/devfreq/Kconfig

source arch/arm/mach-tegra/Kconfig

config ARCH_TEGRA_13x_SOC
	bool "Tegra 13x family SOC"
	select CPU_V8
	select DENVER_CPU
	select ARM_GIC
	select ARCH_REQUIRE_GPIOLIB
	select USB_ARCH_HAS_EHCI if USB_SUPPORT
	select USB_EHCI_TEGRA if USB_SUPPORT
	select USB_ULPI if USB_SUPPORT
	select USB_ULPI_VIEWPORT if USB_SUPPORT
	select REPORT_PRESENT_CPUS if TEGRA_CPUQUIET
	select ARCH_SUPPORTS_MSI if PCI_TEGRA
	select PCI_MSI if PCI_TEGRA
	select NVMAP_CACHE_MAINT_BY_SET_WAYS if TEGRA_NVMAP
	select NVMAP_CACHE_MAINT_BY_SET_WAYS_ON_ONE_CPU if TEGRA_NVMAP
	select ARCH_TEGRA_HAS_CL_DVFS
	select TEGRA_DUAL_CBUS
	select ARCH_TEGRA_VIC
	select SOC_BUS
	select THERMAL
	select PM_GENERIC_DOMAINS if PM
	select RESET_CONTROLLER
	select MACH_HAS_SND_SOC_TEGRA_MAX98090 if SND_SOC
	select MACH_HAS_SND_SOC_TEGRA_RT5639 if SND_SOC
	select ZONE_DMA if !TEGRA_IOMMU_SMMU
	select CMA
	help
	  Support for NVIDIA Tegra 13x family of SoCs, based upon the
	  NVIDIA Denver CPU

config ARCH_TEGRA_21x_SOC
	bool "Tegra 21x family SOC"
	select CPU_V8
	select ARM_GIC
	select ARCH_REQUIRE_GPIOLIB
	select USB_ARCH_HAS_EHCI if USB_SUPPORT
	select USB_EHCI_TEGRA if USB_SUPPORT
	select USB_ULPI if USB_SUPPORT
	select USB_ULPI_VIEWPORT if USB_SUPPORT
	select REPORT_PRESENT_CPUS if TEGRA_CPUQUIET
	select ARCH_SUPPORTS_MSI if PCI_TEGRA
	select PCI_MSI if PCI_TEGRA
	select ARCH_TEGRA_HAS_CL_DVFS
	select TEGRA_DUAL_CBUS
	select ARCH_TEGRA_VIC
	select ARCH_TEGRA_APE
	select RESET_CONTROLLER
	select SOC_BUS
	select THERMAL
	select PM_GENERIC_DOMAINS if PM
	select PINCTRL
	select PINCTRL_TEGRA210
	select PADCTRL
	select SYSTEM_PMIC
	select HAVE_FUNCTION_TRACER
	select CMA
	select NVMAP_CACHE_MAINT_BY_SET_WAYS if TEGRA_NVMAP
	select NVMAP_CACHE_MAINT_BY_SET_WAYS_ON_ONE_CPU if TEGRA_NVMAP
	select TEGRA_ISOMGR
	select TEGRA_ISOMGR_SYSFS
	select ARCH_HAS_PASR if STAGING
	select SKIP_LATE_PASR_SETUP if PASR
	help
	  Support for NVIDIA Tegra 21x family of SoCs, based upon the
	  NVIDIA Denver CPU

config ARCH_TEGRA_VCM31T210
	bool "Enable VCM31 T210 MCM"
	select ARCH_TEGRA_21x_SOC
	help
	  Support for NVIDIA VCM31 T210, based on the Tegra210 SoC

config ARCH_TEGRA_APE
	bool "Tegra Audio Processing Engine(APE) present"
	default n
	help
	  Say Y here if the SOC supports
	  the Tegra Audio Processing Engine (APE)
	  which handles audio specific
	  tasks.

config MACH_GRENADA
	bool "Grenada board"
	select TEGRA_FPGA_PLATFORM
	help
	  Support for NVIDIA GRENADA FPGA development platform

config MACH_EXUMA
	bool "Exuma board"
	select TEGRA_FPGA_PLATFORM
	help
	  Support for NVIDIA Exuma FPGA development platform

config MACH_T132REF
	bool "T132REF board"
	depends on ARCH_TEGRA_13x_SOC
	select SYSEDP_FRAMEWORK
	help
	  Support for NVIDIA Exuma FPGA development platform

config TEGRA_HMP_CLUSTER_CONTROL
	bool "HMP Cluster control"
	help
	  Supports a cluster switch model for heterogenous clusters.

config TEGRA_THERMAL_THROTTLE
	bool "Enable throttling of CPU speed on overtemp"
	depends on CPU_FREQ
	depends on THERMAL
	help
	  Also requires enabling a temperature sensor such as NCT1008.
```

## arch/x86/acrn/Kconfig
```kconfig
# SPDX-License-Identifier: GPL-2.0
#
# This Kconfig describes ACRN options
#

config ACRN
	bool "ACRN guest support"
	depends on X86_64
	depends on PARAVIRT
	help
	  This is the Linux ACRN port.  Enabling this will allow the
	  kernel to boot in a paravirtualized environment under the
	  ACRN hypervisor.

config ACRN_HV
	bool "Enable services run on ACRN hypervisor"
	depends on ACRN
	help
	  This option is needed if were to run ACRN services linux on top of
	  ACRN hypervisor.
```

## arch/x86/configs/apl_x86_64_abl_defconfig
```kconfig
CONFIG_APL_SPI_BRD=y
CONFIG_LOCALVERSION="-PLK"
# CONFIG_LOCALVERSION_AUTO is not set
CONFIG_KERNEL_LZ4=y
CONFIG_SYSVIPC=y
CONFIG_NO_HZ=y
CONFIG_HIGH_RES_TIMERS=y
CONFIG_BSD_PROCESS_ACCT=y
CONFIG_IKCONFIG=m
CONFIG_IKCONFIG_PROC=y
CONFIG_LOG_BUF_SHIFT=20
CONFIG_CGROUPS=y
CONFIG_CGROUP_SCHED=y
CONFIG_CGROUP_FREEZER=y
CONFIG_CPUSETS=y
CONFIG_CGROUP_CPUACCT=y
CONFIG_NAMESPACES=y
CONFIG_USER_NS=y
CONFIG_CC_OPTIMIZE_FOR_SIZE=y
CONFIG_EMBEDDED=y
# CONFIG_COMPAT_BRK is not set
CONFIG_KPROBES=y
CONFIG_MODULES=y
CONFIG_MODULE_UNLOAD=y
CONFIG_MODULE_FORCE_UNLOAD=y
CONFIG_PARTITION_ADVANCED=y
CONFIG_OSF_PARTITION=y
CONFIG_AMIGA_PARTITION=y
CONFIG_MAC_PARTITION=y
CONFIG_BSD_DISKLABEL=y
CONFIG_MINIX_SUBPARTITION=y
CONFIG_SOLARIS_X86_PARTITION=y
CONFIG_UNIXWARE_DISKLABEL=y
CONFIG_SGI_PARTITION=y
CONFIG_SUN_PARTITION=y
CONFIG_KARMA_PARTITION=y
CONFIG_SMP=y
CONFIG_X86_INTEL_LPSS=y
CONFIG_X86_INTEL_SBI_APL=m
CONFIG_MCORE2=y
CONFIG_NR_CPUS=4
CONFIG_SCHED_SMT=y
CONFIG_PREEMPT=y
CONFIG_X86_REROUTE_FOR_BROKEN_BOOT_IRQS=y
# CONFIG_X86_MCE_AMD is not set
CONFIG_X86_MSR=y
CONFIG_X86_CPUID=y
CONFIG_X86_CHECK_BIOS_CORRUPTION=y
# CONFIG_MTRR_SANITIZER is not set
CONFIG_HZ_1000=y
CONFIG_KEXEC=y
CONFIG_CRASH_DUMP=y
# CONFIG_RELOCATABLE is not set
CONFIG_PHYSICAL_ALIGN=0x1000000
# CONFIG_ACPI_AC is not set
# CONFIG_ACPI_BATTERY is not set
# CONFIG_ACPI_FAN is not set
CONFIG_CPU_FREQ_DEFAULT_GOV_USERSPACE=y
CONFIG_CPU_FREQ_GOV_PERFORMANCE=y
CONFIG_CPU_FREQ_GOV_ONDEMAND=y
CONFIG_PCIEPORTBUS=y
CONFIG_PCI_MSI=y
CONFIG_PCI_PRI=y
CONFIG_PCI_PASID=y
CONFIG_BINFMT_MISC=y
CONFIG_NET=y
CONFIG_PACKET=y
CONFIG_UNIX=y
CONFIG_XFRM_SUB_POLICY=y
CONFIG_XFRM_MIGRATE=y
CONFIG_INET=y
CONFIG_IP_MULTICAST=y
CONFIG_IP_PNP=y
CONFIG_IP_PNP_DHCP=y
# CONFIG_INET_XFRM_MODE_TRANSPORT is not set
# CONFIG_INET_XFRM_MODE_TUNNEL is not set
# CONFIG_INET_XFRM_MODE_BEET is not set
# CONFIG_INET_DIAG is not set
# CONFIG_IPV6_SIT is not set
CONFIG_NETLABEL=y
CONFIG_NETFILTER=y
CONFIG_NF_CONNTRACK=m
CONFIG_IP_SET=y
CONFIG_IP_VS=m
CONFIG_NF_CONNTRACK_IPV4=m
CONFIG_IP_NF_IPTABLES=m
CONFIG_IP_NF_NAT=m
CONFIG_IP_NF_TARGET_MASQUERADE=m
CONFIG_IP_SCTP=m
CONFIG_BRIDGE=m
# CONFIG_BRIDGE_IGMP_SNOOPING is not set
CONFIG_VLAN_8021Q=y
CONFIG_NET_SCHED=y
CONFIG_DNS_RESOLVER=y
CONFIG_BT=m
CONFIG_BT_RFCOMM=m
CONFIG_BT_RFCOMM_TTY=y
CONFIG_BT_BNEP=m
CONFIG_BT_BNEP_MC_FILTER=y
CONFIG_BT_BNEP_PROTO_FILTER=y
CONFIG_BT_HIDP=m
CONFIG_BT_HCIUART=m
CONFIG_BT_HCIUART_H4=y
CONFIG_BT_MRVL=m
CONFIG_CFG80211=m
CONFIG_WIMAX=m
CONFIG_RFKILL=m
CONFIG_RFKILL_INPUT=y
CONFIG_UEVENT_HELPER_PATH="/sbin/hotplug"
CONFIG_DEVTMPFS=y
CONFIG_DEVTMPFS_MOUNT=y
CONFIG_CONNECTOR=y
CONFIG_BLK_DEV_LOOP=m
CONFIG_INTEL_MEI_ME=m
CONFIG_INTEL_MEI_TXE=m
CONFIG_BLK_DEV_SD=m
CONFIG_BLK_DEV_SR=m
CONFIG_BLK_DEV_SR_VENDOR=y
CONFIG_CHR_DEV_SG=m
CONFIG_SCSI_CONSTANTS=y
CONFIG_SCSI_SPI_ATTRS=m
# CONFIG_SCSI_LOWLEVEL is not set
CONFIG_ATA=m
# CONFIG_ATA_VERBOSE_ERROR is not set
# CONFIG_SATA_PMP is not set
CONFIG_SATA_AHCI=m
CONFIG_SATA_AHCI_PLATFORM=m
CONFIG_ATA_PIIX=m
CONFIG_PATA_SCH=m
CONFIG_PATA_MPIIX=m
CONFIG_NETDEVICES=y
CONFIG_TUN=m
# CONFIG_NET_VENDOR_3COM is not set
# CONFIG_NET_VENDOR_ADAPTEC is not set
# CONFIG_NET_VENDOR_AGERE is not set
# CONFIG_NET_VENDOR_ALTEON is not set
# CONFIG_NET_VENDOR_AMD is not set
# CONFIG_NET_VENDOR_ARC is not set
# CONFIG_NET_VENDOR_ATHEROS is not set
# CONFIG_NET_CADENCE is not set
# CONFIG_NET_VENDOR_BROADCOM is not set
# CONFIG_NET_VENDOR_BROCADE is not set
# CONFIG_NET_VENDOR_CHELSIO is not set
# CONFIG_NET_VENDOR_CISCO is not set
# CONFIG_NET_VENDOR_DEC is not set
# CONFIG_NET_VENDOR_DLINK is not set
# CONFIG_NET_VENDOR_EMULEX is not set
# CONFIG_NET_VENDOR_EXAR is not set
# CONFIG_NET_VENDOR_HP is not set
CONFIG_IGB=m
# CONFIG_NET_VENDOR_I825XX is not set
# CONFIG_NET_VENDOR_MARVELL is not set
# CONFIG_NET_VENDOR_MELLANOX is not set
# CONFIG_NET_VENDOR_MICREL is not set
# CONFIG_NET_VENDOR_MICROCHIP is not set
# CONFIG_NET_VENDOR_MYRI is not set
# CONFIG_NET_VENDOR_NATSEMI is not set
# CONFIG_NET_VENDOR_NVIDIA is not set
# CONFIG_NET_VENDOR_OKI is not set
# CONFIG_NET_PACKET_ENGINE is not set
# CONFIG_NET_VENDOR_QLOGIC is not set
# CONFIG_NET_VENDOR_QUALCOMM is not set
# CONFIG_NET_VENDOR_REALTEK is not set
# CONFIG_NET_VENDOR_RDC is not set
# CONFIG_NET_VENDOR_ROCKER is not set
# CONFIG_NET_VENDOR_SAMSUNG is not set
# CONFIG_NET_VENDOR_SEEQ is not set
# CONFIG_NET_VENDOR_SILAN is not set
# CONFIG_NET_VENDOR_SIS is not set
# CONFIG_NET_VENDOR_SMSC is not set
# CONFIG_NET_VENDOR_STMICRO is not set
# CONFIG_NET_VENDOR_SUN is not set
# CONFIG_NET_VENDOR_TEHUTI is not set
# CONFIG_NET_VENDOR_TI is not set
# CONFIG_NET_VENDOR_VIA is not set
# CONFIG_NET_VENDOR_WIZNET is not set
CONFIG_SLIP=m
CONFIG_SLIP_COMPRESSED=y
CONFIG_SLIP_SMART=y
CONFIG_USB_RTL8150=m
CONFIG_USB_RTL8152=m
CONFIG_USB_USBNET=m
CONFIG_MWIFIEX=m
CONFIG_MWIFIEX_PCIE=m
CONFIG_INPUT_POLLDEV=y
CONFIG_INPUT_SPARSEKMAP=y
CONFIG_INPUT_EVDEV=y
# CONFIG_INPUT_KEYBOARD is not set
# CONFIG_INPUT_MOUSE is not set
# CONFIG_SERIO is not set
# CONFIG_LEGACY_PTYS is not set
CONFIG_SERIAL_NONSTANDARD=y
CONFIG_CBC_LDISC=y
CONFIG_SERIAL_8250=y
CONFIG_SERIAL_8250_CONSOLE=y
CONFIG_SERIAL_8250_DW=y
CONFIG_HW_RANDOM=y
# CONFIG_HW_RANDOM_INTEL is not set
# CONFIG_HW_RANDOM_AMD is not set
CONFIG_NVRAM=m
CONFIG_TCG_TPM=m
CONFIG_TCG_TIS=m
CONFIG_TCG_CRB=m
CONFIG_I2C_CHARDEV=m
CONFIG_I2C_DESIGNWARE_PLATFORM=y
CONFIG_SPI=y
CONFIG_SPI_DESIGNWARE=m
CONFIG_SPI_DW_PCI=m
CONFIG_SPI_PXA2XX=m
CONFIG_SPI_SPIDEV=m
CONFIG_PINCTRL_BROXTON=y
CONFIG_GPIO_SYSFS=y
CONFIG_GPIO_GENERIC_PLATFORM=m
CONFIG_GPIO_ICH=m
CONFIG_POWER_SUPPLY=y
CONFIG_HWMON=m
CONFIG_WATCHDOG=y
CONFIG_MFD_INTEL_LPSS_PCI=y
CONFIG_MEDIA_SUPPORT=y
CONFIG_MEDIA_CAMERA_SUPPORT=y
CONFIG_MEDIA_CONTROLLER=y
CONFIG_VIDEO_V4L2_SUBDEV_API=y
CONFIG_MEDIA_PCI_SUPPORT=y
CONFIG_VIDEO_INTEL_IPU=y
CONFIG_VIDEO_INTEL_IPU_FW_LIB=y
CONFIG_V4L_PLATFORM_DRIVERS=y
CONFIG_INTEL_IPU4_BXT_GP_PDATA=y
CONFIG_INTEL_IPU4_ADV7481=y
# CONFIG_MEDIA_SUBDRV_AUTOSELECT is not set
CONFIG_VIDEO_CRLMODULE=y
CONFIG_AGP=y
CONFIG_AGP_INTEL=m
CONFIG_DRM=y
# CONFIG_DRM_FBDEV_EMULATION is not set
CONFIG_DRM_LOAD_EDID_FIRMWARE=y
CONFIG_DRM_I915=y
CONFIG_FB=m
CONFIG_FB_UVESA=m
CONFIG_BACKLIGHT_GENERIC=m
CONFIG_VGACON_SOFT_SCROLLBACK=y
CONFIG_SOUND=m
CONFIG_SND=m
CONFIG_SND_DYNAMIC_MINORS=y
CONFIG_SND_SEQUENCER=m
CONFIG_SND_SEQ_DUMMY=m
# CONFIG_SND_DRIVERS is not set
# CONFIG_SND_PCI is not set
# CONFIG_SND_SPI is not set
CONFIG_SND_USB_AUDIO=m
CONFIG_SND_SOC=m
CONFIG_SND_SOC_INTEL_SKYLAKE=m
CONFIG_SND_SOC_INTEL_BXT_GPMRB_MACH=m
CONFIG_HIDRAW=y
CONFIG_HID_GENERIC=m
CONFIG_HID_MULTITOUCH=m
CONFIG_HID_PID=y
CONFIG_USB_HIDDEV=y
CONFIG_USB=m
CONFIG_USB_ANNOUNCE_NEW_DEVICES=y
CONFIG_USB_OC_NOTIFICATION=y
CONFIG_USB_MON=m
CONFIG_USB_XHCI_HCD=m
CONFIG_USB_EHCI_HCD=m
CONFIG_USB_EHCI_ROOT_HUB_TT=y
CONFIG_USB_OHCI_HCD=m
CONFIG_USB_UHCI_HCD=m
CONFIG_USB_ACM=m
CONFIG_USB_STORAGE=m
CONFIG_USB_DWC3=m
CONFIG_USB_GADGET=m
CONFIG_MMC=y
CONFIG_MMC_BLOCK_MINORS=16
CONFIG_MMC_SDHCI=y
CONFIG_MMC_SDHCI_PCI=y
CONFIG_MMC_SDHCI_PLTFM=y
CONFIG_EDAC=y
CONFIG_RTC_CLASS=y
# CONFIG_RTC_HCTOSYS is not set
CONFIG_RTC_DRV_CMOS=m
CONFIG_DMADEVICES=y
CONFIG_INTEL_IDMA64=m
CONFIG_DMATEST=m
# CONFIG_HYPER_DMABUF is not set
# CONFIG_X86_PLATFORM_DEVICES is not set
CONFIG_PWM=y
CONFIG_PWM_LPSS_PCI=m
# CONFIG_DMIID is not set
CONFIG_EXT4_FS=y
CONFIG_EXT4_FS_SECURITY=y
CONFIG_FANOTIFY=y
CONFIG_AUTOFS4_FS=m
CONFIG_MSDOS_FS=m
CONFIG_VFAT_FS=m
CONFIG_PROC_KCORE=y
CONFIG_TMPFS_POSIX_ACL=y
CONFIG_HUGETLBFS=y
# CONFIG_MISC_FILESYSTEMS is not set
CONFIG_NFS_FS=m
CONFIG_NLS_DEFAULT="utf8"
CONFIG_NLS_CODEPAGE_437=y
CONFIG_NLS_ASCII=y
CONFIG_NLS_ISO8859_1=y
CONFIG_NLS_UTF8=y
CONFIG_PRINTK_TIME=y
# CONFIG_ENABLE_WARN_DEPRECATED is not set
# CONFIG_UNUSED_SYMBOLS is not set
CONFIG_DEBUG_MEMORY_INIT=y
CONFIG_OPTIMIZE_INLINING=y
CONFIG_FASTBOOT_PCI_PROBE=y
CONFIG_FASTBOOT_FW_LOAD=y
CONFIG_SECURITY=y
CONFIG_SECURITY_NETWORK=y
CONFIG_KEYSTORE=y
CONFIG_KEYSTORE_TESTMODE=y
CONFIG_KEYSTORE_TEST_MIGRATION=y
CONFIG_KEYSTORE_SECURE_BOOT_IGNORE=y
CONFIG_CRYPTO_AUTHENC=y
CONFIG_CRYPTO_MD5=y
CONFIG_CRYPTO_ARC4=y
CONFIG_CRYPTO_DES=y
CONFIG_CRYPTO_DEFLATE=m
# CONFIG_VIRTUALIZATION is not set
CONFIG_CRC8=m
CONFIG_XZ_DEC=y
```
