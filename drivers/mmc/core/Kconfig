## drivers/staging/iio/meter/Kconfig
```kconfig
#
# IIO meter drivers configuration
#
menu "Active energy metering IC"

config ADE7753
	tristate "Analog Devices ADE7753/6 Single-Phase Multifunction Metering IC Driver"
	depends on SPI
	help
	  Say yes here to build support for Analog Devices ADE7753 Single-Phase Multifunction
	  Metering IC with di/dt Sensor Interface.

config ADE7754
	tristate "Analog Devices ADE7754 Polyphase Multifunction Energy Metering IC Driver"
	depends on SPI
	help
	  Say yes here to build support for Analog Devices ADE7754 Polyphase
	  Multifunction Energy Metering IC Driver.

config ADE7758
	tristate "Analog Devices ADE7758 Poly Phase Multifunction Energy Metering IC Driver"
	depends on SPI
	select IIO_TRIGGER if IIO_BUFFER
	select IIO_KFIFO_BUF if IIO_BUFFER
	help
	  Say yes here to build support for Analog Devices ADE7758 Polyphase
	  Multifunction Energy Metering IC with Per Phase Information Driver.

config ADE7759
	tristate "Analog Devices ADE7759 Active Energy Metering IC Driver"
	depends on SPI
	help
	  Say yes here to build support for Analog Devices ADE7758 Active Energy
	  Metering IC with di/dt Sensor Interface.

config ADE7854
	tristate "Analog Devices ADE7854/58/68/78 Polyphase Multifunction Energy Metering IC Driver"
	depends on SPI || I2C
	help
	  Say yes here to build support for Analog Devices ADE7854/58/68/78 Polyphase
	  Multifunction Energy Metering IC Driver.

config ADE7854_I2C
	tristate "support I2C bus connection"
	depends on ADE7854 && I2C
	default y
	help
	  Say Y here if you have ADE7854/58/68/78 hooked to an I2C bus.

	  To compile this driver as a module, choose M here: the
	  module will be called ade7854-i2c.

config ADE7854_SPI
	tristate "support SPI bus connection"
	depends on ADE7854 && SPI
	default y
	help
	  Say Y here if you have ADE7854/58/68/78 hooked to a SPI bus.

	  To compile this driver as a module, choose M here: the
	  module will be called ade7854-spi.

config INA219
	tristate "TI INA219 bidirectional current/power monitor"
	depends on I2C
	help
	  TI INA219 is High- or Low-Side Measurement,Bidirectional
	  CURRENT/POWER MONITOR with I2C Interface.
	  Say Y here if you have INA219 hooked to a I2C bus.

config INA230
	tristate "TI INA230 bidirectional current/power monitor"
	depends on I2C
	help
	  TI INA230 is High- or Low-Side Measurement,Bidirectional
	  CURRENT/POWER MONITOR with I2C Interface.
	  Say Y here if you have INA230 hooked to a I2C bus.

config INA3221
	tristate "TI INA3221 3-Channel Shunt and Bus Voltage Monitor"
	depends on I2C
	help
	  TI INA3221 is Triple-Channel, High-Side Measurement, Shunt and Bus
	  Voltage Monitor with I2C Interface
	  Say Y here if you have INA3221 hooked to a I2C bus.

endmenu
```

## drivers/staging/mttcan/Kconfig.t18x
```kconfig
config MTTCAN
	tristate "Bosch M_TTCAN Devices"
	depends on ARCH_TEGRA_18x_SOC && CAN
	select STAGING
	help
	  Support for the Bosch M_TTCAN driver. The Bosch MTTCAN CAN
	  controller is having two independent CAN interfaces. These
	  intefaces supports CAN-FD and TT-CAN. This driver will require
	  SocketCAN support enabled in kernel.
```

## drivers/staging/pasr/Kconfig
```kconfig
config ARCH_HAS_PASR
	bool

config PASR
	bool "DDR Partial Array Self-Refresh"
	depends on ARCH_HAS_PASR
	---help---
	  PASR consists on masking the refresh of unused segments or banks
	  when DDR is in self-refresh state.

config SKIP_LATE_PASR_SETUP
	bool "skip late PASR setup"
	def_bool n
	depends on PASR
	---help---
	  PASR has its own spin lock which is initialized during the late setup.
	  In few implementations this lock is not needed as other locks protect pasr code
	  from race. Use this config to disable pasr's explicit locking in such cases.

config PASR_DEBUG
	bool "Add PASR debug prints"
	def_bool n
	depends on PASR
```

## drivers/tachometer/Kconfig.t18x
```kconfig
menuconfig TACHOMETER
	bool "Tachometer support"
	help
	  Say Y here to Tachometer support

	  This framework provides a generic interface to Tach
	  devices.

if TACHOMETER

config TACHOMETER_TEGRA
	bool "Tegra Tachometer client driver"
	depends on ARCH_TEGRA_18x_SOC && TACHOMETER
	help
	  This option enables Tegra Tachometer client driver

	  Tegra Tachometer driver used to measure the speed
	  of PWM based fan in terms of RPM.
endif
```

## drivers/trusty/Kconfig
```kconfig
#
# Trusty
#

menu "Trusty"

config TRUSTY
	tristate "Trusty"
	depends on X86_64
	default n

config TRUSTY_FIQ
	tristate
	depends on TRUSTY

config TRUSTY_FIQ_ARM
	tristate
	depends on TRUSTY
	depends on ARM
	select FIQ_GLUE
	select TRUSTY_FIQ
	default y

config TRUSTY_FIQ_ARM64
	tristate
	depends on TRUSTY
	depends on ARM64
	select FIQ_GLUE
	select TRUSTY_FIQ
	default y

config TRUSTY_LOG
	tristate "Trusty Log support"
	depends on TRUSTY
	default y

config TRUSTY_VIRTIO
	tristate "Trusty virtio support"
	depends on TRUSTY
	select VIRTIO
	default y

config TRUSTY_VIRTIO_IPC
	tristate "Trusty Virtio IPC driver"
	depends on TRUSTY_VIRTIO
	default y
	help
	  This module adds support for communications with Trusty Services

	  If you choose to build a module, it'll be called trusty-ipc.
	  Say N if unsure.

config TRUSTY_BACKUP_TIMER
	tristate "Trusty backup timer"
	depends on TRUSTY
	default y
	help
	  This module adds support for Trusty backup timer. Trusty backup
	  timer might be required on platforms that might loose state of
	  secure timer in deep idle state.

	  If you choose to build a module, it'll be called trusty-timer.
	  Say N if unsure.


endmenu
```

## drivers/tty/cbc/Kconfig
```kconfig
# SPDX-License-Identifier: GPL-2.0
#
# CBC (CarrierBoardCommunication) subsystem configuration
#

config CBC_LDISC
		 tristate "CBC (Carrier Board Communication) line discipline"
		 depends on TTY
		 help
		   The CBC driver implements a line discipline supporting
		   the proprietary CBC (Carrier Board Communication) protocol.

		   The CBC protocol is a serial line protocol with multiplexing
		   intended to be used in automotive IVI platforms for multi-
		   plexed communication between a vehicle IOC and CPU. It is
		   designed to transport small data packets (up to 64 bytes)
		   and features a transport protocol to transport larger data
		   chunks over a point to point connection.

		   When initialised the driver presents a number of channels as
		   character devices.
```
