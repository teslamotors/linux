## drivers/mmc/core/Kconfig
```kconfig
#
# MMC core configuration
#

config MMC_CLKGATE
	bool "MMC host clock gating"
	help
	  This will attempt to aggressively gate the clock to the MMC card.
	  This is done to save power due to gating off the logic and bus
	  noise when the MMC card is not in use. Your host driver has to
	  support handling this in order for it to be of any use.

	  If unsure, say N.

config MMC_EMBEDDED_SDIO
	boolean "MMC embedded SDIO device support (EXPERIMENTAL)"
	help
	  If you say Y here, support will be added for embedded SDIO
	  devices which do not contain the necessary enumeration
	  support in hardware to be properly detected.

config MMC_PARANOID_SD_INIT
	bool "Enable paranoid SD card initialization (EXPERIMENTAL)"
	help
	  If you say Y here, the MMC layer will be extra paranoid
	  about re-trying SD init requests. This can be a useful
	  work-around for buggy controllers and hardware. Enable
	  if you are experiencing issues with SD detection.

config MMC_FREQ_SCALING
	bool "Enable dynamic frequency scaling for SD/MMC/SDIO devices"
	depends on EXPERIMENTAL
	default N
	help
	  If you say Y here, the MMC layer will vary the SD/MMC/SDIO
	  device frequency dynamically. Enable this config only if
	  there is a custom implementation to determine the frequency
	  using the device stats.

config EMMC_BLKTRACE
	bool "eMMC blktrace"
	default n
	help
	  eMMC block trace support

config TRACE_MINIMIZING
	bool "Blktrace minimizing for test"
	default n
	help
		If you take some tests for App loading performance time,
		use this configuration & see blktrace.

config GC_SEPARATE
	bool "Using delay GC Separate for cpu usage"
	default n
	help
		If you don't select this option, it will be operated by timer.
```

## drivers/net/ethernet/nvidia/eqos/Kconfig.t18x
```kconfig
# Copyright (c) 2015, NVIDIA CORPORATION.  All rights reserved.
#
# This program is free software; you can redistribute it and/or modify it
# under the terms and conditions of the GNU General Public License,
# version 2, as published by the Free Software Foundation.
#
# This program is distributed in the hope it will be useful, but WITHOUT
# ANY WARRANTY; without even the implied warranty of MERCHANTABILITY or
# FITNESS FOR A PARTICULAR PURPOSE.  See the GNU General Public License for
# more details.

config EQOS
	tristate "NVIDIA Tegra Ethernet QOS driver"
	default n

	---help---
	  If you have a network (Ethernet) card belonging to this class, say Y
	  and read the Ethernet-HOWTO, available from
	  <http://www.tldp.org/docs.html#howto>.

	  Note that the answer to this question doesn't directly affect the
	  kernel: saying N will just cause the configurator to skip all
	  the questions about NVIDIA cards. If you say Y, you will be asked for
	  your specific card in the following questions.

config DISABLE_VLAN_FWD_TO_REAL_IF
	bool "Disable VLAN RX Packet forwarding to Real ethernet Interface"
	depends on EQOS
	default n

	---help---
		This disables support to forward VLAN tagged packets to the
		Real interface. If enabled, VLAN tagged packets are only forwarded
		to the Virtual interface.

		If unsure, say n.

config DEBUGFS_OBJ
	bool "Enable DEBUGFS_OBJ"
	depends on EQOS
	default n
```

## drivers/net/ethernet/synopsys/dwc_qos/Kconfig
```kconfig
#
# Synopsys network device configuration
#

config SYNOPSYS_DWC_QOS_4_21
    tristate "Sypnopsys DWC Ethernet QOS v4.20a support"
    select PHYLIB
    select CRC32
    select MII
    depends on OF && HAS_DMA
    ---help---
      This driver supports the DWC Ethernet QoS version 4.20a from Synopsys

config DWC_QOS_DEBUGFS
    bool "Enable QoS Debug file system for SNPS QOS v4.20a driver"
    default n
    depends on SYNOPSYS_DWC_QOS_4_21
    ---help---
      This enables debug fs support for Synopsys QoS driver v4.20a

config DWC_QOS_PGTEST
    bool "Enable QoS PG Test for SNPS QOS v4.20a driver"
    default n
    depends on SYNOPSYS_DWC_QOS_4_21
    ---help---
      This enables PC test support for Synopsys QoS driver v4.20a

config DWC_QOS_PTPSUPPORT
    bool "Enable QoS PTP support for SNPS QOS v4.20a driver"
    default n
    depends on SYNOPSYS_DWC_QOS_4_21
    select PTP_1588_CLOCK 
    ---help---
      This enables PTP support for Synopsys QoS driver v4.20a
```

## drivers/net/wireless/bcm4329/Kconfig
```kconfig
config BCM4329
	tristate "Broadcom 4329 wireless cards support"
	depends on MMC
	select WIRELESS_EXT
	select WEXT_PRIV
	---help---
	  This module adds support for wireless adapters based on
	  Broadcom 4329 chipset.

	  This driver uses the kernel's wireless extensions subsystem.

	  If you choose to build a module, it'll be called dhd. Say M if
	  unsure.

config BCM4329_FW_PATH
	depends on BCM4329
	string "Firmware path"
	default "/system/etc/firmware/fw_bcm4329.bin"
	---help---
	  Path to the firmware file.

config BCM4329_NVRAM_PATH
	depends on BCM4329
	string "NVRAM path"
	default "/proc/calibration"
	---help---
	  Path to the calibration file.

config BCM4329_WIFI_CONTROL_FUNC
	bool "Use bcm4329_wlan device"
	depends on BCM4329
	default n
	---help---
	   Use this option to get various parameters from architecture specific
	   bcm4329_wlan platform device. Say n if unsure.

if BCM4329_WIFI_CONTROL_FUNC

config BCM4329_DHD_USE_STATIC_BUF
	bool "Use static buffer"
	depends on BCM4329
	default n
	---help---
	   Use static buffer from kernel heap allocated during bcm4329_wlan
	   platform device creation.

config BCM4329_HW_OOB
	bool "Use out of band interrupt"
	depends on BCM4329
	default n
	---help---
	   Use out of band interrupt for wake on wireless.

config BCM4329_OOB_INTR_ONLY
	bool "Use out of band interrupt only"
	depends on BCM4329
	default n
	---help---
	   Use out of band interrupt for all interrupts(including SDIO interrupts).

config BCM4329_GET_CUSTOM_MAC_ENABLE
	bool "Use custom mac address"
	depends on BCM4329
	default n
	---help---
	   Use mac address provided by bcm4329_wlan platform device.
endif
```

## drivers/net/wireless/bcmdhd-tesla/Kconfig
```kconfig
config BCMDHD_TESLA
	tristate "Broadcom FullMAC wireless cards support"
	---help---
	  This module adds support for wireless adapters based on
	  Broadcom FullMAC chipset.

	  If you choose to build a module, it'll be called dhd. Say M if
	  unsure.

config BCMDHD_SDIO_TESLA
	bool "SDIO bus interface support"
	depends on BCMDHD_TESLA && MMC && !BCMDHD_SDIO

config BCMDHD_PCIE_TESLA
	bool "PCIe bus interface support"
	depends on BCMDHD_TESLA && PCI && !BCMDHD_PCIE

config BCM4359_TESLA
	bool "BCM4359 support"
	depends on BCMDHD_TESLA && !BCM4359
	default y

config BCMDHD_FW_PATH_TESLA
	depends on BCMDHD_TESLA && !BCMDHD_FW_PATH
	string "Firmware path"
	default "/system/vendor/firmware/fw_bcmdhd.bin"
	---help---
	  Path to the firmware file.

config BCMDHD_NVRAM_PATH_TESLA
	depends on BCMDHD_TESLA && !BCMDHD_NVRAM_PATH
	string "NVRAM path"
	default "/system/vendor/etc/wifi/bcmdhd.cal"
	---help---
	  Path to the calibration file.

config BCMDHD_CLM_PATH_TESLA
	depends on BCMDHD_TESLA && !BCMDHD_CLM_PATH
	string "CLM path"
	default "/system/vendor/etc/wifi/bcmdhd.clm_blob"
	---help---
	  Path to the clm blob file.

config DHD_USE_STATIC_BUF_TESLA
	bool "Enable memory preallocation"
	depends on BCMDHD_TESLA && !DHD_USE_STATIC_BUF
	default n
	---help---
	  Use memory preallocated in platform

config DHD_USE_SCHED_SCAN_TESLA
	bool "Use CFG80211 sched scan"
	depends on BCMDHD_TESLA && CFG80211 && !DHD_USE_SCHED_SCAN
	default n
	---help---
	  Use CFG80211 sched scan

config DHD_SET_RANDOM_MAC_VAL_TESLA
	hex "Vendor OUI"
	depends on BCMDHD_TESLA && !DHD_SET_RANDOM_MAC_VAL
	default 0x001A11
	---help---
	Set vendor OUI for SoftAP

config BCMDHD_VENDOR_EXT_TESLA
	bool "Enable BCMDHD_TESLA vendor extension"
	depends on BCMDHD_TESLA && ANDROID && !BCMDHD_VENDOR_EXT
	default n
	---help---
	Set Vendor Extension support.
```

## drivers/net/wireless/bcmdhd/Kconfig
```kconfig
config BCMDHD
	tristate "Broadcom FullMAC wireless cards support"
	---help---
	  This module adds support for wireless adapters based on
	  Broadcom FullMAC chipset.

	  If you choose to build a module, it'll be called dhd. Say M if
	  unsure.

config BCMDHD_SDIO
	bool "SDIO bus interface support"
	depends on BCMDHD && MMC

config BCMDHD_PCIE
	bool "PCIe bus interface support"
	depends on BCMDHD && PCI && !BCMDHD_SDIO

config BCMDHD_FW_PATH
	depends on BCMDHD
	string "Firmware path"
	default "/system/vendor/firmware/fw_bcmdhd.bin"
	---help---
	  Path to the firmware file.

config BCMDHD_NVRAM_PATH
	depends on BCMDHD
	string "NVRAM path"
	default "/system/etc/wifi/bcmdhd.cal"
	---help---
	  Path to the calibration file.

config DHD_USE_STATIC_BUF
	bool "Enable memory preallocation"
	depends on BCMDHD
	default n
	---help---
	  Use memory preallocated in platform

config DHD_USE_SCHED_SCAN
	bool "Use CFG80211 sched scan"
	depends on BCMDHD && CFG80211
	default n
	---help---
	  Use CFG80211 sched scan
```

## drivers/padctrl/Kconfig
```kconfig
menuconfig PADCTRL
	bool "Pad controller support"
	help
	  Say Y here to enable pad controller support

	  This framework provides a generic interface to PAD
	  devices.

if PADCTRL

config PADCTRL_TEGRA210_PMC
	bool "Tegra210 PMC PADCTRL driver"
	depends on ARCH_TEGRA
	help
	  This option enables Tegra 210 PMC padctrl driver

	  Tegra210 PMC padctrl driver which controls the pad
	  to supply either 1.8V or 3.3V.

trysource "../t18x/drivers/padctrl/Kconfig.t18x"
trysource "drivers/padctrl/Kconfig.t18x"
endif
```

## drivers/padctrl/Kconfig.t18x
```kconfig
config PADCTRL_TEGRA186_PMC
	bool "Tegra186 PMC PADCTRL driver"
	depends on TEGRA186_PMC
	help
	  This option enables Tegra 186 PMC padctrl driver

	  Tegra186 PMC padctrl driver which controls the pad
	  to supply either 1.2V or 1.8V or 3.3V.
```

## drivers/pinctrl/Kconfig.t18x
```kconfig
config PINCTRL_TEGRA186
	bool "NVIDIA Tegra186 Pinmux support"
	select PINCTRL_TEGRA
	help
	Support for the NVIDIA Tegra186 PINCTRL controller driver.

config PINCTRL_TEGRA186_PADCTL
	bool "NVIDIA Tegra186 XUSB PADCTL Driver"
	depends on ARCH_TEGRA_18x_SOC
	depends on MAILBOX
	select GENERIC_PHY
	select PINCONF
	select PINMUX

config PINCTRL_TEGRA186_DPAUX
	bool "NVIDIA Tegra186 DP AUX Pinctrl Driver"
        depends on ARCH_TEGRA_18x_SOC
        select PINCONF
        select PINMUX
```

## drivers/pinctrl/intel/Kconfig
```kconfig
#
# Intel pin control drivers
#

config PINCTRL_BAYTRAIL
	bool "Intel Baytrail GPIO pin control"
	depends on GPIOLIB && ACPI
	select GPIOLIB_IRQCHIP
	help
	  driver for memory mapped GPIO functionality on Intel Baytrail
	  platforms. Supports 3 banks with 102, 28 and 44 gpios.
	  Most pins are usually muxed to some other functionality by firmware,
	  so only a small amount is available for gpio use.

	  Requires ACPI device enumeration code to set up a platform device.

config PINCTRL_CHERRYVIEW
	tristate "Intel Cherryview/Braswell pinctrl and GPIO driver"
	depends on ACPI
	select PINMUX
	select PINCONF
	select GENERIC_PINCONF
	select GPIOLIB
	select GPIOLIB_IRQCHIP
	help
	  Cherryview/Braswell pinctrl driver provides an interface that
	  allows configuring of SoC pins and using them as GPIOs.

config PINCTRL_INTEL
	tristate
	select PINMUX
	select PINCONF
	select GENERIC_PINCONF
	select GPIOLIB
	select GPIOLIB_IRQCHIP

config PINCTRL_BROXTON
	tristate "Intel Broxton pinctrl and GPIO driver"
	select PINCTRL_INTEL
	help
	  Broxton pinctrl driver provides an interface that allows
	  configuring of SoC pins and using them as GPIOs.

config PINCTRL_APL_DEVICE
	bool "Intel Apollo Lake GPIO pin control Platform Device Emulation"
	depends on PINCTRL_BROXTON
	help
	  This driver is to set up platform device in the absent of ACPI
	  enumeration.

	  Say yes for non-ACPI platform. This will enable the platform devices
	  to be created and bind with the Apollo Lake GPIO pin control platform
	  driver.

config PINCTRL_SUNRISEPOINT
	tristate "Intel Sunrisepoint pinctrl and GPIO driver"
	depends on ACPI
	select PINCTRL_INTEL
	help
	  Sunrisepoint is the PCH of Intel Skylake. This pinctrl driver
	  provides an interface that allows configuring of PCH pins and
	  using them as GPIOs.
```

## drivers/platform/Kconfig
```kconfig
if X86
source "drivers/platform/x86/Kconfig"
endif
if GOLDFISH
source "drivers/platform/goldfish/Kconfig"
endif

config PLATFORM_TEGRA
	bool "NVIDIA Tegra platform"
	default y if ARCH_TEGRA
	help
	  Enable support for misc Tegra drivers.

if PLATFORM_TEGRA
source "drivers/platform/tegra/Kconfig"
source "drivers/platform/tegra/nvadsp/Kconfig"
endif

source "drivers/platform/chrome/Kconfig"
```
