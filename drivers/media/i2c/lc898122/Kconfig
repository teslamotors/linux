## drivers/misc/tesla/oem/Kconfig
```kconfig
# SPDX-License-Identifier: GPL-2.0-only

config TESLA_AMD_OEM
	tristate "AMD OEM fuse state"
	depends on CPU_SUP_AMD
	help
	  Support for OEM3 ACPI table containing AMD OEM-specific fuse
	  state.
```

## drivers/misc/tesla/panic-biosram/Kconfig
```kconfig
# SPDX-License-Identifier: GPL-2.0-only

config TESLA_PANIC_BIOSRAM
	tristate "Save panic reason to BIOSRAM region"
	depends on X86 && DMI
	help
	  Say Y here to save kernel panic reason messages to the BIOSRAM
	  region if the platform supports it.  The so-called BIOSRAM is
	  persistent across warm resets and can be retrieved by bootloader
	  firmware.

	  If unsure, say N.
```

## drivers/misc/tesla/psb/Kconfig
```kconfig
# SPDX-License-Identifier: GPL-2.0-only

config TESLA_AMD_PSB
	tristate "AMD Platform Secure Boot state"
	depends on CPU_SUP_AMD
	help
	  Support for OEM2 ACPI table containing AMD Platform Secure Boot
	  state.
```

## drivers/misc/trip/Kconfig
```kconfig
config TESLA_TRIP
	tristate "Tesla Trip driver"
	select FRAME_VECTOR
	select DMA_SHARED_BUFFER
	select PM_DEVFREQ
	select DEVFREQ_GOV_PERFORMANCE
	select DEVFREQ_THERMAL
	help
	  This enables the driver for the Trip IP in the Turbo SoC,
	  used for neural network processing.

config TESLA_TRIP_FW
	tristate "Tesla Trip driver firmware loading support"
	depends on TESLA_TRIP
	select FW_LOADER
	select CRC32
	default y
	help
	  This enables the driver for the Trip IP to load firmware from
	  kernel space driver as part of initialization.

config TESLA_TRIP_PROD_MODE_ALWAYS
	tristate "Tesla Trip driver uses prod_mode always"
	depends on TESLA_TRIP
	depends on TESLA_TRIP_FW
	default y
	help
	  This forces the driver to always run in production mode where
	  writes to SRAM from userspace are disabled.

config TESLA_TRIP_MEM
	tristate "Tesla Trip memory driver"
	select DMA_SHARED_BUFFER
	help
	  This enables the driver for the Trip memory driver, providing
	  buffer management for buffers used in the vision pipeline.
```
