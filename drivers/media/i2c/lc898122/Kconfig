## drivers/media/i2c/lc898122/Kconfig
```kconfig
config VIDEO_LC898122
	tristate "lc898122 voice coil support"
	depends on I2C && VIDEO_V4L2
	---help---
	This is a driver for the LC898122 camera lens voice coil.
```

## drivers/media/pci/intel-ipu4/Kconfig
```kconfig
config VIDEO_INTEL_IPU4
	tristate "Intel intel-ipu4 driver"
	select IOMMU_API
	select IOMMU_IOVA
	select X86_DEV_DMA_OPS if X86
	select VIDEOBUF2_DMA_CONTIG
	select PHYS_ADDR_T_64BIT
	select COMMON_CLK
	---help---
	Say Y here!

choice
       prompt "intel-ipu4 hardware stepping"
       depends on VIDEO_INTEL_IPU4
       default VIDEO_INTEL_IPU4_A0

config VIDEO_INTEL_IPU4_A0
       bool "Compile for ipu4 A0"

config VIDEO_INTEL_IPU4_B0
       bool "Compile for ipu4 B0"
endchoice

choice
       prompt "intel-ipu4 hardware type"
       depends on VIDEO_INTEL_IPU4
       default VIDEO_INTEL_IPU4_SOC

config VIDEO_INTEL_IPU4_SOC
       bool "Compile for SOC"

config VIDEO_INTEL_IPU4_FPGA
       bool "Compile for FPGA"
endchoice

config VIDEO_INTEL_IPU4_DEBUG
	tristate "User space interface for firmware testing"
	depends on VIDEO_INTEL_IPU4

config VIDEO_INTEL_IPU4_ISYS
	bool "Input system"
	depends on VIDEO_INTEL_IPU4
	depends on VIDEO_V4L2
	---help---
	FPGA based input system. Select if your FPGA based environment
	contains an input system.

config VIDEO_INTEL_IPU4_PSYS
	bool "Processing system"
	depends on VIDEO_INTEL_IPU4
	---help---
	FPGA based processing system. Select if your FPGA based
	environment contains a processing system.
```

## drivers/media/pci/intel/Kconfig
```kconfig
config VIDEO_INTEL_IPU
	tristate "Intel IPU driver"
	depends on ACPI && X86_64
	select IOMMU_API
	select IOMMU_IOVA
	select X86_DEV_DMA_OPS if X86
	select VIDEOBUF2_DMA_CONTIG
	select PHYS_ADDR_T_64BIT
	select COMMON_CLK
	---help---
	Say Y here!

choice
	prompt "intel ipu generation type"
	depends on VIDEO_INTEL_IPU
	default VIDEO_INTEL_IPU4

config VIDEO_INTEL_IPU4
	bool "Compile for IPU4 driver"
	---help---
	Say Y here!

config VIDEO_INTEL_IPU4P
	bool "Compile for IPU4P driver"
	---help---
	Say Y here!

endchoice

choice
	prompt "intel ipu hardware platform type"
	depends on VIDEO_INTEL_IPU
	default VIDEO_INTEL_IPU_SOC

config VIDEO_INTEL_IPU_SOC
	bool "Compile for SOC"
	---help---
	Select for SOC platform

endchoice

config VIDEO_INTEL_IPU_FW_LIB
	bool "Compile firmware library"
	---help---
	If selected, the firmware hostlib css would be compiled

config VIDEO_INTEL_IPU_WERROR
	bool "Force GCC to throw an error instead of a warning when compiling"
	depends on VIDEO_INTEL_IPU
	depends on EXPERT
	depends on !COMPILE_TEST
	default n
	help
	  Add -Werror to the build flags for (and only for) intel ipu module.
	  Do not enable this unless you are writing code for the ipu module.

	  Recommended for driver developers only.

	  If in doubt, say "N".
config VIDEO_INTEL_ICI
	depends on VIDEO_INTEL_IPU
	bool "Compile for ICI driver"
	---help---
	If selected ICI driver will be compiled

config VIDEO_INTEL_UOS
	bool "Compile driver per UOS"
	---help---
	If selected UOS driver components will be compiled

config VIDEO_INTEL_IPU_ACRN
	bool "Compile for virtio mediation"

choice
    prompt "Virtio driver type"
    depends on VIDEO_INTEL_IPU_ACRN
    default VIDEO_INTEL_IPU_VIRTIO_BE

config VIDEO_INTEL_IPU_VIRTIO_BE
    bool "Configure IPU4 as virtio backend"
    depends on VBS
	---help---
    Configuring IPU4 driver as virtio backend

config VIDEO_INTEL_IPU_VIRTIO_FE
    bool "Configure IPU4 as virtio frontend"
    ---help---
    Configuring IPU4 driver as virtio frontend

endchoice
```

## drivers/media/platform/intel-ipu4/Kconfig
```kconfig
config INTEL_IPU4_BXT_RVP_PDATA
	bool "Enable built in platform data for Broxton RVP"
	---help---
	Pre-ACPI system platform data is compiled inside kernel

config INTEL_IPU4_BXT_P_PDATA
	bool "Enable built in platform data for Broxton-P"
	---help---
	Pre-ACPI system platform data is compiled inside kernel
config INTEL_IPU4_BXT_GP_PDATA
	bool "Enable built in platform data for Gordon Peak"
	---help---
	Pre-ACPI system platform data is compiled inside kernel

config INTEL_IPU4_BXT_GT_PDATA
	bool "Enable built in platform data for Broxton-GT"
	---help---
	Pre-ACPI system platform data is compiled inside kernel

config INTEL_IPU4_IMX185
	bool "Compile platform data for IMX185"
	depends on INTEL_IPU4_BXT_P_PDATA

config INTEL_IPU4_OV13860
	bool "Compile platform data for OV13860"
	---help---
	Omnivision 13MP camera sensor

config INTEL_IPU4_OV10635
	bool "Compile platform data for OV10635"
	---help---
	Omnivision 1MP camera sensor

config INTEL_IPU4_OV10640
	bool "Compile platform data for OV10640"
	---help---
	  Omnivision 1.4MP camera sensor

config INTEL_IPU4_ADV7481
	bool "Compile platform data for ADV7481"
	---help---
	HDMI2MIPI convertor device ADV7481

config INTEL_IPU4_ADV7481_EVAL
	bool "Compile platform data for ADV7481 evaluation board"
	---help---
	HDMI2MIPI convertor device ADV7481 eval board
```

## drivers/media/platform/intel/Kconfig
```kconfig
config INTEL_IPU4_BXT_P_PDATA
	bool "Enable built in platform data for Broxton-P"
	depends on VIDEO_INTEL_IPU && VIDEO_INTEL_IPU4
	---help---
	Pre-ACPI system platform data is compiled inside kernel

config INTEL_IPU4_BXT_GP_PDATA
	depends on VIDEO_INTEL_IPU && VIDEO_INTEL_IPU4
	bool "Enable built in platform data for Gordon Peak"
	---help---
	Pre-ACPI system platform data is compiled inside kernel

config INTEL_IPU4_BXT_GP_PDATA
	bool "Enable built in platform data for Broxton GP MRB"
	---help---
	Pre-ACPI system platform data is compiled inside kernel

config INTEL_IPU4_ICI_BXT_P_PDATA
	depends on VIDEO_INTEL_IPU && VIDEO_INTEL_ICI
	bool "Enable built in platform data for Broxton-P ICI driver"
	---help---
	Pre-ACPI system platform data is compiled inside kernel

config INTEL_IPU4P_CNL_RVP_PDATA
	depends on VIDEO_INTEL_IPU && VIDEO_INTEL_IPU4P
	bool "Enable built in platform data for ipu4p"
	depends on VIDEO_INTEL_IPU4P
	---help---
	Pre-ACPI system platform data is compiled inside kernel

config INTEL_IPU4_OV13858
	bool "Compile platform data for OV13858"
	depends on INTEL_IPU4_BXT_P_PDATA
	---help---
	This module is used to enable
	Omnivision 13MP camera sensor
	which is similar to OV13860
	OS would be Yocto

config INTEL_IPU4_OV2740
	bool "Compile platform data for OV2740"
	depends on INTEL_IPU4_BXT_P_PDATA

config INTEL_IPU4_IMX185
	bool "Compile platform data for IMX185"
	depends on INTEL_IPU4_BXT_P_PDATA

config INTEL_IPU4_IMX185_LI
	bool "Compile platform data for IMX185 by Leopard Imaging"
	depends on INTEL_IPU4_BXT_P_PDATA
	---help---
	Sony IMX185 camera sensor module produced by Leopard Imaging

config INTEL_IPU4_AR023Z
	bool "Compile platform data for AR023Z"
	---help---
	Onsemi 2MP AR023Z camera sensor

config INTEL_IPU4_IMX477
	bool "Compile platform data for IMX477 camera sensor"
	depends on INTEL_IPU4_BXT_P_PDATA
	---help---
	Sony IMX477 sensor is enabled for DUAL Camera input.

config INTEL_IPU4_OV13860
	bool "Compile platform data for OV13860"
	---help---
	Omnivision 13MP camera sensor

config INTEL_IPU4_OV9281
	bool "Compile platform data for OV9281"
	---help---
	Omnivision 1MP camera sensor

config INTEL_IPU4_OV10635
	bool "Compile platform data for OV10635"
	---help---
	Omnivision 1MP camera sensor

config INTEL_IPU4_AR0231AT
        bool "Compile platform data for AR0231AT"
        ---help---
        AR0231 camera sensor for MAXIM 9286

config INTEL_IPU4_MAGNA
	bool "Compile platform data for MAGNA"
        depends on INTEL_IPU4_BXT_P_PDATA
	---help---
	MAGNA Camera Sensor

config INTEL_IPU4_IMX274
	bool "Compile platform data for IMX274 camera sensor"
	depends on INTEL_IPU4_BXT_P_PDATA
	---help---
	Sony 14MP camera sensor is enabled for HDR function.

config INTEL_IPU4_OV10640
	bool "Compile platform data for OV10640"
	---help---
	  Omnivision 1.4MP camera sensor

config INTEL_IPU4_ADV7481
	bool "Compile platform data for ADV7481"
	---help---
	HDMI2MIPI convertor device ADV7481

config INTEL_IPU4_ADV7481_I2C_ID
	int
	default 0
	---help---
	I2C bus number of ADV7481 Mondello

config INTEL_IPU4_ADV7481_EVAL
	bool "Compile platform data for ADV7481 evaluation board"
	---help---
	HDMI2MIPI convertor device ADV7481 eval board

config INTEL_IPU4_IMX290
	bool "Compile platform data for IMX290"
	depends on INTEL_IPU4_BXT_P_PDATA
	---help---
	Sony 8MB camera sensor is enabled for HDR function
```

## drivers/media/platform/mali-c71/Kconfig
```kconfig
config VIDEO_MALI_C71
	tristate "ARM Mali C71 ISP support"
	depends on VIDEO_V4L2
	depends on HAS_DMA && OF
	select VIDEOBUF2_DMA_CONTIG
	select V4L2_MEM2MEM_DEV
	---help---
	  Driver for an ARM Mali C71 (aka 'Morgan') image signal processor.
```

## drivers/media/platform/soc_camera/tegra_camera/Kconfig
```kconfig
config VIDEO_TEGRA
	tristate "Tegra soc_camera host driver"
	depends on VIDEO_DEV && PLATFORM_TEGRA && SOC_CAMERA && HAS_DMA && HAVE_CLK
	select VIDEOBUF2_DMA_CONTIG
	---help---
	  This is a v4l2 driver for the Tegra camera interface

config VIDEO_TEGRA_VI2
	bool "Tegra soc_camera host VI2 driver"
	depends on VIDEO_TEGRA
	default y
	---help---
	This is the v4l2 driver for the VI2-style Tegra camera interface

config VIDEO_TEGRA_VI_BYPASS
	bool "Tegra soc_camera host SCF bypass driver"
	depends on VIDEO_TEGRA
	---help---
	This is the v4l2 driver for the SCF-style Tegra camera interface
```

## drivers/media/platform/tegra/mipical/Kconfig
```kconfig
config TEGRA_MIPI_CAL
	depends on TEGRA_DC || TEGRA_CAMERA_PLATFORM
	bool "Enable MIPI Cal driver"
	default y
	select REGMAP
	select REGMAP_MMIO
	help
	  Provides an interfaces to do MIPI calibration for both DSI and CSI blocks.
	  You will always want this enabled if you are using either Camera or Display.
	  Disabling this can cause issues for drivers that depend on it being present.
	  Leaving this on is harmless even if no drivers that need it are enabled.
```

## drivers/media/platform/trav/Kconfig
```kconfig
config VIDEO_TRAV_MIPI_CSIS
	tristate "Trav SoC MIPI-CSI2 receiver (MIPI-CSIS) driver"
	depends on VIDEO_DEV && VIDEO_V4L2 && VIDEO_V4L2_SUBDEV_API
	depends on ARCH_TRAV || COMPILE_TEST
	depends on HAS_DMA
	select VIDEOBUF2_DMA_CONTIG
	select V4L2_FWNODE
	default n
	help
	  This is a V4L2 driver for Trav SoC MIPI-CSI2
	  receiver (MIPI-CSIS) devices

	  To compile this driver as a module, choose M here: the
	  module will be called trav-csis.

config VIDEO_TRAV_DPRX_CAMERA
	tristate "Trav SoC DPRX receiver driver"
	depends on VIDEO_DEV && VIDEO_V4L2 && VIDEO_V4L2_SUBDEV_API
	depends on ARCH_TRAV || COMPILE_TEST
	depends on HAS_DMA
	select VIDEOBUF2_DMA_CONTIG
	select V4L2_FWNODE
	default n
	help
	  This is a V4L2 driver for Trav SoC DPRX
	  receiver DPRX devices

	  To compile this driver as a module, choose M here: the
	  module will be called trav-dprx.
```

## drivers/misc/intel-ish-client/Kconfig
```kconfig
menu "Intel ISH Client support"
	depends on INTEL_ISH_HID

config INTEL_ISH_CLIENT
	tristate "Intel Integrated Sensor Hub Client"
	help
	  The Integrated Sensor Hub (ISH) supports many clients, Intel ISH client
	  driver supports following clients:
	  SMHI client: calibration & perfermance & menufacture tool interface
	  trace configure client: ISHFW trace parameter configure interface
	  trace tool client: ISHFW trace log output interface
	  loader client: loading customized ISHFW interface

	  Say Y here if you want to support Intel ISH clients. If unsure, say N.
endmenu
```

## drivers/misc/inter-tegra/Kconfig
```kconfig
config INTER_TEGRA_SPI
	tristate "interconnected between Tegras spi driver"
	depends on SPI
	default n
	help
	  This driver provides support for spi communication between Tegras.
	  providing control enable send/receive via sysfs

	  This driver can also be built as a module. If so, the module
	  will be called inter_tegra_spi.
```

## drivers/misc/mei/dal/Kconfig
```kconfig
config INTEL_MEI_DAL
	tristate "Dynamic Application Loader for ME"
	depends on INTEL_MEI
	help
	  Dynamic Application Loader enables downloading java applets
	  to DAL FW and run it in a secure environment.
	  The DAL module exposes both user space api and kernel space api.

config INTEL_MEI_DAL_TEST
	tristate "Test Module for Dynamic Application Loader for ME"
	depends on INTEL_MEI_DAL
	help
	  Testing Module for Dynamic Application Loader, to test the
	  kernel space api from a user space client. The test module
	  calls the kernel space api functions of DAL module.
```

## drivers/misc/mei/spd/Kconfig
```kconfig
#
# Storage proxy device configuration
#
config INTEL_MEI_SPD
	tristate "Intel MEI Host Storage Proxy Driver"
	depends on INTEL_MEI && BLOCK
	help
	  A driver for the host storage proxy ME client
	  The driver enables ME FW to store data on a storage devices
	  that are accessible only from the host.

	  To compile this driver as a module, choose M here.
```

## drivers/misc/mpu3050/Kconfig
```kconfig
menu "Motion Sensors Support"

config SENSORS_MPU3050
    tristate "MPU3050 Gyroscope Driver"
    depends on I2C
    help
      If you say yes here you get support for the MPU3050 Gyroscope driver
      This driver can also be built as a module.  If so, the module
      will be called mpu3050.

config SENSORS_MPU3050_DEBUG
    bool "MPU3050 debug"
    depends on SENSORS_MPU3050
    help
      If you say yes here you get extra debug messages from the MPU3050
      and other slave sensors.

choice
    prompt "Accelerometer Type"
    depends on SENSORS_MPU3050
    default SENSORS_KXTF9_MPU

config SENSORS_ACCELEROMETER_NONE
    bool "NONE"
    help
      This disables accelerometer support for the MPU3050

config SENSORS_KXTF9_MPU
    bool "Kionix KXTF9"
    help
      This enables support for the Kionix KXFT9 accelerometer

endchoice

choice
    prompt "Compass Type"
    depends on SENSORS_MPU3050
    default SENSORS_AK8975_MPU

config SENSORS_COMPASS_NONE
    bool "NONE"
    help
      This disables compass support for the MPU3050

config SENSORS_AK8975_MPU
    bool "AKM ak8975"
    help
      This enables support for the AKM ak8975 compass

endchoice

endmenu
```

## drivers/misc/nvs-dfsh/Kconfig
```kconfig
config NVS_DFSH
	tristate "Line discipline for NVS DFSH"
	select NVS_IIO
	select IIO_BUFFER
	select IIO_TRIGGERED_BUFFER
	depends on TTY
	default n
	help
	  Say Y here for TTY line discipline for NVS
	  DFSH stream.

	  This driver cannot be built as a module.
	  If unsure, say N.
```

## drivers/misc/tegra-cec/Kconfig
```kconfig
config TEGRA_CEC_SUPPORT
	bool "Tegra CEC support"
	---help---
	 Enables HDMI-CEC driver for Tegra SoC.
```

## drivers/misc/tegra-profiler/Kconfig
```kconfig
config TEGRA_PROFILER
	bool "Enable Tegra profiler"
	depends on ARCH_TEGRA || PLATFORM_TEGRA
	help
	  This option enables Tegra profiler
	  The main responsibility of this module is sampling
	  This module creates /dev/quadd device which is essential for
	  Tegra profiler work
```

## drivers/misc/tegra186-ahc/Kconfig.t18x
```kconfig
config TEGRA186_AHC
	tristate "Tegra186 AHC driver"
	depends on ARCH_TEGRA_18x_SOC
```

## drivers/misc/tesla/Kconfig
```kconfig
# SPDX-License-Identifier: GPL-2.0-only
#
# Tesla misc devices/drivers
#

menu "Tesla misc drivers/devices"

source "drivers/misc/tesla/hsti/Kconfig"
source "drivers/misc/tesla/hsti1/Kconfig"
source "drivers/misc/tesla/oem/Kconfig"
source "drivers/misc/tesla/psb/Kconfig"
source "drivers/misc/tesla/panic-biosram/Kconfig"

endmenu
```

## drivers/misc/tesla/hsti/Kconfig
```kconfig
# SPDX-License-Identifier: GPL-2.0-only

config TESLA_AMD_HSTI
	tristate "AMD Hardware Security Test Interface state"
	depends on CPU_SUP_AMD
	help
	  Support for OEM1 ACPI table containing AMD Hardware Security
	  Test Interface state.
```

## drivers/misc/tesla/hsti1/Kconfig
```kconfig
# SPDX-License-Identifier: GPL-2.0-only

config TESLA_AMD_HSTI1
	tristate "AMD Hardware Security Test Interface 1 state"
	depends on CPU_SUP_AMD
	help
	  Support for OEM4 ACPI table containing additional
	  information from AMD Hardware Security Test Interface.
```
