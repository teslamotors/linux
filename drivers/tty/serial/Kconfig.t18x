## security/oemkey/Kconfig
```kconfig
config OEM_KEY
	bool "OEM Key Provisioning and Verification"
	default n
	select ABL_UTILS
        select KEYS
	select ASYMMETRIC_KEY_TYPE
	select ASYMMETRIC_PUBLIC_KEY_SUBTYPE
	select PUBLIC_KEY_ALGO_RSA
	select MPILIB
	help
		A module which reads the OEM public key passed to the kernel
		by the bootloader. Allows applications to verify digest
		signatures against the OEM public key.

                If in doubt, select "N".

config OEM_KEY_HARDCODE
	bool "Hardcode the OEM public RSA key (DANGEROUS!)"
        default n
	depends on OEM_KEY
	help
                Sets the RSA public keys to fixed values instead
                of using values passed via the kernel command line.

                WARNING: This is only for testing purposes and should not be used
                for production as any data encrypted with keystore will be vulnerable
                to attack.

                If in doubt, select "N".

	default n

config MANIFEST
	bool "Manifest Provisioning and Verification"
	default n
	select ABL_UTILS
        select KEYS
	select ASYMMETRIC_KEY_TYPE
	select ASYMMETRIC_PUBLIC_KEY_SUBTYPE
	select PUBLIC_KEY_ALGO_RSA
        select CRYPTO_RSA
	select MPILIB
        select X509_CERTIFICATE_PARSER
	help
		A module which reads the manifest passed to the kernel
		by the bootloader. Allows applications to verify digest
		signatures against the key digest signatures provided
		by the manifest.

                If in doubt, select "N".

config MANIFEST_HARDCODE
	bool "Hardcode the manifest (DANGEROUS!)"
        default n
	depends on MANIFEST
	help
                Sets the manifest to fixed values instead
                of using values passed via the kernel command line.

                WARNING: This is only for testing purposes and should not be used
                for production as any data encrypted with keystore will be vulnerable
                to attack.

                If in doubt, select "N".

	default n
```

## security/sb/Kconfig
```kconfig
config SECURE_BOOT
	bool "Secure Boot Status"
	default n
        select PCI
	help
		Check the secure boot status when the module
		is initialised and store it in RAM.

		Kernel applications can check the secure boot
		status via the API.

	  	If in doubt, say "N".
```

## security/tlk_driver/Kconfig
```kconfig
config TRUSTED_LITTLE_KERNEL
	bool "Enable Open Trusted Execution driver for TLK"
	select TEGRA_USE_SECURE_KERNEL
	select FIQ
	select FIQ_GLUE
	help
	  This option adds kernel support for communication with the
	  Trusted Little Kernel (TLK) secure OS.
	  If you are unsure how to answer this question, answer N.

config OTE_TRUSTY
	bool "Enable Open Trusted Execution driver for OTE-Trusty"
	select TEGRA_USE_SECURE_KERNEL
	select FIQ
	select FIQ_GLUE
	depends on TRUSTY
	help
	  This option adds kernel support for communication with the
	  Trusty-OTE Secure OS, which is a variant of the Trusty
	  Secure OS, that is provided by Google.
	  If you are unsure how to answer this question, answer N.
```

## security/xpin/Kconfig
```kconfig
# SPDX-License-Identifier: GPL-2.0-only
config SECURITY_XPIN
	bool "XPin support"
	depends on SECURITY && DM_VERITY
	help
	  This selects XPin, which checks that all usermode pages mapped with
	  PROT_EXEC must be file-backed by a dm-verity protected volume.
	  See Documentation/admin-guide/LSM/XPin.rst for more information.

	  If you are unsure how to answer this question, answer N.

config SECURITY_XPIN_ENFORCE
	bool "XPin enforcement at boot"
	depends on SECURITY_XPIN
	help
	  If selected, XPin will enforce pinning at boot. If not
	  selected, it can be enabled at boot with the kernel parameter
	  "xpin.enforce=1", or after boot through the "xpin/enforce" entry
	  in securityfs.

	  If you are unsure how to answer this question, answer N.

config SECURITY_XPIN_LOGGING
	bool "XPin logging at boot"
	depends on SECURITY_XPIN
	help
	  If selected, XPin will log violations at boot. If not
	  selected, it can be enabled at boot with the kernel parameter
	  "xpin.logging=1", or after boot through the "xpin/logging" entry
	  in securityfs.

	  If you are unsure how to answer this question, answer N.

config SECURITY_XPIN_LOCKDOWN
	bool "XPin lockdown at boot"
	depends on SECURITY_XPIN
	help
	  If selected, XPin's lockdown mode will be enabled at boot. If not
	  selected, it can be enabled at runtime through the "xpin/lockdown"
	  entry in securityfs.

	  Lockdown mode is a mode intended for use in production devices,
	  as opposed to development/engineering. Enabling lockdown mode will
	  prevent XPin's policy to become less restrictive, such as disabling
	  enforcement (even by a process with `CAP_MAC_ADMIN`).

	  If you are unsure how to answer this question, answer N.
```
