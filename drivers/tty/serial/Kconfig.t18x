## drivers/tty/serial/Kconfig.t18x
```kconfig
config TEGRA_COMBINED_UART
	bool "Tegra combined UART"
	depends on ARCH_TEGRA_18x_SOC
	default n
	help
	  Tegra combined UART is a client-server model which allows a server
	  running on SPE to multiplex a single UART controller amongst multiple
	  UART clients.

	  This config enables the Linux client driver. Instead of
	  directly bit banging the UART controller, the client driver
	  communicates with the SPE server using mailbox registers. The SPE
	  server multiplexes the UART controller amongst the various clients.
	  This allows all the clients to send output and receive input through a
	  single UART controller.
```

## drivers/usb/mux/Kconfig
```kconfig
#
# USB port mux driver configuration
#

menu "USB Port MUX drivers"
config USB_PORTMUX
	select EXTCON
	def_bool n
	help
	  Generic USB dual role port mux support.

config INTEL_MUX_GPIO
	tristate "Intel dual role port mux controlled by GPIOs"
	depends on GPIOLIB
	depends on REGULATOR
	depends on X86 && ACPI
	select USB_PORTMUX
	help
	  Say Y here to enable support for Intel dual role port mux
	  controlled by GPIOs.

config INTEL_MUX_DRCFG
	tristate "Intel dual role port mux controlled by register"
	depends on X86
	select USB_PORTMUX
	help
	  Say Y here to enable support for Intel dual role port mux
	  controlled by the Dual Role Configuration Register.

endmenu
```

## drivers/vbs/Kconfig
```kconfig
#
# This Kconfig describes VBS for ACRN hypervisor
#
config VBS
	bool "Enable VBS framework for ACRN hypervisor"
	depends on ACRN
	default n
	---help---
	  This option is selected by any driver which needs to use
	  the Virtio Backend Service (VBS) framework on ACRN
	  hypervisor.

config VBS_DEBUG
	bool "ACRN VBS debugging"
	depends on VBS != n
	default n
	---help---
	  This is an option for use by developers; most people should
	  say N here.  This enables ACRN VBS debugging.

config VBS_RNG
	bool "ACRN VBS reference driver: virtio RNG"
	depends on VBS != n
	default n
	---help---
	  Say M or * here to enable a VBS-K reference driver for ACRN 
	  hypervisor, virtio RNG driver, to work with virtio-rng
	  frontend driver in guest.
	  The reference driver shows an example on how to use VBS-K
	  APIs.
```

## drivers/vhm/Kconfig
```kconfig
config ACRN_VHM
	bool "Intel ACRN Hypervisor Virtio and Hypervisor service Module (VHM)"
	depends on ACRN
	depends on DMA_CMA
	depends on PCI_MSI
	depends on HUGETLBFS
	depends on !VMAP_STACK
	default n
	---help---
		This is the Virtio and Hypervisor service Module (VHM) for
		Intel ACRN hypervisor.

		It is required for Service OS.
		User OS doesn't need to have this config.

		Say Y for SOS and say N for UOS.

		If unsure, say N.
```

## drivers/video/Kconfig
```kconfig
#
# Video configuration
#

menu "Graphics support"
	depends on HAS_IOMEM

config HAVE_FB_ATMEL
	bool

config SH_MIPI_DSI
	tristate
	depends on (SUPERH || ARCH_SHMOBILE) && HAVE_CLK

config SH_LCD_MIPI_DSI
	bool

source "drivers/char/agp/Kconfig"

source "drivers/gpu/vga/Kconfig"

source "drivers/gpu/host1x/Kconfig"
source "drivers/gpu/ipu-v3/Kconfig"

menu "Direct Rendering Manager"
source "drivers/gpu/drm/Kconfig"
endmenu

menu "Frame buffer Devices"
source "drivers/video/fbdev/Kconfig"
endmenu

source "drivers/video/backlight/Kconfig"
source "drivers/video/adf/Kconfig"

source "drivers/video/tegra/Kconfig"

config VGASTATE
       tristate
       default n

config VIDEOMODE_HELPERS
	bool

config HDMI
	bool

if VT
	source "drivers/video/console/Kconfig"
endif

if FB || SGI_NEWPORT_CONSOLE
	source "drivers/video/logo/Kconfig"

endif


config DS90UH925Q_SER
	bool "DS90UH925Q FPDLink Serializer"
	depends on I2C
	help
	  This is a driver for FPDLink Serializer DS90UH925Q.

config DS90UB947
	bool "DS90UB947-Q1 1080p OpenLDS to FPD-Link III Serializer driver"
	default n
	help
		Enable support for TI DS90UB947-Q1 LVDS-to-FPD-Link Serializer driver.

endmenu
```

## drivers/video/tegra/Kconfig
```kconfig
comment "NVIDIA Tegra Display Driver options"

trysource "../nvhost/drivers/video/tegra/Kconfig"
trysource "../nvhost/drivers/video/tegra/Kconfig.nvhost"
trysource "drivers/video/tegra/Kconfig.nvhost"

trysource "../nvmap/drivers/video/tegra/nvmap/Kconfig.nvmap"
trysource "drivers/video/tegra/nvmap/Kconfig.nvmap"

config TEGRA_GR_VIRTUALIZATION
	bool "Tegra graphics virtualization support"
	default n
	depends on TEGRA_HV_MANAGER
	help
	  Adds Tegra graphics virtualization (host and gpu) support to client
	  drivers.

config TEGRA_DC
	tristate "Tegra Display Contoller"
	depends on (ARCH_TEGRA || PLATFORM_TEGRA) && (TEGRA_GRHOST || TEGRA_HOST1X) && I2C
	select BACKLIGHT_CLASS_DEVICE
	select FB_MODE_HELPERS
	help
	  Tegra display controller support.
	  Enable this to access the Tegra display controller using either framebuffer
	  console interface and a proprietary dc-ext interface or with ADF.

trysource "../display/drivers/video/tegra/Kconfig.display"
trysource "drivers/video/tegra/Kconfig.display"

config TEGRA_CAMERA
	bool "Enable support for tegra camera/isp hardware"
	depends on ARCH_TEGRA
	default y
	help
	  Enables support for the Tegra camera interface

	  If unsure, say Y

config TEGRA_CAMERA_PLATFORM
	bool "Enable tegra camera platform driver"
	depends on PLATFORM_TEGRA
	default y
	help
	  Enables tegra camera platform driver

	  If unsure, say Y

config NVHOST_BONDOUT_CHECK
	bool "Check device presence through bondout registers"
	depends on ARCH_TEGRA && ARM64
	default n
	help
	  Say Y here if you want to check nvhost client unit presence
	  in pre-silicon systems.
	  If unsure, say N
```
