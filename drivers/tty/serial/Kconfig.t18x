## drivers/video/tegra/nvmap/Kconfig.nvmap
```kconfig
menuconfig TEGRA_NVMAP
	bool "Tegra GPU memory management driver (nvmap)"
	select ARM_DMA_USE_IOMMU if IOMMU_API
	select DMA_SHARED_BUFFER
	select CRYPTO_LZO
	default y
	help
	  Say Y here to include the memory management driver for the Tegra
	  GPU, multimedia and display subsystems

if TEGRA_NVMAP

config NVMAP_HIGHMEM_ONLY
	bool "Use only HIGHMEM for nvmap"
	depends on IOMMU_API && HIGHMEM
	help
	  Say Y here to restrict nvmap system memory allocations (both
	  physical system memory and IOVMM) to just HIGHMEM pages.

config NVMAP_PAGE_POOLS
	bool "Use page pools to reduce allocation overhead"
	default y
	help
	  say Y here to reduce the alloction overhead, which is significant
	  for uncached, writecombine and inner cacheable memories as it
	  involves changing page attributes during every allocation per page
	  and flushing cache. Alloc time is reduced by allcoating the pages
	  ahead and keeping them aside. The reserved pages would be released
	  when system is low on memory and acquired back during release of
	  memory.

config NVMAP_PAGE_POOL_DEBUG
	bool "Debugging for page pools"
	depends on NVMAP_PAGE_POOLS
	help
	  Say Y here to include some debugging info in the page pools. This
	  adds a bit of unnecessary overhead so only enable this is you
	  suspect there is an issue with the nvmap page pools.

config NVMAP_PAGE_POOLS_INIT_FILLUP
	bool "Fill up page pools during page pools init"
	depends on NVMAP_PAGE_POOLS
	default y
	help
	  Say Y here to fill up the page pools during page pool init time.
	  This helps in faster alloctions right from the early alloction
	  requests. Page pools fill up during init would increase the boot time.
	  If increase in boot time is not acceptable, keep this option disabled.

config NVMAP_PAGE_POOLS_INIT_FILLUP_SIZE
	depends on NVMAP_PAGE_POOLS_INIT_FILLUP
	hex "Amount of memory to fill up page pools with during bootup in MB"
	default 0x64

config NVMAP_PAGE_POOL_SIZE
	depends on NVMAP_PAGE_POOLS
	hex "Page pool size in pages"
	default 0x0

config NVMAP_CACHE_MAINT_BY_SET_WAYS
	bool "Enable cache maintenance by set/ways"
	help
	 Say Y here to reduce cache maintenance overhead by MVA.
	 This helps in reducing cache maintenance overhead in the systems,
	 where inner cache includes only L1. For the systems, where inner cache
	 includes L1 and L2, keep this option disabled.

config NVMAP_CACHE_MAINT_BY_SET_WAYS_ON_ONE_CPU
	bool "Perform cache maint on one cpu only"
	depends on NVMAP_CACHE_MAINT_BY_SET_WAYS
	help
	  Say Y here to avoid cache maint on all CPU's during inner cache maint
	  by set/ways. When L1 and L2 are inner caches, cache maint on one
	  CPU is enough. When L1 is inner and L2 is outer, cache maint on
	  all CPU's is necessary during L1 cache maint by set/ways.

config NVMAP_OUTER_CACHE_MAINT_BY_SET_WAYS
	bool "Enable outer cache maintenance by set/ways"
	help
	  Say Y here if you want to optimize cache maintenance for ranges
	  bigger than size of outer cache. This option has no effect on
	  system without outer cache.

config NVMAP_DMABUF_STASH
	bool "Enable stashing of IOVA maps with dmabuf"
	default y
	help
	  Set to Y if you would like nvmap to stash maps when using dma
	  bufs. This will speed up remapping of the same handle at the cost
	  of using more IOVA space.

config NVMAP_DMABUF_STASH_STATS
	bool "Enable stat tracking on the stash"
	depends on NVMAP_DMABUF_STASH
	help
	  Say Y to enable tracking of basic cache statistics on the dmabuf
	  stash. This adds some overhead but should be very useful for
	  debugging memory leaks.

config NVMAP_FORCE_ZEROED_USER_PAGES
	bool "Only alloc zeroed pages for user space"
	default y
	help
	  Say Y here to force zeroing of pages allocated for user space. This
	  avoids leaking kernel secure data to user space. This can add
	  significant overhead to allocation operations depending on the
	  allocation size requested.

config NVMAP_FD_START
	hex "FD number to start allocation from"
	default 0x400
	help
	  NvMap handles are represented with FD's in the user processes.
	  To avoid Linux FD usage limitations, NvMap allocates FD starting
	  from this number.

config NVMAP_DEFER_FD_RECYCLE
	bool "Defer FD recycle"
	help
	  Say Y here to enable deferred FD recycle.
	  A released nvmap handle would release memory and FD. This FD
	  can be reused immediately for subsequent nvmap allocation req in
	  the same process. Any buggy code in client process that continues to
	  use FD of released allocation would continue to use new allocation
	  and can lead to undesired consequences, which can be hard to debug.
	  Enabling this option would defer recycling FD for longer time and
	  allows debugging incorrect FD references by clients by returning errors
	  for the accesses that occur after handle/FD release.

config NVMAP_DEFER_FD_RECYCLE_MAX_FD
	hex "FD number to start free FD recycle"
	depends on NVMAP_DEFER_FD_RECYCLE
	default 0x8000
	help
	  Once last allocated FD reaches this number, allocation of subsequent
	  FD's start from NVMAP_START_FD.

endif
```

## drivers/virt/tegra/Kconfig
```kconfig
config	TEGRA_VIRTUALIZATION
	bool "Tegra Virtualization support"
	depends on ARCH_TEGRA_12x_SOC || ARCH_TEGRA_21x_SOC || ARCH_TEGRA_18x_SOC
	select VIRTUALIZATION
	default n
	help
	  Enable Tegra Virtualization support; turning this option on
	  enables features like the tegra virtualization manager and
	  all others than depend on it.

	  Select y to enable virtualization features on the tegra platforms
	  that support it.

config TEGRA_HV_MANAGER
	bool "Nvidia Tegra hypervisor management & IVC"
	depends on TEGRA_VIRTUALIZATION
	select TEGRA_IVC
	help
	  The NVIDIA hypervisor management driver provides IVC channels
	  configured by the hypervisor.

	  Select Y to enable

config TEGRA_VIRT_SUPPORT_BOOTDATA
	bool "Expose Boot data passed by bootloader"
	depends on TEGRA_VIRTUALIZATION
	default n
	help
	  When enabled Boot data passed by bootloader is exposed via chosen node of device tree.

	  Select Y to enable
```

## drivers/watchdog/Kconfig.t18x
```kconfig
config TEGRA18X_WATCHDOG
	tristate "Tegra T18x watchdog"
	depends on ARCH_TEGRA_18x_SOC
	help
	  Say Y here to include support for the watchdog timer
	  embedded in NVIDIA Tegra SoCs.

	  To compile this driver as a module, choose M here: the
	  module will be called tegra18x_wdt.
```

## fs/yaffs2/Kconfig
```kconfig
#
# yaffs file system configurations
#

config YAFFS_FS
	tristate "yaffs2 file system support"
	default n
	depends on MTD_BLOCK
	select YAFFS_YAFFS1
	select YAFFS_YAFFS2
	help
	  yaffs2, or Yet Another Flash File System, is a file system
	  optimised for NAND Flash chips.

	  To compile the yaffs2 file system support as a module, choose M
	  here: the module will be called yaffs2.

	  If unsure, say N.

	  Further information on yaffs2 is available at
	  <http://www.aleph1.co.uk/yaffs/>.

config YAFFS_DEBUG
	bool "Enable yaffs debugging"
	depends on YAFFS_FS
	default n
	help
	  Enable the yaffs debugging tracing.

	  If unsure, say N.
```

## security/abl/Kconfig
```kconfig
config ABL_UTILS
	bool "Automotive Bootloader Utilities"
	default n
	help
		Provides helper functions to copy data from physical
		memory locations into kernel memory space.

                If in doubt, select "N".
```

## security/keystore/Kconfig
```kconfig
config KEYSTORE
	tristate "Generic Keystore"
	default n
	select ABL_UTILS
	help
		An IVI system deals with various keys that need to be stored
		securely on the platform. Some of the keys are stored in
		specific embedded hardware but others are required by
		algorithms running on Linux. The keystore is designed to
		provide a secure storage solution for such keys. Applications
		interface is through the char device ioctls on /dev/keystore.

		If in doubt, say "N".

choice
	prompt "Keystore Module Type"
	default KEYSTORE_FULL
	depends on KEYSTORE

config KEYSTORE_FULL
	bool "Keystore full-functionality"
	select SECURE_BOOT
	select MANIFEST
        select CRYPTO
	select CRYPTO_AES
	select CRYPTO_AES_NI_INTEL
	select CRYPTO_BLKCIPHER
	select CRYPTO_BLKCIPHER2
	select CRYPTO_RNG
	select CRYPTO_MANAGER
	select CRYPTO_CCM
	select CRYPTO_GCM
        select CRYPTO_ECB
	select CRYPTO_CTR
	select CRYPTO_SEQIV
	select CRYPTO_CBC
	select CRYPTO_HMAC
	select CRYPTO_CMAC
	select CRYPTO_SHA1
	select CRYPTO_SHA256
	select CRYPTO_SHA512
	help
		This option chooses the default keystore configuration which
		is intended for production linux kernels.

		This is the default implementation choice. Choose this one
		unless you have a good reason not to.

config KEYSTORE_SEED_WIPE
	bool "Keystore delete SEEDs"
	help
		This option will create a keystore kernel module which deletes
		the user and device SEED values provided by the bootloader and
		exits. No normal keystore functionality is available.

		This option should be seleted when building an Emergency Linux
		kernel (ELK) or recovery image on a system which also uses
		keystore on the production (normal) image. This will prevent
		the SEED values being leaked on booting to the recovery image.
endchoice

choice
        prompt "Keystore SEED size"
        default KEYSTORE_SEED_SIZE_64
        depends on KEYSTORE

config KEYSTORE_SEED_SIZE_32
        bool "32-bytes"
        help
                Set the SEED size to 32-bytes. This should
                match the size of the SEED provided by the
                bootloader.

                If unsure, select "N".

config KEYSTORE_SEED_SIZE_64
        bool "64-bytes"
        help
                Set the SEED size to 64-bytes. This should
                match the size of the SEED provided by the
                bootloader.

                If unsure, select "N".

endchoice

choice
        prompt "Keystore seed type"
        depends on KEYSTORE_FULL
        default KEYSTORE_DEVICE_AND_USER_SEED
        help
          This option allows select which seed types are available in
          Keystore. Choose the default ("Device and User seed") unless you
          know that you need one of the others.

config KEYSTORE_DEVICE_AND_USER_SEED
        bool "Device and User seed"
        help
          This option allows both device and user seed.

          This is the default implementation choice. Choose this one unless
          you have a good reason not to.

config KEYSTORE_DEVICE_SEED_ONLY
        bool "Device seed only"
        help
          This option allows device seed only.

          Only choose this option if you know what you are doing.

config KEYSTORE_USER_SEED_ONLY
        bool "User seed only"
        help
          This option allows user seed only.

          Only choose this option if you know what you are doing.

endchoice

config KEYSTORE_OEM_KEY_USAGE_BIT
	int "Keystore OEM Manifest Key usage bit"
	depends on KEYSTORE_FULL
	default 47
	help
		Sets the key manifest usage bit to use when
		verifying data (e.g. backup and migration keys) which
		are sent from the OEM.

config KEYSTORE_OEM_KEY_IDENTIFIER
	string "Keystore OEM Kernel Keyring Identifier"
	depends on KEYSTORE_FULL
	default "OEM: Keystore: 4f454d4b4559000000000080000000000000000000004b657973746f7265"
	help
		The key identifier for the OEM public key used to
		verify data (e.g. backup and migration keys) which
		are sent from the OEM.

config APPLICATION_AUTH
	bool "Application Auth using signed manifest"
	depends on KEYSTORE_FULL
        default n
	help
		Enables authentication of keystore clients and other
		applications using a signed manifest. In keystore
		the manifest is verified during client registration.

config APPLICATION_AUTH_MANIFEST_ROOT
	string "Application Auth Manifest Root Directory"
	depends on APPLICATION_AUTH
	default "/opt/ias/etc/manifest"
	help
		The root directory for signed manifests of application
		auth clients.

config KEYSTORE_TESTMODE
	bool "Keystore Enable Diagnostic Tests"
	depends on KEYSTORE_FULL
        default n
	help
		Compiles a set of test functions which run diagnostics
		such as checking of crypto self-consistency (encrypt/decrypt)
		and format conversion. Provides an API to run a series of
		tests triggered from user-space.

                If unsure, select "N".

config KEYSTORE_TEST_MIGRATION
	bool "Keystore Migration Test Functions enabled"
	depends on KEYSTORE_FULL
        default n
	help
                Makes additional functions available to keystore for testing
                the backup and migration functions on a single machine. These
		are not necessary for keystore operation, but allow the
		migration step iteself to be performed natively instead
		of on a host machine.

                If unsure, select "N".

config KEYSTORE_DEBUG
	bool "Keystore enable additional debug messages (DANGEROUS!)"
	depends on KEYSTORE
        default n
	help
		Provides additional debug prints, hexdumps during keystore
		operation. Includes hexdump of cryptographic data structures
		such as public keys.

                Should not be enabled in production as it will expose
                sensitive information!

                If unsure, select "N".

config KEYSTORE_SECURE_BOOT_IGNORE
	bool "Keystore Ignore Secure Boot Status (DANGEROUS!)"
	depends on KEYSTORE_FULL
	default n
	help
		Check this option to ignore secure boot status when
		starting keystore.

		This should not be enabled for production as applications
		will wrongly assume a secure environment.

                If unsure, select "N".

config KEYSTORE_HARD_CODED_SEED
	bool "Keystore Hard-coded SEEDs and Keys (DANGEROUS!)"
	depends on KEYSTORE_FULL
        default n
	help
                Sets the keystore SEED a to fixed values instead
                of using values passed via the kernel command line.

                WARNING: This is only for testing purposes and should not be used
                for production as any data encrypted with keystore will be vulnerable
                to attack.

                If in doubt, select "N".

config DAL_KEYSTORE
        bool "DAL Keystore"
        depends on INTEL_MEI_DAL && KEYSTORE_FULL
        help
                Enable DAL Keystore

config DAL_KEYSTORE_APPLET_PATH
	string "DAL Keystore Applet path"
	depends on DAL_KEYSTORE
	default "/var/lib/intel/dal/applets/Keystore.pack"
	help
		The path for DAL Keystore applet file.

config DAL_KEYSTORE_APPLET_ID
	string "DAL Keystore Applet UUID"
	depends on DAL_KEYSTORE
	default "c12452f0adc640a78623708f0f4f0e52"
	help
		DAL Keystore applet UUID.

config DAL_KEYSTORE_CONF_PATH
	string "DAL Keystore Configuration File"
	depends on DAL_KEYSTORE
	default "/opt/ias/etc/dal-keystore.conf"
	help
		The path for DAL Keystore configuration file.
```
