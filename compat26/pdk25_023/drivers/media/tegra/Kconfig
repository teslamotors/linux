## drivers/iio/common/nvs/Kconfig
```kconfig
#
# NVidiaSensor IIO common
#
config NVS_IIO
	tristate "Common module for NVSensor IIO drivers"
	depends on SYSFS && IIO && IIO_KFIFO_BUF && IIO_TRIGGER
	default n
	help
	  Say Y here for IIO NVSensor framework support.
	  This is a common module for NVS (NVidia Sensor)
	  IIO (Industrial Input/Output) drivers (nvs_<device>).

config NVS_LIGHT
	tristate "Common module for NVSensor light drivers"
	depends on SYSFS && IIO && IIO_KFIFO_BUF && IIO_TRIGGER
	default n
	help
	  Say Y here for the NVSensor framework for ambient light sensors.

	  This is required for NVS (NVidia Sensor) drivers (nvs_<device>)
	  that control an ambient light sensor (ALS) in their device.
	  This is typically autoselected by these drivers.

config NVS_PROXIMITY
	tristate "Common module for NVSensor proximity drivers"
	depends on SYSFS && IIO && IIO_KFIFO_BUF && IIO_TRIGGER
	default n
	help
	  Say Y here for the NVSensor framework for proximity sensors.
	  This is required for NVS (NVidia Sensor) drivers (nvs_<device>)
	  that control a proximity sensor in their device.
```

## drivers/iio/imu/nvi_mpu/Kconfig
```kconfig
#
# nvi-mpu driver for Invensense MPU devices and combos
#

config NVI_MPU
	tristate "Invensense MPU devices"
	depends on I2C && SYSFS && IIO && IIO_KFIFO_BUF && IIO_TRIGGER && !INV_MPU
	select NVS_IIO
	default n
	help
	  This driver supports the Invensense MPU devices.
	  This includes MPU6050/MPU65XX/MPU9X50
	  This driver can be built as a module. The module will be called
	  nvi-mpu.
```

## drivers/input/misc/compass/Kconfig
```kconfig
#
# Kconfig for stand-alone compass input device drivers
#

config NVI_INPUT_AK89xx
    tristate "Invensense AKM AK8975 compass input device driver"
    depends on I2C && SYSFS && INPUT && INPUT_EVDEV
    default n
    help
      This driver supports the AKM AK8975 compass device.
      This driver can be built as a module. The module will be called
      inv-ak8975.
```

## drivers/media/i2c/crlmodule-lite/Kconfig
```kconfig
config VIDEO_CRLMODULE_LITE
	tristate "CRL Module sensor support for ICI driver"
	depends on I2C
	depends on VIDEO_INTEL_ICI
    depends on !VIDEO_CRLMODULE
	---help---
	  This is a generic driver for CRL based camera modules.
```

## drivers/media/i2c/crlmodule/Kconfig
```kconfig
config VIDEO_CRLMODULE
	tristate "CRL Module sensor support"
	depends on I2C && VIDEO_V4L2 && VIDEO_V4L2_SUBDEV_API
	depends on MEDIA_CAMERA_SUPPORT
	---help---
	  This is a generic driver for CRL based camera modules.
config CRLMODULE_RD_NVM_TO_VCM
        bool "CRL Module sensor pass value to vcm"
        depends on VIDEO_CRLMODULE
        ---help---
          This is a driver for sensors that pass nvm value to
          control vcm.
```
