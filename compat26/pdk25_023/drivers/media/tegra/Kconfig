## compat26/pdk25_023/drivers/media/tegra/Kconfig
```kconfig
source "compat26/pdk25_023/drivers/media/tegra/avp/Kconfig"
source "compat26/pdk25_023/drivers/media/tegra/mediaserver/Kconfig"
source "compat26/pdk25_023/drivers/media/tegra/nvavp/Kconfig"

config TEGRA_CAMERA
        bool "Enable support for tegra camera/isp hardware"
        depends on ARCH_TEGRA
        default y
        help
          Enables support for the Tegra camera interface

          If unsure, say Y

config VIDEO_OV5650
        tristate "OV5650 camera sensor support"
        depends on I2C && ARCH_TEGRA
        ---help---
          This is a driver for the Omnivision OV5650 5MP camera sensor
          for use with the tegra isp.

config VIDEO_OV14810
        tristate "OV14810 camera sensor support"
        depends on I2C && ARCH_TEGRA
        ---help---
          This is a driver for the Omnivision OV14810 14MP camera sensor
          for use with the tegra isp.


config VIDEO_OV9726
        tristate "OV9726 camera sensor support"
        depends on I2C && ARCH_TEGRA
        ---help---
          This is a driver for the Omnivision OV9726 camera sensor
          for use with the tegra isp.

config VIDEO_OV2710
        tristate "OV2710 camera sensor support"
        depends on I2C && ARCH_TEGRA
        ---help---
          This is a driver for the Omnivision OV2710 camera sensor
          for use with the tegra isp.

config VIDEO_AR0832
        tristate "AR0832 camera sensor support"
        depends on I2C && ARCH_TEGRA
        ---help---
          This is a driver for the AR0832 camera sensor
          for use with the tegra isp.

config VIDEO_SOC380
        tristate "SOC380 camera sensor support"
        depends on I2C && ARCH_TEGRA
        ---help---
          This is a driver for the Semco soc380 camera sensor
          for use with the tegra isp.

config TORCH_SSL3250A
        tristate "SSL3250A flash/torch support"
        depends on I2C && ARCH_TEGRA
        ---help---
          This is a driver for the SSL3250A flash/torch camera device

config TORCH_TPS61050
        tristate "TPS61050 flash/torch support"
        depends on I2C && ARCH_TEGRA
        ---help---
          This is a driver for the TPS61050 flash/torch camera device

config VIDEO_SH532U
        tristate "SH532U focuser support"
        depends on I2C && ARCH_TEGRA
        ---help---
          This is a driver for the SEMCO SH532U focuser
          for use with the tegra isp.

config VIDEO_AD5820
        tristate "AD5820 focuser support"
        depends on I2C && ARCH_TEGRA
        ---help---
          This is a driver for the AD5820 focuser
          for use with the tegra isp.
```

## compat26/pdk25_023/drivers/media/tegra/nvavp/Kconfig
```kconfig
config TEGRA_NVAVP
	bool "Enable support for Tegra NVAVP driver"
	depends on ARCH_TEGRA
	default n
	help
	  Enables support for the push-buffer mechanism based driver for the Tegra
	  multimedia framework. Exports the Tegra nvavp interface on device node
	  /dev/tegra_avpchannel.

	  If unsure, say N
```

## drivers/acrn/Kconfig
```kconfig
config ACRN_SHARED_BUFFER
	bool "Intel ACRN SHARED BUFFER"
	depends on ACRN_VHM
	---help---
	  Ring buffer shared between ACRN Hypervisor and its SOS.
	  Help ACRN performance profiling.

config ACRN_TRACE
	tristate "Intel ACRN Hypervisor Trace support"
	depends on ACRN_SHARED_BUFFER
	---help---
		This is the Trace driver for the Intel ACRN hypervisor.
		You can say y to build it into the kernel, or m to build
		it as a module.

config ACRN_HVLOG
	bool "Intel ACRN Hypervisor Logmsg support"
	depends on ACRN_SHARED_BUFFER
	---help---
		This is the Trace driver for the Intel ACRN hypervisor log.
		You can say y to build it into the kernel.

config ACRN_HV_NPK_LOG
	bool "Intel ACRN Hypervisor NPK Log"
	depends on INTEL_TH
	depends on ACRN_VHM
	---help---
	  The driver is to configure/enable/disable the Intel ACRN hypervisor
	  NPK log.
```

## drivers/cbc/Kconfig
```kconfig
#
# CBC (CarrierBoardCommunication) subsystem configuration
#

config CBC_LDISC
	tristate "CBC (CarrierBoardCommunication) line discipline"
	depends on TTY
        help
          This line discipline provides support for demultiplexing the
          CBC (CarrierBoardCommunication) protocol and presents the mux
          as a set of individual char devices.
```

## drivers/char/rpmb/Kconfig
```kconfig
config RPMB
	tristate "RPMB partition interface"
	help
	  Unified RPMB partition interface for eMMC and UFS.
	  Provides interface for in kernel security controllers to
	  access RPMB partition.

	  If unsure, select N.

config RPMB_INTF_DEV
	bool "RPMB character device interface /dev/rpmbN"
	depends on RPMB
	help
	  Say yes here if you want to access RPMB from user space
	  via character device interface /dev/rpmb%d
```

## drivers/char/rpmb/mux/Kconfig
```kconfig
config RPMB_MUX
	tristate "RPMB Mux kernel module interface /dev/rpmbmux"
	default n
	depends on RPMB
	select CRYPTO_SHA256
	select CRYPTO_HMAC
	help
	  Say yes here if you want to access RPMB from user space
	  via character device interface /dev/rpmbmux, which is acted
	  as a multiplexor for RPMB by calling RPMB native driver directly.

	  It owns RPMB authentication key internally for RPMB
	  virtualization usage.The users who don't own RPMB key
	  in such a RPMB virtualization use case could enable it.
```

## drivers/clocksource/Kconfig.t18x
```kconfig
config CLK_SRC_TEGRA18_TIMER
	bool "Clocksource for tegra18 based SOC's"
	depends on PLATFORM_TEGRA
	help
	  This is the tegra18 SOC timer driver.
```

## drivers/cpuidle/Kconfig.arm64
```kconfig
#
# ARM64 CPU Idle drivers
#

config ARM64_CPUIDLE
	bool "Generic ARM64 CPU idle Driver"
	select DT_IDLE_STATES
	help
	  Select this to enable generic cpuidle driver for ARM64.
	  It provides a generic idle driver whose idle states are configured
	  at run-time through DT nodes. The CPUidle suspend backend is
	  initialized by calling the CPU operations init idle hook
	  provided by architecture code.

config CPU_IDLE_DENVER
	bool "CPU Idle Driver for NVIDIA Denver processors"
	select DT_IDLE_STATES
	depends on DENVER_CPU
	default y
	help
	  Select this to enable cpuidle on NVIDIA Denver processors.

config CPU_IDLE_TEGRA210
	bool "CPU Idle Driver for NVIDIA Tegra210 SoC"
	select DT_IDLE_STATES
	depends on ARCH_TEGRA_21x_SOC
	default y
	help
          Support for entering different power states on NVIDIA Tegra210
          SoC when CPUs become idle.

          Select this to enable cpuidle on NVIDIA Tegra210 SoC.

config CPU_IDLE_TEGRA18X
	bool "CPU Idle Driver for NVIDIA Tegra18x SoCs"
	depends on ARCH_TEGRA_18x_SOC
	default y
	select CPU_IDLE_MULTIPLE_DRIVERS
	select DT_IDLE_STATES
	help
	  Support for entering different power states on NVIDIA Tegra18x
	  SoCs when CPUs become idle.

	  Select this to enable cpuidle on NVIDIA Tegra18x SoCs.
```

## drivers/crypto/Kconfig.t18x
```kconfig
config CRYPTO_DEV_TEGRA_SE_USE_HOST1X_INTERFACE
	tristate "Use Host1x Interface for Tegra SE crypto algorithms"
	depends on ARCH_TEGRA_18x_SOC && CRYPTO_DEV_TEGRA_SE
	help
	  This allows you to use Host1x Memory Interface for Tegra SE Driver
	  Crypto algorithms.

config CRYPTO_DEV_TEGRA_VIRTUAL_SE_INTERFACE
        tristate "Virtual SE interface for Tegra SE crypto algorithms"
        depends on TEGRA_HV_MANAGER && CRYPTO_DEV_TEGRA_SE
        help
          This allows you to use Virtual SE interface for Tegra Crypto algorithms.
```

## drivers/crypto/elliptic/Kconfig.t18x
```kconfig
# SE Elliptic Engine Driver
config CRYPTO_DEV_TEGRA_ELLIPTIC_SE
	tristate "Tegra SE for Elliptic crypto algorithms"
	depends on ARCH_TEGRA_18x_SOC && CRYPTO_DEV_TEGRA_SE
	help
	   This option allows you to have support of Security Engine for Elliptic
	   Crypto Algorithms
```

## drivers/cwp/Kconfig
```kconfig
config CWP_SHARED_BUFFER
	bool "Intel CWP SHARED BUFFER"
	---help---
	  Ring buffer shared between CWP Hypervisor and its SOS.
	  Help CWP performance profiling.

config CWP_TRACE
	tristate "Intel CWP Hypervisor Trace support"
	select CWP_SHARED_BUFFER
	---help---
		This is the Trace driver for the Intel CWP hypervisor.
		You can say y to build it into the kernel, or m to build
		it as a module.
```

## drivers/dma-buf/hyper_dmabuf/Kconfig
```kconfig
menu "hyper_dmabuf options"

config HYPER_DMABUF
	bool "Enables hyper dmabuf driver"
	default y
	depends on (X86=y || X86_64=y)

choice
	prompt "Hypervisor"
	depends on HYPER_DMABUF
	default HYPER_DMABUF_XEN

config HYPER_DMABUF_XEN
	bool "Configure hyper_dmabuf for XEN hypervisor"
	depends on HYPER_DMABUF && XEN
	help
	  Configuring hyper_dmabuf driver for XEN hypervisor

config HYPER_DMABUF_ACRN
	bool "Configure hyper_dmabuf for ACRN hypervisor"
	depends on HYPER_DMABUF && ACRN_VIRTIO_DEVICES
	help
	  Configuring hyper_dmabuf driver for ACRN hypervisor
endchoice

choice
        prompt "Virtio driver type"
        depends on HYPER_DMABUF && HYPER_DMABUF_ACRN
        default HYPER_DMABUF_VIRTIO_BE

config HYPER_DMABUF_VIRTIO_BE
	depends on VBS && DRM_I915_GVT
	bool "Configure hyper_dmabuf as virtio backend"
	help
	  Configuring hyper_dmabuf driver as virtio backend

config HYPER_DMABUF_VIRTIO_FE
	depends on ACRN_VIRTIO_DEVICES
	bool "Configure hyper_dmabuf as virtio frontend"
	help
	  Configuring hyper_dmabuf driver as virtio frontend
endchoice

config HYPER_DMABUF_SYSFS
	bool "Enable sysfs information about hyper DMA buffers"
	default y
	depends on HYPER_DMABUF
	help
	  Expose information about imported and exported buffers using
	  hyper_dmabuf driver

config HYPER_DMABUF_EVENT_GEN
	bool "Enable event-generation and polling operation"
	default n
	depends on HYPER_DMABUF
	help
	  With this config enabled, hyper_dmabuf driver on the importer side
	  generates events and queue those up in the event list whenever a new
	  shared DMA-BUF is available. Events in the list can be retrieved by
	  read operation.

config HYPER_DMABUF_XEN_AUTO_RX_CH_ADD
	bool "Enable automatic rx-ch add with 10 secs interval"
	default y
	depends on HYPER_DMABUF && HYPER_DMABUF_XEN
	help
	  If enabled, driver reads a node in xenstore every 10 seconds
	  to check whether there is any tx comm ch configured by another
	  domain then initialize matched rx comm ch automatically for any
	  existing tx comm chs.

endmenu
```

## drivers/dma/Kconfig.t18x
```kconfig
config TEGRA186_GPC_DMA
	bool "NVIDIA Tegra186 GPC DMA support"
	depends on ARCH_TEGRA_18x_SOC
	select DMA_ENGINE
	help
	  Support for the NVIDIA Tegra186 GPC DMA controller driver. The
	  DMA controller is having multiple DMA channel which can be
	  configured for different peripherals like UART, SPI, etc which
	  are on APB bus.
	  This DMA controller transfers data from memory to peripheral fifo
	  or vice versa. It also supports memory to memory data transfer.
```

## drivers/edp/Kconfig
```kconfig
menu "SYSEDP Framework"

config SYSEDP_FRAMEWORK
	bool "System EDP framework"
	default n
	help
	  SYSEDP-framework implements system peak current management
endmenu
```

## drivers/firmware/tegra/Kconfig
```kconfig
menu "Tegra BPMP Driver"

config TEGRA_BPMP
	bool "Tegra BPMP driver"
	default n
	help
	  Manages firmware running on Tegra BPMP

endmenu
```

## drivers/gpio/Kconfig.t18x
```kconfig
config GPIO_TEGRA186
	bool "NVIDIA Tegra186 GPIO support"
	select GPIO_SYSFS
	help
	Support for the NVIDIA Tegra186 GPIO controller driver.
```

## drivers/gpu/drm/bridge/Kconfig
```kconfig
config DRM_BRIDGE
	def_bool y
	depends on DRM
	help
	  Bridge registration and lookup framework.

menu "Display Interface Bridges"
	depends on DRM && DRM_BRIDGE

config DRM_DW_HDMI
	tristate
	select DRM_KMS_HELPER

config DRM_NXP_PTN3460
	tristate "NXP PTN3460 DP/LVDS bridge"
	depends on OF
	select DRM_KMS_HELPER
	select DRM_PANEL
	---help---
	  ptn3460 eDP-LVDS bridge chip driver.

config DRM_PS8622
	tristate "Parade eDP/LVDS bridge"
	depends on OF
	select DRM_PANEL
	select DRM_KMS_HELPER
	select BACKLIGHT_LCD_SUPPORT
	select BACKLIGHT_CLASS_DEVICE
	---help---
	  Parade eDP-LVDS bridge chip driver.

config DRM_ANX1122
	tristate "Analogix ANX1122 (e)DP/LVDS bridge"
	select DRM_KMS_HELPER
	---help---
	  Analogix anx1122 (e)DP-LVDS bridge chip driver.

endmenu
```

## drivers/gpu/nvgpu/Kconfig.nvgpu
```kconfig
config GK20A
	tristate "Nvidia GK20A GPU support"
	default y
	help
	  Choose this option if you have an SoC with integrated
	  Nvidia GPU IP.

config GK20A_DEFAULT_TIMEOUT
	depends on GK20A
	int "Default timeout for submits"
	default 3000
	help
	  Default timeout for jobs in milliseconds. Set to zero for no timeout.

config GK20A_PMU
	bool "Support GK20A PMU"
	depends on GK20A
	default n
	help
	  Say Y here to enable GK20A PMU features.

choice
	depends on GK20A
	prompt "Enable GK20A frequency scaling"
	default GK20A_PERFMON
	optional
	help
	  Select this entry to enable gk20a scaling

config GK20A_PERFMON
	bool "Use Perfmon"
	help
	  Select this to enable built-in perfmon scaling.
	  The built-in scaling option uses simplistic
	  scaling mechanism (if busy, increase frequency and
	  decrease frequency if idle).

config GK20A_DEVFREQ
	depends on TEGRA_CLK_FRAMEWORK || COMMON_CLK
	bool "Use Devfreq"
	help
	  Select this to use devfreq based scaling.
	  Devfreq is a common framework that allows using
	  variety of different governors and changing
	  between governors on the fly. By default, no
	  governor is selected.

endchoice

config GK20A_CYCLE_STATS
	bool "Support GK20A GPU CYCLE STATS"
	depends on GK20A
	default y
	help
	  Say Y here to enable the cycle stats debugging features.

config GK20A_CTXSW_TRACE
	bool "Support GK20A Context Switch tracing"
	depends on GK20A
	default n
	help
	  Enable support for the GK20A Context Switch Tracing. In this mode,
	  FECS collects timestamps for contexts loaded on GR engine. This
	  allows tracking context switches on GR engine, as well as
	  identifying processes that submitted work.

config TEGRA_GK20A
	bool "Enable the GK20A GPU on Tegra"
	depends on TEGRA_GRHOST || TEGRA_HOST1X
	depends on GK20A
	default y
	help
	  Enable support for the GK20A graphics engine on Tegra
	  by adding a Tegra platfrom interface to the GK20A driver.
	  The Tegra platform interface requires TEGRA_GRHOST (host1x).

config TEGRA_ACR
	bool "Enable HS bin support on GM20B GPU on Tegra"
	depends on GK20A_PMU
	default n
	help
	  Enable Support for Loading High Secure binary, and using
	  Write Protected Regions (WPR) for storing ucodes, and bootstrap
	  PMU, FECS and GPCCS in Low Secure mode.

config TEGRA_USE_NA_GPCPLL
	bool "Enable noise aware mode of GM20B GPCPLL on Tegra"
	depends on TEGRA_CLK_FRAMEWORK
	default n
	help
	  Enable noise aware (NA) mode of GM20b GPCPLL. In this mode PLL output
	  frequency is automatically adjusted when GM20b voltage is fluctuating
	  because of transient PMIC or power distribution tree noise.

config GK20A_PCI
	bool "Support PCIe NVIDIA GPUs on nvgpu"
	depends on PCI && GK20A
	default y if ARM64
	default n
	help
	  Enable support for GPUs on PCIe bus.

config GK20A_VIDMEM
	bool "Support separate video memory on nvgpu"
	depends on GK20A
	default n
	help
	  Enable support for using and allocating buffers in a distinct video
	  memory aperture (in contrast to general system memory), available on
	  GPUs that have their own banks. PCIe GPUs have this, for example.

trysource "../nvgpu-t19x/drivers/gpu/nvgpu/Kconfig"
```

## drivers/i2c/busses/Kconfig.t18x
```kconfig
config I2C_BPMP_TEGRA
	tristate "NVIDIA Tegra internal BPMP I2C controller"
	depends on TEGRA_BPMP
	default y
	select I2C_ALGO_BUSCLEAR
	select I2C_ALGOBIT
	help
	  If you say yes to this option, support will be included for the
	  I2C controller embedded in NVIDIA Tegra SOCs accessed via BPMP.
	  This I2C driver is a 'virtual' I2C driver. The real driver is
	  embedded in the BPMP firmware, and this driver merely communicates
	  with that real driver.
config TEGRA_I2CSLV_T186
	bool "Tegra i2c slave controller driver"
	default y
	help
	  Enable on-chip i2c slave controller.
```
